    "---",
    "--",
    "0%",
    "--:--",
    "--.--.----",
    "C",
    "F",
    "ppb",
    "Index",
    "HCHO",
    "AQI",
    "LOG DO SISTEMA",
    "VOLTAR",
    "LIMPAR LOG",
    "Nenhum aviso ou erro para mostrar.",
    "Inicializando",
    "Ar fresco - Tudo ok",
    "Excelente",
    "Bom",
    "Moderado",
    "Ruim",
    "OFF",
    "ON",
    "OK",
    "ERR",
    "SYNC",
    "CON",
    "UPD",
    "LOW",
    "WRN",
    "Conectado",
    "Modo AP",
    "Erro",
    "Conectando",
    "Desativado",
    "Sem Wi-Fi",
    "Conectado",
    "Erro",
    "Tentando de novo...",
    "Nova tentativa atrasada",
    "Conectando...",
    "Aguardando hora...",
    "ON / OFF",
    "A cada 6h",
    "http://192.168.4.1/wifi",
    "http://aura.local/mqtt",
    "http://aura.local/theme",
    "Modo AP:\n1) Conecte seu telefone/PC na rede AP da Aura.\n2) Abra: http://192.168.4.1/dashboard\nConfig Wi-Fi: http://192.168.4.1/wifi",
    "Modo STA (Wi-Fi):\nUse: {{IP_URL}}\nHostname alternativo:\n{{LOCAL_URL}}",
    "Nao conectado:\nAtive o modo AP nas configuracoes de Wi-Fi ou conecte a Aura ao seu Wi-Fi de casa.\nDepois volte para esta pagina.",
    "CO detectado - Verifique fonte e alarme de CO",
    "CO elevado - Vá para o ar livre",
    "CO perigo - Saia agora",
    "CO2 muito alto",
    "CO2 alto",
    "CO2 elevado",
    "PM2.5 muito alto",
    "PM2.5 alto",
    "PM2.5 elevado",
    "PM1 muito alto",
    "PM1 alto",
    "PM1 elevado",
    "PM10 muito alto",
    "PM10 alto",
    "PM10 elevado",
    "HCHO muito alto",
    "HCHO alto",
    "HCHO elevado",
    "Índice VOC muito alto",
    "Índice VOC alto",
    "Índice VOC elevado",
    "Índice NOx muito alto",
    "Índice NOx alto",
    "Índice NOx elevado",
    "Temperatura muito baixa",
    "Temperatura baixa",
    "Temperatura ligeiramente baixa",
    "Temperatura muito alta",
    "Temperatura alta",
    "Temperatura ligeiramente alta",
    "Ar muito seco",
    "O ar pode parecer seco",
    "Ar muito abafado",
    "Ar abafado",
    "O ar pode parecer abafado",
    "Umidade muito baixa",
    "Umidade baixa",
    "Umidade ligeiramente baixa",
    "Umidade muito alta",
    "Umidade alta",
    "Umidade ligeiramente alta",
    "CONFIGURAÇÕES",
    "CONFIG",
    "VOLTAR",
    "OFFSET TEMP",
    "OFFSET UMID",
    "MODO NOITE",
    "C / F",
    "STATUS HEAD",
    "WI-FI",
    "HORA / DATA",
    "COR TEMA",
    "MQTT",
    "AUTO NOITE",
    "REINICIAR",
    "RESET\nFÁBRICA",
    "CO2\nCALIBRAÇÃO",
    "SOBRE",
    "PONTOS\nINDICADORES",
    "ALERTA\nPISCAR",
    "VOC\nREAPRENDER",
    "RETROILUM.",
    "CONFIG. WI-FI",
    "Status Wi-Fi:",
    "Para configurar Wi-Fi:\n- Pressione ON / OFF\n- Conecte o celular ou PC à rede \"ProjectAura-Setup\".\n- Abra http://192.168.4.1/wifi ou escaneie o QR.\n- Selecione sua rede Wi-Fi e digite a senha.\n",
    "SSID:",
    "IP:",
    "ESQUECER\nWI-FI",
    "RECONECTAR",
    "INICIAR AP",
    "CONFIG. MQTT",
    "Status MQTT:",
    "Para configurar MQTT:\n- Abra {{IP_URL}} no navegador ou escaneie o QR.\n- Host alternativo: {{LOCAL_URL}}",
    "IP dispositivo:",
    "IP broker:",
    "Tópico:",
    "RECONECTAR",
    "DATA E HORA",
    "FUSO HORÁRIO",
    "SYNC AUTO (NTP)",
    "AJUSTAR HORA",
    "Horas:",
    "Minutos:",
    "AJUSTAR DATA",
    "Dia:",
    "Mês:",
    "Ano:",
    "HORA",
    "APLICAR",
    "RTC:",
    "WIFI:",
    "NTP:",
    "Se o RTC for detectado corretamente e o dispositivo mostrar\na hora correta, voce nao precisa mudar nada.\n\nDeixe esta opcao em Auto, a menos que a deteccao do RTC esteja errada.\n\nSe o sistema nao identificar seu RTC corretamente,\nselecione manualmente o modulo instalado:",
    "AUTO",
    "Use a selecao manual apenas se a deteccao automatica estiver incorreta.\nAlterar esta configuracao reiniciara o dispositivo.",
    "Detectado: %s",
    "Selecionado: %s",
    "nenhum",
    "Status: Nao encontrado",
    "Status: Bateria fraca",
    "Status: Perda de energia",
    "Status: Hora nao definida",
    "Status: Hora invalida",
    "Status: OK",
    "Status: Reinicio necessario para aplicar as alteracoes",
    "STATUS: ",
    "TEMP",
    "UMIDADE",
    "PRESSAO MSL",
    "AQUEC.",
    "RESET VOC",
    "REINICIAR",
    "RESET",
    "CANCELAR",
    "Reset calibração VOC?",
    "Aprendizado VOC/NOx reinicia.\nLeituras instáveis por algumas horas.",
    "Reiniciar dispositivo?",
    "O dispositivo irá reiniciar.\nLeituras pausam brevemente.",
    "Reset de fábrica?",
    "Apaga Wi-Fi, offsets, temas,\nagendas e estado VOC.\nAção irreversível.",
    "TEMA:",
    "PERS.",
    "PRESET",
    "EXEMPLO:",
    "Para configurar tema personalizado:\n- Conecte o Project Aura ao WI-FI primeiro\n- Abra {{IP_URL}} no navegador\nou escaneie o QR.\n- Hostname alternativo:\n{{LOCAL_URL}}\n- Salve com Voltar",
    "Alternativa: use o link .local acima.\n{{LOCAL_URL}}",
    "CTRL\nVENTOINHA",
    "Controle ventoinha",
    "MODO NOITE AUTO",
    "Este recurso ativa cores do \"Modo Noite\" por horário.\n- Defina início e fim.\n- Ligue o interruptor.\n- Modo Noite manual desativado\n  quando Auto Noite está ON.",
    "HORA INÍCIO",
    "HORA FIM",
    "LUZ DE FUNDO",
    "Dispositivo monitora ar com tela apagada.\nSensores permanecem ativos. Toque para acordar.",
    "SONO PROGRAM.",
    "ACORDAR COM ALERTA",
    "ON / OFF",
    "ECONOMIA",
    "DORMIR ÀS",
    "ACORDAR ÀS",
    "SEMPRE",
    "30 SEG",
    "1 MIN",
    "5 MIN",
    "Calibração CO2 (Ar fresco)",
    "CALIBRAR\nCO2",
    "- ASC (Auto Self-Calibration): ON por padrão.\n- Ideal se CO2 cai perto do externo semanalmente\n  (boa ventilação / sala vazia).\n- ASC ajusta lentamente (dias, não instantâneo).\n- Com ASC ON, calibração manual\n  geralmente não é necessária.",
    "- Alimente com power bank.\n- Leve para fora em ar limpo.\n- Longe de pessoas, janelas, carros, fumaça, saídas.\n- Aguarde 10 min (mín 5).\n- Pressione Calibrar CO2 e não mova.\n- Calibração manual só para diagnóstico.\n- No máximo 1x / 6 meses.\n- Referência 420 ppm.\n- Condições erradas pioram leituras.",
    "INICIAR",
    "Confirmar calibracao CO2",
    "Verifique se o dispositivo ficou em ar externo limpo por pelo menos 5-10 minutos.\nDeseja continuar?",
    "Calibracao de CO2 em andamento\nAguarde cerca de 10 segundos.\nNao mova o dispositivo.",
    "Ativando CO2 ASC...\nAguarde cerca de 10 segundos.",
    "Desativando CO2 ASC...\nAguarde cerca de 10 segundos.",
    "TOQUE PARA CONTINUAR",
    "DIAGNÓSTICO BOOT",
    "Sistema",
    "Sensores",
    "App:",
    "MAC:",
    "Reset:",
    "Heap:",
    "Armazenamento:",
    "I2C:",
    "Touch:",
    "SEN66:",
    "SFA3X:",
    "PCF8523:",
    "Erros detectados",
    "MOSTRAR ERROS",
    "OK (config)",
    "OK (padrão)",
    "RECUPERADO",
    "DETECTADO",
    "FALHA",
    "INICIANDO",
    "NÃO ENCONTRADO",
    "PERDIDO",
    "AJUSTAR HORA",
    "Umidade absoluta muito baixa",
    "Umidade absoluta baixa",
    "Umidade absoluta ligeiramente baixa",
    "Umidade absoluta ligeiramente alta",
    "Umidade absoluta alta",
    "Umidade absoluta muito alta",
    "A temperatura afeta o conforto, a produtividade e a qualidade do sono. Limiares baseados no ASHRAE 55 (conforto térmico) e recomendações da OMS. A faixa ideal ajuda a manter o foco e reduz a fadiga. Extremos causam desconforto, sonolência ou dificuldade de concentração. Exposição prolongada a condições ruins pode afetar a saúde.",
    "Excelente: 20-25°C (68-77°F)\nFaixa ideal para conforto e produtividade",
    "Aceitável: 18-20°C ou 25-26°C (64-68°F ou 77-79°F)\nLevemente fora do ideal, ainda confortável",
    "Desconfortável: 16-18°C ou 26-28°C (61-64°F ou 79-82°F)\nDesconforto notável, produtividade menor",
    "Ruim: <16°C ou >28°C (<61°F ou >82°F)\nDesconforto significativo, ajuste necessário",
    "O índice VOC mede compostos orgânicos voláteis de tintas, móveis e cosméticos. Baseado no algoritmo Sensirion SGP (escala 1-500). Valores maiores indicam maior concentração. Exposição prolongada pode causar dor de cabeça, irritação nos olhos e fadiga. Ventile se estiver elevado. Indicador azul = sensor em aquecimento.",
    "Excelente: ≤150\nAr interno normal, nenhuma ação",
    "Aceitável: 151-250\nVOC levemente elevados, considere ventilar",
    "Desconfortável: 251-350\nOdores possíveis, ventilação recomendada",
    "Ruim: >350\nProváveis dores de cabeça e irritação, ventile imediatamente",
    "O índice NOx mede óxidos de nitrogênio de fontes de combustão: fogões a gás, aquecedores, veículos, fumaça de tabaco. Baseado no algoritmo Sensirion SGP (escala 1-500). Níveis altos irritam as vias respiratórias e pioram a asma. Use a coifa ao cozinhar a gás. Indicador azul = sensor em aquecimento.",
    "Excelente: ≤50\nAr limpo, sem fontes de combustão",
    "Aceitável: 51-100\nLeve elevação, garanta ventilação",
    "Desconfortável: 101-200\nSubprodutos de combustão perceptíveis, ventile",
    "Ruim: >200\nAlta exposição a NOx, irritação provável, identifique a fonte",
    "O formaldeído (HCHO) é um VOC cancerígeno liberado por madeira prensada, móveis, pisos, adesivos e tecidos. Limiares baseados nas diretrizes da OMS (~80 µg/m³ ≈ 65 ppb). Móveis novos e reformas são fontes principais. Causa irritação nos olhos, nariz e garganta. Os níveis diminuem com o tempo (desgaseificação). Ventile ambientes novos por algumas semanas.",
    "Excelente: <30 ppb\nNível seguro, sem irritação esperada",
    "Aceitável: 30-60 ppb\nBaixa exposição, sensíveis podem notar leve irritação",
    "Desconfortável: 60-100 ppb\nPossível irritação ocular/garganta, aumente a ventilação",
    "Ruim: >100 ppb\nRisco à saúde, exposição prolongada nociva, ventile já",
    "AQI é o índice geral em tempo real da qualidade do ar do dispositivo. Combina partículas, ventilação e gases numa escala de 0 a 100; quanto menor, melhor. Reage principalmente à pior fonte de poluição e soma pequenas penalidades de outros grupos elevados. Use como visão rápida e veja os sensores para achar a causa.",
    "Excelente: 0-25\nAr limpo, sem ação necessária",
    "Aceitável: 26-50\nLeve piora, ventilar pode ajudar",
    "Desconfortável: 51-75\nCarga notável, ache a causa e ventile",
    "Ruim: >75\nPoluição alta, reduza exposição e aja já",
    "O CO2 indica a qualidade do ar interno e a eficácia da ventilação. Limiares baseados no ASHRAE e na agência alemã (UBA). O ar externo é ~400 ppm. Acima de 1000 ppm reduz o desempenho cognitivo; acima de 1500 ppm causa sonolência e dor de cabeça. Boa ventilação mantém o CO2 baixo para foco e saúde.",
    "Excelente: <800 ppm\nQualidade ótima para foco e produtividade",
    "Aceitável: 800-1000 ppm\nLeve queda de concentração possível",
    "Desconfortável: 1000-1500 ppm\nFadiga notável, desempenho cognitivo reduzido",
    "Ruim: >1500 ppm\nSonolência, dor de cabeça, dificuldade de concentração",
    "PM2.5 são partículas finas que penetram profundamente nos pulmões e na corrente sanguínea. Limiares baseados no AQI da EPA e diretrizes da OMS. Exposição prolongada está ligada a doenças respiratórias e cardiovasculares. Fontes: cozinha, velas, poluição externa, fumaça. Mantenha níveis internos baixos com filtração e ventilação.",
    "Excelente: ≤12 µg/m³\nAr limpo, sem impacto à saúde",
    "Aceitável: >12-35 µg/m³\nPessoas sensíveis podem notar leve irritação",
    "Desconfortável: >35-55 µg/m³\nPossível desconforto respiratório, limite a exposição",
    "Ruim: >55 µg/m³\nRisco à saúde, evite exposição prolongada, melhore a ventilação",
    "PM4 são partículas respiráveis entre PM2.5 e PM10. Os limiares ficam entre referências de PM2.5 e PM10 para avaliação prática de risco interno. Fontes: poeira, fragmentos de pólen, aerossóis de combustão e poluição externa. Mantenha níveis baixos com filtração e ventilação.",
    "Excelente: ≤25 µg/m³\nAr limpo, impacto mínimo à saúde",
    "Aceitável: >25-50 µg/m³\nElevação leve, sensíveis podem notar irritação",
    "Desconfortável: >50-75 µg/m³\nPossível desconforto respiratório, reduza a exposição",
    "Ruim: >75 µg/m³\nRisco alto, melhore ventilação e filtração",
    "PM10 são partículas grossas como poeira, pólen e esporos de mofo. Limiares baseados no AQI da EPA. Podem irritar olhos, nariz e garganta. Menos nocivas que PM2.5, mas afetam a saúde respiratória. Fontes: poeira, obras, pólen, partículas de estrada. Reduza com limpeza regular, filtração e janelas fechadas.",
    "Excelente: ≤54 µg/m³\nAr limpo, sem irritação esperada",
    "Aceitável: >54-154 µg/m³\nSensíveis podem sentir leve irritação",
    "Desconfortável: >154-254 µg/m³\nPossível irritação olhos/garganta, limite a exposição",
    "Ruim: >254 µg/m³\nDesconforto respiratório provável, evite exposição prolongada",
    "A variação de pressão em 3 horas mostra mudanças rápidas do tempo e efeitos imediatos no bem-estar. Quedas rápidas costumam preceder tempestades e podem desencadear sintomas agudos em sensíveis: enxaqueca, dor articular, tontura. Útil para planejamento a curto prazo. Se sentir fadiga ou dor de cabeça súbita, verifique este valor: a queda de pressão pode ser a causa.",
    "Excelente: <1.0 hPa\nTempo estável, sem desconforto esperado",
    "Aceitável: 1.0-3.0 hPa\nTempo mudando, possível leve fadiga",
    "Desconfortável: 3.0-6.0 hPa\nFrente próxima, possíveis dor de cabeça e articulações",
    "Ruim: >6.0 hPa\nMudança rápida, enxaqueca e fadiga prováveis",
    "A variação de pressão em 24 horas revela tendências do tempo e estresse prolongado no corpo. Grandes oscilações indicam frentes fortes ou tempestades. Sensíveis podem sentir fadiga persistente, mudanças de humor ou piora de dor crônica. Útil para planejar o dia e antecipar sintomas nas próximas horas.",
    "Excelente: <2.0 hPa\nTempo estável, confortável para todos",
    "Aceitável: 2.0-6.0 hPa\nTempo mudando, sintomas leves possíveis",
    "Desconfortável: 6.0-10.0 hPa\nTempestade ou frente, maior desconforto",
    "Ruim: >10.0 hPa\nEvento severo, sintomas fortes prováveis",
    "A umidade afeta o conforto respiratório, a saúde da pele e a sensação térmica. Limiares baseados no ASHRAE 55 e EPA. A faixa ideal (40-60%) evita vias respiratórias secas e inibe mofo. Baixa umidade causa pele seca, irritação e estática. Alta umidade favorece mofo, ácaros e desconforto. O equilíbrio é fundamental.",
    "Excelente: 40-60%\nConforto ideal, saudável para vias respiratórias e pele",
    "Aceitável: 30-40% ou 60-65%\nLeve secura ou umidade, desconforto menor possível",
    "Desconfortável: 20-30% ou 65-70%\nPele seca/irritação ou sensação pegajosa",
    "Ruim: <20% ou >70%\nRisco à saúde: problemas respiratórios ou mofo",
    "A umidade absoluta mede a massa real de vapor de água no ar (g/m³), independente da temperatura. Níveis baixos ressecam vias respiratórias e pele. Níveis altos dificultam o resfriamento e favorecem mofo. Útil para decidir ventilação e comparar ar interno/externo. A faixa ideal favorece saúde respiratória e conforto.",
    "Excelente: 7-15 g/m³\nUmidade ideal, respiração confortável",
    "Aceitável: 5-7 ou 15-18 g/m³\nUm pouco seco ou úmido, leve desconforto possível",
    "Desconfortável: 4-5 ou 18-20 g/m³\nSecura ou abafado perceptível, desconforto provável",
    "Ruim: <4 ou >20 g/m³\nMuito seco ou úmido, problemas respiratórios e de pele",
    "O ponto de orvalho indica melhor o conforto de umidade que a umidade relativa. Baseado na escala NOAA. Mostra quão abafado ou seco o ar parece. Ponto baixo indica ar seco que irrita pele e vias respiratórias. Ponto alto é pegajoso e opressivo, dificultando resfriar-se ao suar. A faixa ideal oferece respiração confortável e resfriamento natural.",
    "Excelente: 10-16°C (50-61°F)\nConforto ideal, respiração agradável",
    "Aceitável: 8-10°C (46-50°F) ou 16-18°C (61-64°F)\nLevemente seco ou úmido, ainda confortável",
    "Desconfortável: 5-8°C (41-46°F) ou 18-21°C (64-70°F)\nSeco ou abafado, desconforto notável",
    "Ruim: <5°C (<41°F) ou >21°C (>70°F)\nMuito seco ou opressivo, desconforto à saúde",
    "TEMPERATURA",
    "FORMALDEÍDO",
    "UMIDADE RELATIVA",
    "UMIDADE ABSOLUTA",
    "PONTO DE ORVALHO",
    "O risco de mofo indica a probabilidade de crescimento com base nas condicoes de umidade e temperatura. Umidade alta acima de 70% combinada com temperaturas quentes cria condicoes ideais para mofo e acaros. Esporos de mofo causam alergias, problemas respiratorios e danos ao imovel. Monitore cantos, banheiros e areas pouco ventiladas. Mantenha a umidade abaixo de 60% para prevenir crescimento.",
    "Excelente: 0-2\nRisco baixo, mofo improvavel",
    "Aceitavel: 3-4\nRisco moderado, monitorar niveis de umidade",
    "Desconfortavel: 5-7\nRisco alto, desumidificar e ventilar melhor",
    "Ruim: 8-10\nRisco critico, mofo muito provavel, agir imediatamente",
    "RISCO DE MOFO",
    "PM1 sao particulas ultrafinas menores que 1 micron, capazes de penetrar mais fundo nos pulmoes e entrar na corrente sanguinea. Fontes tipicas: combustao, escapamento, fumaca de tabaco e cozinha. Nao ha limites EPA oficiais para PM1; estes limiares sao derivados de PM2.5 com faixas mais rigidas.",
    "Excelente: <=10 ug/m3\nAr limpo, sem impacto esperado na saude",
    "Aceitavel: >10-25 ug/m3\nPessoas sensiveis podem notar irritacao leve",
    "Desconfortavel: >25-50 ug/m3\nPossivel desconforto respiratorio, limite a exposicao",
    "Ruim: >50 ug/m3\nRisco a saude, evite exposicao prolongada",
    "Monoxido de carbono (CO) e um gas toxico incolor e inodoro gerado por combustao incompleta. Fontes comuns: fogao a gas, aquecedores, lareira, motores e fumaca de tabaco. O CO reduz o transporte de oxigenio no sangue e pode ficar perigoso rapidamente em ambientes internos. Mantenha equipamentos revisados, ventile bem e use detector de CO.",
    "Excelente: <9 ppm\nNivel seguro, ar interno normal",
    "Aceitavel: 9-35 ppm\nElevado, ventilar e limitar exposicao",
    "Desconfortavel: >35-100 ppm\nAlerta, dor de cabeca e fadiga possiveis",
    "Ruim: >100 ppm\nPerigo! Evacuar e ventilar imediatamente",
    "PM0.5 conta particulas ultrafinas (0.3-0.5 um) que entram na corrente sanguinea. Medido por espalhamento a laser em #/cm3. Fontes: combustao, cozinha, impressao 3D, velas e vape. Faixa do sensor: 0-3000 #/cm3. Os limites consideram a precisao (+/-100 #/cm3) e niveis urbanos internos tipicos.",
    "Excellent: <=250 #/cm3\nAr limpo, ideal para sono e permanencia prolongada",
    "Acceptable: >250-600 #/cm3\nInterior normal, nenhuma acao necessaria",
    "Uncomfortable: >600-1200 #/cm3\nFonte detectada, ventile ou use purificador",
    "Poor: >1200 #/cm3\nContagem alta, identifique fonte e melhore o ar",
    "Instalando atualizacao...\nNao desligue o dispositivo.\nO dispositivo reiniciara automaticamente.",
    "ALTITUDE",
    "TOQUE\nPARA\nALTITUDE",
    "Pressao MSL\nPressao corrigida ao nivel do mar para comparar com o tempo.",
    "Altitude acima do nivel do mar\nVerifique Maps ou GPS para a altitude",
    "Usado apenas para MSL.\nA pressao absoluta permanece igual.",
    "Pressao ABS",
    "Pressao MSL",
    "APLICAR",
