    "---",
    "--",
    "0%",
    "--:--",
    "--.--.----",
    "C",
    "F",
    "ppb",
    "Index",
    "HCHO",
    "AQI",
    "SYSTEMPROTOKOLL",
    "ZURUECK",
    "LOG LEEREN",
    "Keine Warnungen oder Fehler vorhanden.",
    "Initialisiere...",
    "Frische Luft - Alles gut",
    "Ausgezeichnet",
    "Gut",
    "Mittel",
    "Schlecht",
    "AUS",
    "AN",
    "OK",
    "ERR",
    "SYNC",
    "CON",
    "UPD",
    "LOW",
    "WRN",
    "Verbunden",
    "AP Modus",
    "Fehler",
    "Verbinde...",
    "Deaktiviert",
    "Kein WLAN",
    "Verbunden",
    "Fehler",
    "Wiederhole...",
    "Später neuer Versuch",
    "Verbinde...",
    "Warte auf Zeit...",
    "AN / AUS",
    "Alle 6h",
    "http://192.168.4.1/wifi",
    "http://aura.local/mqtt",
    "http://aura.local/theme",
    "AP-Modus:\n1) Verbinde dein Handy/PC mit dem Aura-AP-Netzwerk.\n2) Öffne: http://192.168.4.1/dashboard\nWi-Fi-Setup: http://192.168.4.1/wifi",
    "STA (Wi-Fi)-Modus:\nNutze: {{IP_URL}}\nAlternativer Hostname:\n{{LOCAL_URL}}",
    "Nicht verbunden:\nAktiviere AP im Wi-Fi-Menü oder verbinde Aura mit deinem Heim-Wi-Fi.\nDann diese Seite erneut öffnen.",
    "CO erkannt - Für Belüftung sorgen",
    "CO erhöht - Sofort lüften",
    "CO Gefahr! Jetzt evakuieren",
    "CO2 Sehr hoch! Jetzt lüften",
    "CO2 Hoch - Bald lüften",
    "CO2 Steigt - Lüften erwägen",
    "PM2.5 Sehr hoch! Reinigen - Rauch stoppen",
    "PM2.5 Hoch - Reinigen - Quelle prüfen",
    "PM2.5 Erhöht - Reiniger erwägen",
    "PM1 Sehr hoch! Reinigen - Verbrennung stoppen",
    "PM1 Hoch - Luft reinigen - Quelle prüfen",
    "PM1 Erhöht - Luftreiniger erwägen",
    "PM10 Sehr hoch! Reinigen - Quelle prüfen",
    "PM10 Hoch - Reinigen - Staub reduzieren",
    "PM10 Erhöht - Staub reduzieren",
    "HCHO Sehr hoch! Lüften - Quelle weg",
    "HCHO Hoch - Lüften - Quelle weg",
    "HCHO Erkannt - Quellen prüfen",
    "VOC Sehr hoch! Quelle finden - lüften",
    "VOC Hoch - Mehr lüften",
    "NOx Sehr hoch! Quelle stoppen - lüften",
    "NOx Hoch - Abzug nutzen - Quelle prüfen",
    "NOx Erhöht - Herd / Außen prüfen",
    "Zu kalt! Heizen",
    "Kalt - Raum heizen",
    "Etwas kühl - Mehr Wärme",
    "Zu heiß! Kühlen",
    "Warm - Lüften / kühlen",
    "Etwas warm - Mehr Luft",
    "DP Sehr niedrig! Befeuchten",
    "DP Niedrig - Luft kann trocken sein",
    "DP Schwül! Entfeuchten",
    "DP Sehr hoch - Lüften / Entfeuchten",
    "DP Hoch - Luft kann schwül sein",
    "Luftfeuchte Extrem niedrig! Befeuchten",
    "Luftfeuchte Sehr niedrig - Befeuchter",
    "Luftfeuchte Niedrig - Befeuchter erwägen",
    "Luftfeuchte Extrem hoch! Entfeuchten",
    "Luftfeuchte Sehr hoch - Entfeuchten",
    "Luftfeuchte Hoch - Mehr Luft",
    "EINSTELL",
    "EINSTELL",
    "ZURÜCK",
    "TEMP-KORR.",
    "FEUCHT-KORR.",
    "NACHTMODUS",
    "C / F",
    "HEAD STATUS",
    "WI-FI",
    "ZEIT / DATUM",
    "THEME FARBE",
    "MQTT",
    "AUTO NACHT",
    "NEUSTART",
    "WERKS\nRESET",
    "CO2\nKALIBRIEREN",
    "INFO",
    "PUNKT\nANZEIGE",
    "ALARM\nBLINK",
    "VOC\nNEU LERNEN",
    "HINTERLICHT",
    "WLAN EINSTELLUNGEN",
    "WLAN Status:",
    "WLAN einrichten:\n- ON / OFF drücken\n- Mit \"ProjectAura-Setup\" verbinden\n- http://192.168.4.1/wifi öffnen oder QR-Code scannen\n- Heimnetz wählen und Passwort eingeben\n",
    "SSID:",
    "IP:",
    "WLAN\nLÖSCHEN",
    "VERBINDEN",
    "AP START",
    "MQTT EINSTELLUNGEN",
    "MQTT Status:",
    "MQTT einrichten:\n- Öffne {{IP_URL}} im Browser oder scanne den QR.\n- Alt. Host: {{LOCAL_URL}}",
    "Gerät IP:",
    "Broker IP:",
    "Topic:",
    "VERBINDEN",
    "DATUM & ZEIT",
    "ZEITZONE",
    "AUTO SYNC (NTP)",
    "ZEIT SETZEN",
    "Stunden:",
    "Minuten:",
    "DATUM SETZEN",
    "Tag:",
    "Monat:",
    "Jahr:",
    "ZEIT",
    "ANWENDEN",
    "RTC:",
    "WLAN:",
    "NTP:",
    "Wenn dein RTC korrekt erkannt wird und das Gerät\ndie richtige Zeit zeigt, musst du nichts ändern.\n\nLass diese Einstellung auf Auto, außer die RTC-Erkennung falsch ist.\n\nWenn das System dein RTC nicht korrekt erkennt,\nwähle das installierte Modul manuell:",
    "AUTO",
    "Manuelle Auswahl nur verwenden, wenn die Auto-Erkennung falsch ist.\nBei Änderung dieser Einstellung startet das Gerät neu.",
    "Erkannt: %s",
    "Ausgewählt: %s",
    "keins",
    "Status: Nicht gefunden",
    "Status: Batterie schwach",
    "Status: Strom verloren",
    "Status: Zeit nicht gesetzt",
    "Status: Zeit ungültig",
    "Status: OK",
    "Status: Neustart zum Anwenden erforderlich",
    "STATUS: ",
    "TEMP",
    "LUFTFEUCHTE",
    "MSL DRUCK",
    "WARMLAUF",
    "VOC RESET",
    "NEUSTART",
    "RESET",
    "ABBRECHEN",
    "VOC-Kalibrierung zurücksetzen?",
    "VOC/NOx-Lernen wird neu gestartet.\nWerte können einige Stunden instabil sein.",
    "Gerät neu starten?",
    "Das Gerät wird neu gestartet.\nMesswerte pausieren kurz.",
    "Werkseinstellungen zurücksetzen?",
    "Dies löscht WLAN, Offsets, Themes,\nZeitpläne und VOC-Status.\nDies kann nicht rückgängig gemacht werden.",
    "THEME:",
    "EIGEN",
    "VORLAGEN",
    "BEISPIEL:",
    "Custom-Theme einrichten:\n- Project Aura zuerst mit WLAN verbinden\n- Öffne {{IP_URL}} im Browser\noder scanne den QR-Code.\n- Alternativer Hostname:\n{{LOCAL_URL}}\n- Mit Zurück speichern",
    "Alternative: nutze den .local-Link oben.\n{{LOCAL_URL}}",
    "LÜFTER\nSTEUER.",
    "Lüftersteuerung",
    "AUTO NACHTMODUS",
    "Diese Funktion aktiviert \"Nachtmodus\" nach Zeitplan.\n- Start- und Endzeit einstellen.\n- Schalter auf AN.\n- Manueller Nachtmodus ist deaktiviert,\n  wenn Auto Nacht aktiv ist.",
    "STARTZEIT",
    "ENDZEIT",
    "HINTERLICHT",
    "Gerät überwacht Luftqualität bei ausgeschaltetem Bildschirm.\nSensoren bleiben aktiv. Berühren zum Aufwecken.",
    "GEPLANTER SCHLAF",
    "WECKEN BEI ALARM",
    "AN / AUS",
    "ENERGIESPAREN",
    "SCHLAFEN UM",
    "AUFWACHEN UM",
    "IMMER AN",
    "30 SEK",
    "1 MIN",
    "5 MIN",
    "CO2 Kalibrierung (Frischluft)",
    "KALIBRIEREN\nCO2",
    "- ASC (Auto-Selbstkalibrierung): Standardmäßig AN.\n- Am besten, wenn CO2 mind. wöchentlich nahe Außenluft fällt\n  (gute Lüftung / Raum unbesetzt).\n- ASC passt sich langsam über Tage an (nicht sofort).\n- Mit ASC AN ist manuelle Kalibrierung meist nicht nötig.",
    "- Gerät mit Powerbank betreiben.\n- Nach draußen an frische Luft bringen.\n- Fern von Menschen (Atem), Fenstern, Autos, Rauch, Lüftungen.\n- 10 Minuten laufen lassen (mind. 5).\n- CO2 kalibrieren drücken und Gerät ruhig halten.\n- Manuelle Kalibrierung nur zur Fehlersuche.\n- Nicht öfter als alle 6 Monate kalibrieren.\n- Kalibrierung nutzt 420 ppm Referenz.\n- Falsche Bedingungen verschlechtern die Messung.",
    "START",
    "CO2-Kalibrierung bestaetigen",
    "Sicherstellen, dass das Geraet mindestens 5-10 Minuten in sauberer Aussenluft war.\nMoechten Sie fortfahren?",
    "CO2-Kalibrierung laeuft\nBitte etwa 10 Sekunden warten.\nGeraet nicht bewegen.",
    "CO2 ASC wird aktiviert...\nBitte etwa 10 Sekunden warten.",
    "CO2 ASC wird deaktiviert...\nBitte etwa 10 Sekunden warten.",
    "TIPPE ZUM FORTFAHREN",
    "BOOT-DIAGNOSE",
    "System",
    "Sensoren",
    "App:",
    "MAC:",
    "Reset:",
    "Heap:",
    "Speicher:",
    "I2C:",
    "Touch:",
    "SEN66:",
    "SFA3X:",
    "PCF8523:",
    "Fehler erkannt",
    "FEHLER ANZEIGEN",
    "OK (Konfig)",
    "OK (Standard)",
    "WIEDER OK",
    "ERKANNT",
    "FEHLER",
    "STARTET...",
    "NICHT GEFUNDEN",
    "VERLOREN",
    "ZEIT SETZEN",
    "AH sehr niedrig! Befeuchten",
    "AH niedrig - Luftbefeuchter",
    "AH hoch - Schimmelrisiko",
    "AH sehr hoch! Schimmel wächst",
    "Temperatur beeinflusst Komfort, Produktivität und Schlafqualität. Schwellenwerte basieren auf ASHRAE Standard 55 (thermischer Komfort) und WHO-Empfehlungen fürs Wohnen. Der optimale Bereich hält wach und reduziert Müdigkeit. Extreme verursachen Unbehagen, Schläfrigkeit oder Konzentrationsprobleme. Längere Exposition bei schlechten Bedingungen kann die Gesundheit beeinträchtigen.",
    "Ausgezeichnet: 20-25°C (68-77°F)\nIdealer Temperaturbereich für Komfort und Produktivität",
    "Akzeptabel: 18-20°C oder 25-26°C (64-68°F oder 77-79°F)\nEtwas außerhalb des Optimums, noch komfortabel",
    "Unangenehm: 16-18°C oder 26-28°C (61-64°F oder 79-82°F)\nDeutliches Unbehagen, reduzierte Produktivität",
    "Schlecht: <16°C oder >28°C (<61°F oder >82°F)\nStarkes Unbehagen, bitte anpassen",
    "VOC-Index misst flüchtige organische Verbindungen aus Farben, Möbeln, Reinigern und Kosmetik. Basierend auf Sensirion-SGP-Algorithmus (Skala 1-500). Index 100 entspricht der Basisluft. Höhere Werte bedeuten mehr VOC. Längere Belastung kann Kopfschmerzen, Augenreizungen und Müdigkeit verursachen. Bei erhöhten Werten lüften. Blaue Anzeige = Sensor wärmt auf.",
    "Ausgezeichnet: ≤150\nNormale Innenluft, keine Aktion nötig",
    "Akzeptabel: 151-250\nLeicht erhöhte VOC, Lüften erwägen",
    "Unangenehm: 251-350\nGerüche möglich, Lüften empfohlen",
    "Schlecht: >350\nKopfschmerzen/Reizungen möglich, sofort lüften",
    "NOx-Index misst Stickoxide aus Verbrennungsquellen: Gasherde, Heizungen, Fahrzeuge, Tabakrauch. Basierend auf Sensirion-SGP-Algorithmus (Skala 1-500). Verkehrsemissionen draußen sind oft eine Innenquelle. Hohe Werte reizen Atemwege und verschlimmern Asthma. Beim Kochen mit Gas Dunstabzug nutzen. Während der Rushhour Fenster geschlossen halten. Blaue Anzeige = Sensor wärmt auf.",
    "Ausgezeichnet: ≤50\nSaubere Luft, keine Verbrennungsquellen erkannt",
    "Akzeptabel: 51-100\nLeicht erhöht, ausreichend lüften",
    "Unangenehm: 101-200\nSpürbare Verbrennungsprodukte, aktiv lüften",
    "Schlecht: >200\nHohe NOx-Belastung, Atemwegsreizungen wahrscheinlich, Quelle suchen",
    "Formaldehyd (HCHO) ist ein krebserzeugendes VOC aus Pressholz, Möbeln, Bodenbelägen, Klebstoffen und Textilien. Schwellen basieren auf WHO-Leitlinien (~80 µg/m³ ≈ 65 ppb). Neue Möbel und Renovierungen sind Hauptquellen. Verursacht Reizungen von Augen, Nase und Rachen. Werte sinken mit der Zeit durch Ausgasen. Neue Räume mehrere Wochen gründlich lüften.",
    "Ausgezeichnet: <30 ppb\nSicherer Wert, keine Reizung erwartet",
    "Akzeptabel: 30-60 ppb\nGeringe Belastung, Empfindliche merken leichte Reizung",
    "Unangenehm: 60-100 ppb\nReizung von Augen/Rachen möglich, mehr lüften",
    "Schlecht: >100 ppb\nGesundheitsrisiko, längere Exposition schädlich, sofort lüften",
    "AQI ist der Echtzeit-Gesamtwert der Luftqualität dieses Geräts. Er fasst Partikel-, Lüftungs- und Gassignale in einem Index von 0 bis 100 zusammen, niedriger ist besser. Der Wert folgt vor allem der stärksten Belastungsquelle und ergänzt kleinere Aufschläge aus weiteren erhöhten Gruppen. Für Details die Einzelsensoren prüfen.",
    "Sehr gut: 0-25\nSaubere Luft, keine Maßnahme nötig",
    "Akzeptabel: 26-50\nLeichte Verschlechterung, Lüften kann helfen",
    "Unangenehm: 51-75\nSpürbare Belastung, Ursache suchen und lüften",
    "Schlecht: >75\nHohe Belastung, Exposition senken und sofort handeln",
    "CO2 zeigt Innenluftqualität und Lüftungswirksamkeit. Schwellen basieren auf ASHRAE- und UBA-Richtlinien. Außenluft liegt bei ~400 ppm. Werte über 1000 ppm senken die kognitive Leistung; über 1500 ppm machen müde und verursachen Kopfschmerzen. Gute Lüftung hält CO2 niedrig für optimalen Fokus und Gesundheit.",
    "Ausgezeichnet: <800 ppm\nOptimale Luftqualität für Fokus und Produktivität",
    "Akzeptabel: 800-1000 ppm\nLeichte Konzentrationsabnahme möglich",
    "Unangenehm: 1000-1500 ppm\nSpürbare Müdigkeit, reduzierte kognitive Leistung",
    "Schlecht: >1500 ppm\nSchläfrigkeit, Kopfschmerzen, Konzentrationsprobleme",
    "PM2.5 sind Feinstaubpartikel, die tief in Lunge und Blutkreislauf gelangen. Schwellen basieren auf US EPA AQI und WHO-Leitlinien. Langzeitbelastung ist mit Atemwegs- und Herz-Kreislauf-Erkrankungen verbunden. Quellen: Kochen, Kerzen, Außenluftverschmutzung, Rauchen. Innenwerte durch Filtration und Lüftung niedrig halten.",
    "Ausgezeichnet: ≤12 µg/m³\nSaubere Luft, keine Gesundheitswirkung",
    "Akzeptabel: >12-35 µg/m³\nEmpfindliche können leichte Reizung spüren",
    "Unangenehm: >35-55 µg/m³\nAtembeschwerden möglich, Exposition begrenzen",
    "Schlecht: >55 µg/m³\nGesundheitsrisiko, längere Exposition vermeiden, Lüftung verbessern",
    "PM4 sind einatembare Partikel zwischen PM2.5 und PM10. Die Schwellen sind als Zwischenbereich zwischen PM2.5- und PM10-Richtwerten für die Innenraumbewertung gesetzt. Quellen: Staub, Pollenfragmente, Verbrennungsaerosole und Außenluft. Werte mit Filtration und Lüftung niedrig halten.",
    "Ausgezeichnet: ≤25 µg/m³\nSaubere Luft, minimale Gesundheitswirkung",
    "Akzeptabel: >25-50 µg/m³\nLeicht erhöht, empfindliche können Reizung spüren",
    "Unangenehm: >50-75 µg/m³\nAtemwegsbeschwerden möglich, Exposition reduzieren",
    "Schlecht: >75 µg/m³\nHohes Risiko, Lüftung und Filtration verbessern",
    "PM10 sind grobe Partikel wie Staub, Pollen und Schimmelsporen. Schwellen basieren auf dem US EPA AQI. Reizen Augen, Nase und Rachen. Weniger schädlich als PM2.5, aber beeinflussen die Atemwege. Quellen: Staub, Baustellen, Pollen, Straßenabrieb. Reduzieren durch regelmäßige Reinigung, Luftfilterung und geschlossene Fenster.",
    "Ausgezeichnet: ≤54 µg/m³\nSaubere Luft, keine Reizung erwartet",
    "Akzeptabel: >54-154 µg/m³\nEmpfindliche können leichte Reizung spüren",
    "Unangenehm: >154-254 µg/m³\nMögliche Augen- und Rachenreizung, Exposition begrenzen",
    "Schlecht: >254 µg/m³\nAtembeschwerden wahrscheinlich, längere Exposition vermeiden",
    "Die 3-Stunden-Druckänderung zeigt schnelle Wetterwechsel und unmittelbare Auswirkungen auf das Wohlbefinden. Schnelle Abfälle gehen oft Stürmen voraus und können bei Empfindlichen akute Symptome auslösen: Migräne, Gelenkschmerzen, Schwindel. Gut für kurzfristige Planung. Bei plötzlicher Müdigkeit oder Kopfschmerz diesen Wert prüfen - ein Druckabfall kann die Ursache sein.",
    "Ausgezeichnet: <1.0 hPa\nStabiles Wetter, kein Unbehagen erwartet",
    "Akzeptabel: 1.0-3.0 hPa\nWetterwechsel, leichte Müdigkeit möglich",
    "Unangenehm: 3.0-6.0 hPa\nFront nähert sich, Kopf- und Gelenkschmerzen möglich",
    "Schlecht: >6.0 hPa\nSchneller Sturmwechsel, Migräne und Müdigkeit wahrscheinlich",
    "Die 24-Stunden-Druckänderung zeigt Wettertrends und länger anhaltende Belastung für den Körper. Große Schwankungen deuten auf starke Fronten oder Stürme hin. Empfindliche können anhaltende Müdigkeit, Stimmungsschwankungen oder verstärkte chronische Schmerzen spüren. Für Tagesplanung und zum Abschätzen der nächsten Stunden.",
    "Ausgezeichnet: <2.0 hPa\nRuhiges Wetter, für alle angenehm",
    "Akzeptabel: 2.0-6.0 hPa\nWetter ändert sich, leichte Symptome möglich",
    "Unangenehm: 6.0-10.0 hPa\nSturm oder Front, mehr Unbehagen",
    "Schlecht: >10.0 hPa\nStarkes Wetterereignis, starke Symptome wahrscheinlich",
    "Luftfeuchte beeinflusst Atemkomfort, Hautgesundheit und Temperaturempfinden. Schwellen basieren auf ASHRAE 55 und EPA. Optimal (40-60%) verhindert trockene Atemwege und hemmt Schimmel. Niedrige Feuchte verursacht trockene Haut, Reizungen und statische Aufladung. Hohe Feuchte fördert Schimmel, Hausstaubmilben und Unbehagen.",
    "Ausgezeichnet: 40-60%\nOptimaler Komfort, gut für Atemwege und Haut",
    "Akzeptabel: 30-40% oder 60-65%\nLeicht trocken oder feucht",
    "Unangenehm: 20-30% oder 65-70%\nTrockene Haut/Reizung oder schwüles Gefühl",
    "Schlecht: <20% oder >70%\nGesundheitsrisiko: Atemprobleme oder Schimmel möglich",
    "Absolute Feuchte misst die tatsächliche Wasserdampfmenge in der Luft (g/m³), unabhängig von der Temperatur. Anders als relative Feuchte zeigt sie den echten Feuchtegehalt. Niedrige Werte trocknen Atemwege und Haut aus. Hohe Werte erschweren das Kühlen und fördern Schimmel. Nützlich für Lüftungsentscheidungen und den Vergleich von Innen- und Außenluft.",
    "Ausgezeichnet: 7-15 g/m³\nOptimale Feuchte, angenehmes Atmen",
    "Akzeptabel: 5-7 oder 15-18 g/m³\nEtwas trocken oder feucht",
    "Unangenehm: 4-5 oder 18-20 g/m³\nSpürbar trocken oder schwül",
    "Schlecht: <4 oder >20 g/m³\nSehr trocken oder feucht, Atem- und Hautprobleme",
    "Der Taupunkt beschreibt das Feuchtegefühl besser als die relative Feuchte. Basierend auf der NOAA-Komfortskala. Er zeigt, wie schwül oder trocken sich die Luft anfühlt. Ein niedriger Taupunkt bedeutet trockene Luft mit Haut- und Atemwegsreizungen. Ein hoher Taupunkt wirkt klebrig und drückend und erschwert die Abkühlung durch Schwitzen.",
    "Ausgezeichnet: 10-16°C (50-61°F)\nIdealer Komfort, angenehmes Atmen",
    "Akzeptabel: 8-10°C (46-50°F) oder 16-18°C (61-64°F)\nEtwas trocken oder feucht",
    "Unangenehm: 5-8°C (41-46°F) oder 18-21°C (64-70°F)\nTrocken oder schwül, Unbehagen",
    "Schlecht: <5°C (<41°F) oder >21°C (>70°F)\nZu trocken oder drückend",
    "TEMPERATUR",
    "FORMALDEHYD",
    "RELATIVE FEUCHTIGKEIT",
    "ABSOLUTE FEUCHTIGKEIT",
    "TAUPUNKT",
    "Schimmelrisiko basiert auf Luftfeuchte und Temperatur. Über 70% Feuchte und warme Luft erhöhen das Risiko stark, besonders in Ecken, Bad und schlecht belüfteten Räumen. Halte die Luftfeuchte möglichst unter 60%.",
    "Ausgezeichnet: 0-2\nNiedriges Risiko, Schimmel unwahrscheinlich",
    "Akzeptabel: 3-4\nMittleres Risiko, Feuchtewerte beobachten",
    "Unangenehm: 5-7\nHohes Risiko, entfeuchten und besser lüften",
    "Schlecht: 8-10\nKritisches Risiko, Schimmel sehr wahrscheinlich, sofort handeln",
    "SCHIMMELRISIKO",
    "PM1 sind ultrafeine Partikel unter 1 Mikrometer, die am tiefsten in die Lunge eindringen und teils in den Blutkreislauf gelangen. Typische Quellen sind Verbrennung, Verkehr, Tabakrauch und Kochdämpfe. Offizielle EPA-Grenzen für PM1 fehlen, daher sind diese Schwellen aus PM2.5 mit strengeren Bereichen abgeleitet.",
    "Ausgezeichnet: <=10 ug/m3\nSaubere Luft, keine Gesundheitswirkung erwartet",
    "Akzeptabel: >10-25 ug/m3\nEmpfindliche können leichte Reizung bemerken",
    "Unangenehm: >25-50 ug/m3\nAtemwegsbeschwerden möglich, Exposition begrenzen",
    "Schlecht: >50 ug/m3\nGesundheitsrisiko, längere Exposition vermeiden",
    "Kohlenmonoxid (CO) ist ein farb- und geruchloses Giftgas aus unvollständiger Verbrennung. Typische Quellen sind Gasherd, Heizer, Kamin, Motorabgase und Tabakrauch. CO behindert den Sauerstofftransport im Blut und kann in Innenräumen schnell gefährlich werden. Geräte warten, gut lüften und einen CO-Melder nutzen.",
    "Ausgezeichnet: <9 ppm\nSicherer Bereich, normale Innenraumluft",
    "Akzeptabel: 9-35 ppm\nErhöht, belüften und Exposition begrenzen",
    "Unangenehm: >35-100 ppm\nWarnung, Kopfschmerzen und Erschöpfung möglich",
    "Schlecht: >100 ppm\nGefahr! Sofort evakuieren und lüften",
    "PM0.5 erfasst ultrafeine Partikel (0.3-0.5 um), die die Lungenabwehr umgehen und ins Blut gelangen. Messung per Laserstreuung in #/cm3. Hauptquellen: Verbrennung, Kochen, 3D-Druck, Kerzen, Vaping. Sensorbereich: 0-3000 #/cm3. Schwellen berücksichtigen Sensorgenauigkeit (+/-100 #/cm3) und typische urbane Innenraumwerte.",
    "Ausgezeichnet: <=250 #/cm3\nSaubere Luft, ideal für Schlaf und Aufenthalt",
    "Akzeptabel: >250-600 #/cm3\nNormaler Innenraum, keine Aktion nötig",
    "Unangenehm: >600-1200 #/cm3\nQuelle erkannt, lüften oder Reiniger nutzen",
    "Schlecht: >1200 #/cm3\nHoher Wert, Quelle finden und Luft verbessern",
    "Update wird installiert...\nGerät nicht ausschalten.\nGerät startet automatisch neu.",
    "SET HOEHE",
    "TIPPEN\nFUER\nHOEHE",
    "MSL-Druck\nAuf Meereshoehe korrigierter Druck fuer Wettervergleich.",
    "Hoehe ueber dem Meeresspiegel\nHoehe in Maps oder GPS nachsehen",
    "Nur fuer MSL.\nAbsoluter Druck bleibt unveraendert.",
    "ABS Druck",
    "MSL-Druck",
    "ANWENDEN",
