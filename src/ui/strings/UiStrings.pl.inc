    "---",
    "--",
    "0%",
    "--:--",
    "--.--.----",
    "C",
    "F",
    "ppb",
    "ind.",
    "HCHO",
    "AQI",
    "DZIENNIK SYSTEMU",
    "WRÓĆ",
    "WYCZYŚĆ",
    "Brak ostrzeżeń i błędów.",
    "Uruchamianie",
    "Świeże powietrze - wszystko OK",
    "Doskonała",
    "Dobra",
    "Umiarkowana",
    "Zła",
    "WYŁ.",
    "WŁ.",
    "OK",
    "BŁĄD",
    "SYNCH.",
    "POŁ.",
    "AKT.",
    "NISKI",
    "UWAGA",
    "Połączono",
    "Tryb AP",
    "Błąd",
    "Łączenie",
    "Wyłączono",
    "Brak Wi-Fi",
    "Połączono",
    "Błąd",
    "Ponawianie...",
    "Ponowienie później",
    "Łączenie...",
    "Oczekiwanie na czas...",
    "WŁ./WYŁ.",
    "Co 6 h",
    "http://192.168.4.1/wifi",
    "http://aura.local/mqtt",
    "http://aura.local/theme",
    "Tryb AP:\n1) Połącz telefon lub komputer z siecią AP Aury.\n2) Otwórz: http://192.168.4.1/dashboard\nUstawienia Wi-Fi: http://192.168.4.1/wifi",
    "Tryb STA (Wi-Fi):\nOtwórz: {{IP_URL}}\nAlternatywny adres:\n{{LOCAL_URL}}",
    "Brak połączenia:\nWłącz tryb AP w ustawieniach Wi-Fi lub połącz się z domową siecią.\nNastępnie wróć na tę stronę.",
    "Wykryto CO - sprawdź źródło i czujnik czadu",
    "Podwyższone CO - wyjdź na świeże powietrze",
    "Niebezpieczne CO - natychmiast wyjdź",
    "CO2 bardzo wysokie",
    "CO2 wysokie",
    "CO2 podwyższone",
    "PM2.5 bardzo wysokie",
    "PM2.5 wysokie",
    "PM2.5 podwyższone",
    "PM1 bardzo wysokie",
    "PM1 wysokie",
    "PM1 podwyższone",
    "PM10 bardzo wysokie",
    "PM10 wysokie",
    "PM10 podwyższone",
    "HCHO bardzo wysokie",
    "HCHO wysokie",
    "HCHO podwyższone",
    "Indeks VOC bardzo wysoki",
    "Indeks VOC wysoki",
    "Indeks VOC podwyższony",
    "Indeks NOx bardzo wysoki",
    "Indeks NOx wysoki",
    "Indeks NOx podwyższony",
    "Temperatura bardzo niska",
    "Temperatura niska",
    "Temperatura nieco niska",
    "Temperatura bardzo wysoka",
    "Temperatura wysoka",
    "Temperatura nieco wysoka",
    "Powietrze bardzo suche",
    "Powietrze może być suche",
    "Powietrze bardzo parne",
    "Powietrze parne",
    "Powietrze może być parne",
    "Wilgotność bardzo niska",
    "Wilgotność niska",
    "Wilgotność nieco niska",
    "Wilgotność bardzo wysoka",
    "Wilgotność wysoka",
    "Wilgotność nieco wysoka",
    "USTAWIENIA",
    "USTAWIENIA",
    "ZAPISZ/WRÓĆ",
    "KOR. TEMP.",
    "KOR. WILG.",
    "TRYB NOCNY",
    "C / F",
    "PASEK STANU",
    "WI-FI",
    "CZAS / DATA",
    "KOLOR MOTYWU",
    "MQTT",
    "AUTO NOC",
    "RESTART",
    "USTAWIENIA\nFABRYCZNE",
    "KALIBRACJA\nCO2",
    "O AURZE",
    "WSKAŹNIKI\nPUNKTOWE",
    "MIGANIE\nALARMÓW",
    "RESET\nNAUKI VOC",
    "PODŚWIETL.",
    "USTAWIENIA WI-FI",
    "Stan Wi-Fi:",
    "Aby skonfigurować Wi-Fi:\n- Naciśnij WŁ./WYŁ.\n- Połącz telefon lub komputer z siecią \"ProjectAura-Setup\".\n- Otwórz http://192.168.4.1/wifi w przeglądarce lub zeskanuj kod QR.\n- Wybierz domową sieć Wi-Fi i wpisz hasło.\n",
    "SSID:",
    "IP:",
    "ZAPOMNIJ\nWI-FI",
    "POŁĄCZ PON.",
    "WŁĄCZ AP",
    "USTAWIENIA MQTT",
    "Stan MQTT:",
    "Aby skonfigurować MQTT:\n- Otwórz {{IP_URL}} w przeglądarce lub zeskanuj kod QR.\n- Alternatywny adres: {{LOCAL_URL}}",
    "IP urządzenia:",
    "IP brokera:",
    "Temat:",
    "POŁĄCZ PON.",
    "DATA I CZAS",
    "STREFA CZASOWA",
    "AUTO SYNCH. (NTP)",
    "USTAW CZAS",
    "Godziny:",
    "Minuty:",
    "USTAW DATĘ",
    "Dzień:",
    "Miesiąc:",
    "Rok:",
    "CZAS",
    "ZASTOSUJ",
    "RTC:",
    "WIFI:",
    "NTP:",
    "Jeśli moduł RTC jest wykrywany poprawnie\ni urządzenie pokazuje właściwy czas,\nnie trzeba nic zmieniać.\n\nPozostaw Auto, chyba że wykrywanie RTC zawodzi.\n\nJeśli system błędnie rozpoznaje moduł RTC,\nwybierz zainstalowany model ręcznie:",
    "AUTO",
    "Wybierz ręcznie tylko przy błędnym wykrywaniu.\nZmiana ustawienia uruchomi urządzenie ponownie.",
    "Wykryto: %s",
    "Wybrano: %s",
    "brak",
    "Stan: Nie znaleziono",
    "Stan: Słaba bateria",
    "Stan: Utrata zasilania",
    "Stan: Czas nieustawiony",
    "Stan: Nieprawidłowy czas",
    "Stan: OK",
    "Stan: Wymagany restart, aby zastosować zmiany",
    "STAN: ",
    "TEMP.",
    "WILGOTNOŚĆ",
    "CIŚNIENIE MSL",
    "ROZGRZEW.",
    "RESET VOC",
    "RESTART",
    "RESET",
    "ANULUJ",
    "Zresetować kalibrację VOC?",
    "Nauka VOC/NOx rozpocznie się od nowa.\nOdczyty mogą być niestabilne przez kilka godzin.",
    "Uruchomić ponownie?",
    "Urządzenie uruchomi się ponownie.\nPomiary zostaną na chwilę wstrzymane.",
    "Ustawienia fabryczne?",
    "Usunie to Wi-Fi, korekty, motywy,\nharmonogramy i stan VOC.\nTej operacji nie można cofnąć.",
    "MOTYW:",
    "WŁASNY",
    "GOTOWE",
    "PRZYKŁAD:",
    "Aby ustawić własny motyw:\n- Najpierw połącz Project Aura z Wi-Fi.\n- Otwórz {{IP_URL}} w przeglądarce\nlub zeskanuj kod QR.\n- Alternatywny adres:\n{{LOCAL_URL}}\n- Zapisz przyciskiem Wróć.",
    "Możesz też użyć adresu .local powyżej.\n{{LOCAL_URL}}",
    "STEROWANIE\nWENTYL.",
    "Wentylator",
    "AUTO TRYB NOCNY",
    "Włącza kolory trybu nocnego według harmonogramu.\n- Ustaw poniżej godzinę początku i końca.\n- Włącz przełącznik.\n- Ręczny tryb nocny jest wtedy niedostępny.",
    "POCZĄTEK",
    "KONIEC",
    "PODŚWIETLENIE EKRANU",
    "Przy wyłączonym ekranie pomiary nadal działają.\nCzujniki pozostają aktywne. Dotknij, aby wybudzić.",
    "HARMONOGRAM SNU",
    "ALARM BUDZI",
    "WŁ./WYŁ.",
    "OSZCZĘDZANIE",
    "UŚPIJ O",
    "WYBUDŹ O",
    "ZAWSZE WŁ.",
    "30 SEK",
    "1 MIN",
    "5 MIN",
    "Kalibracja CO2 (świeże powietrze)",
    "KALIBRUJ\nCO2",
    "- ASC (automatyczna kalibracja): domyślnie włączona.\n- Działa najlepiej, gdy CO2 spada do poziomu zewnętrznego\nco najmniej raz w tygodniu (wietrzenie / pusty pokój).\n- ASC koryguje odczyty przez kilka dni, nie od razu.\n- Przy włączonej ASC ręczna kalibracja zwykle\nnie jest potrzebna.",
    "- Zasil urządzenie z powerbanku.\n- Wynieś je na zewnątrz, na czyste, świeże powietrze.\n- Unikaj ludzi (oddechu), okien, aut, dymu i nawiewów.\n- Pozostaw włączone na 10 minut (minimum 5).\n- Naciśnij Kalibruj CO2 i nie poruszaj urządzeniem.\n- Kalibruj ręcznie tylko przy problemach z pomiarem.\n- Nie kalibruj częściej niż raz na 6 miesięcy.\n- Poziom odniesienia to 420 ppm.\n- Niewłaściwe warunki mogą pogorszyć odczyty.",
    "START",
    "Potwierdź kalibrację CO2",
    "Czy urządzenie było na czystym powietrzu\nna zewnątrz przez minimum 5-10 minut?\nKontynuować?",
    "Trwa kalibracja CO2\nPoczekaj około 10 sekund.\nNie poruszaj urządzeniem.",
    "Włączanie ASC dla CO2...\nPoczekaj około 10 sekund.",
    "Wyłączanie ASC dla CO2...\nPoczekaj około 10 sekund.",
    "DOTKNIJ, ABY KONTYNUOWAĆ",
    "DIAGNOSTYKA STARTU",
    "System",
    "Czujniki",
    "Aplikacja:",
    "MAC:",
    "Reset:",
    "Sterta:",
    "Pamięć:",
    "I2C:",
    "Dotyk:",
    "SEN66:",
    "SFA3X:",
    "PCF8523:",
    "Wykryto błędy",
    "POKAŻ BŁĘDY",
    "OK (ustawienia)",
    "OK (domyślne)",
    "PRZYWRÓCONO",
    "WYKRYTO",
    "BŁĄD",
    "START",
    "NIE ZNALEZIONO",
    "UTRACONO",
    "USTAW CZAS",
    "Wilgotność bezwzględna bardzo niska",
    "Wilgotność bezwzględna niska",
    "Wilgotność bezwzględna nieco niska",
    "Wilgotność bezwzględna nieco wysoka",
    "Wilgotność bezwzględna wysoka",
    "Wilgotność bezwzględna bardzo wysoka",
    "Temperatura wpływa na komfort, wydajność i jakość snu. Progi oparto na normie ASHRAE 55 dotyczącej komfortu cieplnego oraz zaleceniach WHO dla mieszkań. Optymalny zakres sprzyja koncentracji i zapobiega zmęczeniu. Skrajne wartości powodują dyskomfort, senność lub trudności z koncentracją. Długotrwałe przebywanie w niekorzystnych warunkach może wpływać na zdrowie.",
    "Doskonała: 20-25°C (68-77°F)\nIdealny zakres dla komfortu i wydajności",
    "Dopuszczalna: 18-20°C lub 25-26°C (64-68°F lub 77-79°F)\nNieco poza optymalnym zakresem, nadal komfortowo",
    "Niekomfortowa: 16-18°C lub 26-28°C (61-64°F lub 79-82°F)\nOdczuwalny dyskomfort, mniejsza wydajność",
    "Zła: <16°C lub >28°C (<61°F lub >82°F)\nZnaczny dyskomfort, dostosuj temperaturę",
    "Indeks VOC określa poziom lotnych związków organicznych z farb, mebli, środków czystości i kosmetyków. Korzysta z algorytmu Sensirion SGP (skala 1-500). Wartość 100 odpowiada poziomowi bazowemu. Wyższe wartości oznaczają więcej VOC. Długotrwała ekspozycja może powodować bóle głowy, podrażnienie oczu i zmęczenie. Przy wzroście wietrz pomieszczenie. Niebieski wskaźnik oznacza rozgrzewanie czujnika.",
    "Doskonały: ≤150\nTypowe powietrze w pomieszczeniu, bez potrzeby działania",
    "Dopuszczalny: 151-250\nNiewielki wzrost VOC, rozważ wietrzenie",
    "Niekomfortowy: 251-350\nMożliwe wyczuwalne zapachy, zalecane wietrzenie",
    "Zły: >350\nPrawdopodobne bóle głowy i podrażnienia, wietrz od razu",
    "Indeks NOx określa poziom tlenków azotu ze spalania: kuchenek gazowych, ogrzewaczy, pojazdów i dymu tytoniowego. Korzysta z algorytmu Sensirion SGP (skala 1-500). Spaliny uliczne często przenikają do wnętrz. Wysokie poziomy podrażniają drogi oddechowe i nasilają astmę. Używaj okapu przy gotowaniu na gazie. W godzinach szczytu zamykaj okna. Niebieski wskaźnik oznacza rozgrzewanie czujnika.",
    "Doskonały: ≤50\nCzyste powietrze, nie wykryto źródeł spalania",
    "Dopuszczalny: 51-100\nNiewielki wzrost, zapewnij odpowiednią wentylację",
    "Niekomfortowy: 101-200\nWykryto produkty spalania, intensywnie wietrz",
    "Zły: >200\nDuża ekspozycja na NOx, możliwe podrażnienia, znajdź źródło",
    "Formaldehyd (HCHO) to rakotwórczy lotny związek organiczny uwalniany z płyt drewnopochodnych, mebli, podłóg, klejów i tkanin. Progi oparto na wytycznych WHO (~80 µg/m³ ≈ 65 ppb). Główne źródła to nowe meble i remonty. Powoduje podrażnienie oczu, nosa i gardła. Stężenie maleje z czasem, gdy materiały oddają lotne związki. Nowe wnętrza intensywnie wietrz przez kilka tygodni.",
    "Doskonały: <30 ppb\nBezpieczny poziom, podrażnienia nie są spodziewane",
    "Dopuszczalny: 30-60 ppb\nMała ekspozycja, u osób wrażliwych możliwe podrażnienie",
    "Niekomfortowy: 60-100 ppb\nMożliwe podrażnienie oczu i gardła, zwiększ wentylację",
    "Zły: >100 ppb\nRyzyko zdrowotne przy długiej ekspozycji, wietrz od razu",
    "AQI to bieżąca ocena ogólnej jakości powietrza w tym urządzeniu. Łączy pomiary pyłów, wentylacji i gazów w indeks od 0 do 100; im niższy, tym lepiej. Największy wpływ ma najgorsze źródło zanieczyszczeń, a pozostałe podwyższone grupy zwiększają wynik w mniejszym stopniu. AQI daje szybki przegląd sytuacji. Sprawdź poszczególne czujniki, aby znaleźć główną przyczynę.",
    "Doskonały: 0-25\nOgólnie czyste powietrze, bez potrzeby działania",
    "Dopuszczalny: 26-50\nNiewielkie pogorszenie jakości, wietrzenie może pomóc",
    "Niekomfortowy: 51-75\nWyraźne zanieczyszczenie, znajdź źródło i popraw wentylację",
    "Zły: >75\nDuże zanieczyszczenie, ogranicz ekspozycję i działaj od razu",
    "CO₂ wskazuje jakość powietrza wewnątrz i skuteczność wentylacji. Progi oparto na wytycznych ASHRAE i niemieckiej Federalnej Agencji Środowiska (UBA). Na zewnątrz jest około 400 ppm. Poziomy powyżej 1000 ppm obniżają sprawność umysłową, a powyżej 1500 ppm powodują senność i bóle głowy. Dobra wentylacja utrzymuje niskie CO₂, wspierając koncentrację i zdrowie.",
    "Doskonały: <800 ppm\nOptymalna jakość powietrza dla koncentracji i wydajności",
    "Dopuszczalny: 800-1000 ppm\nMożliwy niewielki spadek koncentracji",
    "Niekomfortowy: 1000-1500 ppm\nOdczuwalne zmęczenie i niższa sprawność umysłowa",
    "Zły: >1500 ppm\nSenność, bóle głowy i trudności z koncentracją",
    "PM2.5 to drobne cząstki wnikające głęboko do płuc i krwiobiegu. Progi oparto na indeksie AQI amerykańskiej EPA i wytycznych WHO. Długotrwała ekspozycja wiąże się z chorobami układu oddechowego i krążenia. Źródła to gotowanie, świece, zanieczyszczenia z zewnątrz i palenie. Utrzymuj niskie stężenia dzięki filtracji i wentylacji.",
    "Doskonały: ≤12 µg/m³\nCzyste powietrze, bez wpływu na zdrowie",
    "Dopuszczalny: >12-35 µg/m³\nU osób wrażliwych możliwe lekkie podrażnienie",
    "Niekomfortowy: >35-55 µg/m³\nMożliwy dyskomfort oddechowy, ogranicz ekspozycję",
    "Zły: >55 µg/m³\nRyzyko zdrowotne, unikaj długiej ekspozycji, popraw wentylację",
    "PM4 to cząstki respirabilne osadzające się głęboko w drogach oddechowych, o rozmiarach pomiędzy PM2.5 a PM10. Progi dobrano pomiędzy zaleceniami dla PM2.5 i PM10 do praktycznej oceny ryzyka we wnętrzach. Źródła obejmują kurz, fragmenty pyłków, aerozole spalania i zanieczyszczenia zewnętrzne. Filtracja i wentylacja pomagają utrzymać niski poziom.",
    "Doskonały: ≤25 µg/m³\nCzyste powietrze, minimalny wpływ na zdrowie",
    "Dopuszczalny: >25-50 µg/m³\nNiewielki wzrost, u osób wrażliwych możliwe podrażnienie",
    "Niekomfortowy: >50-75 µg/m³\nMożliwy dyskomfort oddechowy, ogranicz ekspozycję",
    "Zły: >75 µg/m³\nDuże ryzyko ekspozycji, popraw wentylację i filtrację",
    "PM10 to większe cząstki, w tym kurz, pyłki i zarodniki pleśni. Progi oparto na indeksie AQI amerykańskiej EPA. Mogą podrażniać oczy, nos i gardło. Są mniej szkodliwe niż PM2.5, lecz nadal wpływają na układ oddechowy. Źródła to kurz, prace budowlane, pyłki i pył drogowy. Ograniczaj je przez regularne sprzątanie, filtrację powietrza i zamykanie okien.",
    "Doskonały: ≤54 µg/m³\nCzyste powietrze, podrażnienia nie są spodziewane",
    "Dopuszczalny: >54-154 µg/m³\nU osób wrażliwych możliwe lekkie podrażnienie",
    "Niekomfortowy: >154-254 µg/m³\nMożliwe podrażnienie oczu i gardła, ogranicz ekspozycję",
    "Zły: >254 µg/m³\nMożliwy dyskomfort oddechowy, unikaj długiej ekspozycji",
    "Zmiana ciśnienia w ciągu 3 godzin pokazuje nagłe zmiany pogody i ich możliwy wpływ na samopoczucie. Szybkie spadki często poprzedzają burze i mogą wywoływać u osób wrażliwych migreny, bóle stawów lub zawroty głowy. Przydaje się do planowania najbliższych godzin. Przy nagłym zmęczeniu lub bólu głowy sprawdź tę wartość: przyczyną może być spadek ciśnienia.",
    "Doskonała: <1.0 hPa (<0.03 inHg)\nStabilna pogoda, dyskomfort nie jest spodziewany",
    "Dopuszczalna: 1.0-3.0 hPa (0.03-0.09 inHg)\nZmiana pogody, możliwe lekkie zmęczenie",
    "Niekomfortowa: 3.0-6.0 hPa (0.09-0.18 inHg)\nZbliża się front, możliwe bóle głowy i stawów",
    "Zła: >6.0 hPa (>0.18 inHg)\nGwałtowna zmiana pogody, możliwe migreny i zmęczenie",
    "Zmiana ciśnienia w ciągu 24 godzin pokazuje trendy pogodowe i dłuższe obciążenie organizmu. Duże wahania wskazują na przejście silnych frontów lub burz. U osób wrażliwych mogą wystąpić utrzymujące się zmęczenie, zmiany nastroju lub nasilenie przewlekłego bólu. Wartość pomaga planować dzień i przewidywać objawy w kolejnych godzinach.",
    "Doskonała: <2.0 hPa (<0.06 inHg)\nStabilna pogoda, komfortowe warunki",
    "Dopuszczalna: 2.0-6.0 hPa (0.06-0.18 inHg)\nZmiana pogody, możliwe łagodne objawy",
    "Niekomfortowa: 6.0-10.0 hPa (0.18-0.30 inHg)\nPrzejście burzy lub frontu, większy dyskomfort",
    "Zła: >10.0 hPa (>0.30 inHg)\nSilne zjawisko pogodowe, prawdopodobne nasilone objawy",
    "Wilgotność wpływa na komfort oddychania, stan skóry i temperaturę odczuwalną. Progi oparto na normie ASHRAE 55 i zaleceniach EPA. Optymalny zakres (40-60%) zapobiega wysychaniu dróg oddechowych i hamuje pleśń. Niska wilgotność powoduje suchość skóry, podrażnienia i elektryzowanie. Wysoka sprzyja pleśni, roztoczom i dyskomfortowi. Równowaga służy zdrowiu i mieszkaniu.",
    "Doskonała: 40-60%\nOptymalny komfort dla dróg oddechowych i skóry",
    "Dopuszczalna: 30-40% lub 60-65%\nNieco sucho lub wilgotno, możliwy niewielki dyskomfort",
    "Niekomfortowa: 20-30% lub 65-70%\nSucha, podrażniona skóra lub uczucie parności",
    "Zła: <20% lub >70%\nRyzyko problemów oddechowych lub rozwoju pleśni",
    "Wilgotność bezwzględna określa masę pary wodnej w powietrzu (g/m³), niezależnie od temperatury. W odróżnieniu od względnej pokazuje rzeczywistą zawartość wilgoci. Niskie wartości wysuszają drogi oddechowe i skórę. Wysokie utrudniają chłodzenie ciała i sprzyjają pleśni. Przydaje się przy wietrzeniu i porównywaniu powietrza wewnątrz i na zewnątrz. Optymalny zakres wspiera komfort i zdrowie dróg oddechowych.",
    "Doskonała: 7-15 g/m³\nOptymalna ilość wilgoci, komfortowe oddychanie",
    "Dopuszczalna: 5-7 lub 15-18 g/m³\nNieco sucho lub wilgotno, możliwy niewielki dyskomfort",
    "Niekomfortowa: 4-5 lub 18-20 g/m³\nOdczuwalna suchość lub parność, możliwy dyskomfort",
    "Zła: <4 lub >20 g/m³\nBardzo sucho lub wilgotno, możliwe problemy ze skórą i oddechem",
    "Punkt rosy lepiej opisuje komfort wilgotności niż wilgotność względna. Opiera się na skali komfortu NOAA i pokazuje, jak suche lub parne wydaje się powietrze. Niski punkt rosy oznacza suche powietrze, które podrażnia skórę i drogi oddechowe. Wysoki daje uczucie lepkości i duszności, utrudniając chłodzenie przez pocenie. Optymalny zakres sprzyja oddychaniu i naturalnemu chłodzeniu.",
    "Doskonały: 10-16°C (50-61°F)\nIdealny komfort, swobodne oddychanie",
    "Dopuszczalny: 8-10°C (46-50°F) lub 16-18°C (61-64°F)\nNieco sucho lub wilgotno, nadal komfortowo",
    "Niekomfortowy: 5-8°C (41-46°F) lub 18-21°C (64-70°F)\nSucho lub parno, odczuwalny dyskomfort",
    "Zły: <5°C (<41°F) lub >21°C (>70°F)\nZbyt sucho lub duszno, niekorzystne samopoczucie",
    "TEMPERATURA",
    "FORMALDEHYD",
    "WILGOTNOŚĆ WZGLĘDNA",
    "WILGOTNOŚĆ BEZWZGLĘDNA",
    "PUNKT ROSY",
    "Ryzyko pleśni określa prawdopodobieństwo jej rozwoju na podstawie wilgotności i temperatury. Wilgotność powyżej 70% wraz z ciepłem tworzy idealne warunki dla pleśni i roztoczy. Zarodniki pleśni wywołują alergie, problemy oddechowe i szkody w mieszkaniu. Obserwuj narożniki, łazienki i słabo wentylowane miejsca. Utrzymuj wilgotność poniżej 60%, aby zapobiegać rozwojowi pleśni.",
    "Doskonałe: 0-2\nNiskie ryzyko, warunki niesprzyjające pleśni",
    "Dopuszczalne: 3-4\nUmiarkowane ryzyko, obserwuj wilgotność",
    "Niekomfortowe: 5-7\nWysokie ryzyko, obniż wilgotność i popraw wentylację",
    "Złe: 8-10\nKrytyczne ryzyko, możliwy rozwój pleśni, działaj od razu",
    "RYZYKO PLEŚNI",
    "PM1 to bardzo drobne cząstki mniejsze niż 1 mikrometr, które wnikają najgłębiej do płuc i bezpośrednio do krwiobiegu. Źródła to spalanie, spaliny pojazdów, dym tytoniowy i opary kuchenne. Są szczególnie groźne ze względu na głębokie wnikanie w tkanki. EPA nie określa oficjalnych progów PM1; wartości wywodzą się z wytycznych PM2.5, z ostrzejszymi limitami ze względu na wpływ na zdrowie.",
    "Doskonały: <=10 ug/m3\nCzyste powietrze, bez wpływu na zdrowie",
    "Dopuszczalny: >10-25 ug/m3\nU osób wrażliwych możliwe lekkie podrażnienie",
    "Niekomfortowy: >25-50 ug/m3\nMożliwy dyskomfort oddechowy, ogranicz ekspozycję",
    "Zły: >50 ug/m3\nRyzyko zdrowotne, unikaj długiej ekspozycji, popraw wentylację",
    "Tlenek węgla (CO), czyli czad, to bezbarwny, bezwonny, toksyczny gaz powstający przy niepełnym spalaniu. Typowe źródła to kuchenki gazowe, ogrzewacze, kominki, silniki i dym tytoniowy. CO ogranicza transport tlenu we krwi i może szybko stać się niebezpieczny w pomieszczeniu. Serwisuj urządzenia spalające paliwo, zapewnij wentylację i używaj osobnego czujnika czadu.",
    "Doskonały: <9 ppm\nBezpieczny poziom, typowe powietrze w pomieszczeniu",
    "Dopuszczalny: 9-35 ppm\nPodwyższony poziom, zapewnij wentylację, ogranicz ekspozycję",
    "Niekomfortowy: >35-100 ppm\nUwaga, możliwe bóle głowy i zmęczenie",
    "Zły: >100 ppm\nNiebezpieczeństwo! Natychmiast opuść pomieszczenie i przewietrz",
    "PM0.5 zlicza bardzo drobne cząstki (0.3-0.5 um), które omijają mechanizmy obronne płuc i przenikają do krwiobiegu. Pomiar wykorzystuje rozpraszanie światła lasera, w #/cm3. Główne źródła to spalanie, gotowanie, druk 3D, świece i e-papierosy. Zakres czujnika: 0-3000 #/cm3. Progi uwzględniają dokładność (+/-100 #/cm3) oraz typowe tło w miejskich wnętrzach.",
    "Doskonały: <=250 #/cm3\nCzyste powietrze, idealne do snu i długiego pobytu",
    "Dopuszczalny: >250-600 #/cm3\nTypowa aktywność w pomieszczeniu, bez potrzeby działania",
    "Niekomfortowy: >600-1200 #/cm3\nWykryto źródło, przewietrz lub włącz oczyszczacz",
    "Zły: >1200 #/cm3\nDużo cząstek, znajdź źródło i popraw przepływ powietrza",
    "Instalowanie aktualizacji...\nNie odłączaj zasilania.\nUrządzenie uruchomi się ponownie automatycznie.",
    "WYSOKOŚĆ",
    "DOTKNIJ, BY\nUSTAWIĆ\nWYSOKOŚĆ",
    "Ciśnienie MSL\nCiśnienie na poziomie morza do porównywania pogody.",
    "Wysokość nad poziomem morza\nSprawdź wysokość na mapie lub przez GPS",
    "Dotyczy tylko MSL.\nCiśnienie bezwzględne pozostaje bez zmian.",
    "Ciśnienie ABS",
    "Ciśnienie MSL",
    "ZASTOSUJ",
    "JEDNOSTKI",
    "STRONA\nWWW",
    "DZIENNIK",
    "JĘZYK:",
    "Aktualizacja firmware",
    "ZEZWÓL\nNA AKTUAL.",
    "ODRZUĆ\nAKTUAL.",
    "Przesyłanie przez WWW oczekuje.\nZezwolić na aktualizację?",
    "Aktualizacja dozwolona.\nRozpoczynanie przesyłania...",
    "Aktualizacja odrzucona.\nPrzesyłanie anulowane.",
    "RĘCZNY",
    "AUTO\nWŁ.",
    "CZAS:",
    "PRĘDKOŚĆ:",
    "WENTYL.:",
    "Przyczyna",
    "Więcej ustawień w WWW:",
    "WYJ.:",
    "1\ngodz.",
    "2\ngodz.",
    "4\ngodz.",
    "8\ngodz.",
    "BRAK POŁ.",
    "AWARIA",
    "PRACUJE",
    "ZATRZYMANY",
    "NIEZNANE",
    "Połącz Wi-Fi lub włącz AP",
    "Project Aura\nWersja: v%s\n(c) Volodymyr Papush (21CNCStudio)\nOprogramowanie open source (GPL-3.0-or-later)\naura-aq.com",
