    "---",
    "--",
    "0%",
    "--:--",
    "--.--.----",
    "C",
    "F",
    "ppb",
    "Index",
    "HCHO",
    "AQI",
    "SYSTEM LOG",
    "BACK",
    "CLEAR LOG",
    "No warnings or errors to show.",
    "Initializing",
    "Fresh Air - All Good",
    "Excellent",
    "Good",
    "Moderate",
    "Poor",
    "OFF",
    "ON",
    "OK",
    "ERR",
    "SYNC",
    "CON",
    "UPD",
    "LOW",
    "WRN",
    "Connected",
    "AP Mode",
    "Error",
    "Connecting",
    "Disabled",
    "No WiFi",
    "Connected",
    "Error",
    "Retrying...",
    "Delayed retry",
    "Connecting...",
    "Waiting for time...",
    "ON / OFF",
    "Every 6h",
    "http://192.168.4.1/wifi",
    "http://aura.local/mqtt",
    "http://aura.local/theme",
    "AP mode:\n1) Connect your phone/PC to the Aura AP network.\n2) Open: http://192.168.4.1/dashboard\nWi-Fi setup: http://192.168.4.1/wifi",
    "STA (Wi-Fi) mode:\nUse: {{IP_URL}}\nAlternative hostname:\n{{LOCAL_URL}}",
    "Not connected:\nEnable AP mode in Wi-Fi settings or connect to your home Wi-Fi.\nThen return to this page.",
    "CO detected - Check source and CO alarm",
    "CO elevated - Move to fresh air",
    "CO danger - Leave now",
    "CO2 very high",
    "CO2 high",
    "CO2 elevated",
    "PM2.5 very high",
    "PM2.5 high",
    "PM2.5 elevated",
    "PM1 very high",
    "PM1 high",
    "PM1 elevated",
    "PM10 very high",
    "PM10 high",
    "PM10 elevated",
    "HCHO very high",
    "HCHO high",
    "HCHO elevated",
    "VOC Index very high",
    "VOC Index high",
    "VOC Index elevated",
    "NOx Index very high",
    "NOx Index high",
    "NOx Index elevated",
    "Temperature very low",
    "Temperature low",
    "Temperature slightly low",
    "Temperature very high",
    "Temperature high",
    "Temperature slightly high",
    "Air feels very dry",
    "Air may feel dry",
    "Air feels very muggy",
    "Air feels muggy",
    "Air may feel muggy",
    "Humidity very low",
    "Humidity low",
    "Humidity slightly low",
    "Humidity very high",
    "Humidity high",
    "Humidity slightly high",
    "SETTINGS",
    "SETTINGS",
    "SAVE & BACK",
    "TEMP OFFSET",
    "HUMID OFFSET",
    "NIGHT MODE",
    "C / F",
    "HEAD STATUS",
    "WI-FI",
    "TIME / DATE",
    "THEME COLOR",
    "MQTT",
    "AUTO NIGHT",
    "RESTART",
    "FACTORY\nRESET",
    "CO2\nCALLIBRATION",
    "ABOUT",
    "DOT\nINDICATORS",
    "ALERT\nBLINK",
    "VOC\nRELEARN",
    "BACKLIGHT",
    "WI-FI SETTINGS",
    "Wi-Fi status:",
    "To configure Wi-Fi:\n- Press ON / OFF button\n- Connect your phone or PC to network \"ProjectAura-Setup\".\n- Open http://192.168.4.1/wifi in browser or scan QR code.\n- Select your home Wi-Fi network and enter the password.\n",
    "SSID:",
    "IP:",
    "FORGET\nWI-FI",
    "RECONNECT",
    "START AP",
    "MQTT SETTINGS",
    "MQTT status:",
    "To configure MQTT:\n- Open {{IP_URL}} in browser or scan QR code.\n- Alternative hostname: {{LOCAL_URL}}",
    "Device IP:",
    "Broker IP:",
    "Topic:",
    "RECONNECT",
    "DATE & TIME",
    "TIME ZONE",
    "AUTO SYNC (NTP)",
    "SET TIME",
    "Hours:",
    "Minutes:",
    "SET DATE",
    "Day:",
    "Month:",
    "Year:",
    "TIME",
    "APPLY NOW",
    "RTC:",
    "WIFI:",
    "NTP:",
    "If your RTC is detected correctly and the device shows\nthe correct time, you do not need to change anything.\n\nLeave this setting on Auto unless RTC detection is wrong.\n\nIf the system does not identify your RTC correctly,\nselect the installed module manually:",
    "AUTO",
    "Use manual selection only if auto-detection is incorrect.\nChanging this setting will restart the device.",
    "Detected: %s",
    "Selected: %s",
    "none",
    "Status: Not found",
    "Status: Battery low",
    "Status: Lost power",
    "Status: Time not set",
    "Status: Time invalid",
    "Status: OK",
    "Status: Restart required to apply changes",
    "STATUS: ",
    "TEMP",
    "HUMIDITY",
    "MSL PRESSURE",
    "WARMUP",
    "RESET VOC",
    "RESTART",
    "RESET",
    "CANCEL",
    "Reset VOC Calibration?",
    "VOC/NOx learning will restart.\nReadings may be unstable for a few hours.",
    "Restart Device?",
    "The device will reboot.\nReadings will pause briefly.",
    "Factory Reset?",
    "This clears Wi-Fi, offsets, themes,\nschedules and VOC state.\nThis cannot be undone.",
    "THEME:",
    "CUSTOM",
    "PRESETS",
    "EXAMPLE:",
    "To configure custom theme:\n- Connect Project Aura to WI-FI first\n- Open {{IP_URL}} in browser \nor scan QR code.\n- Alternative hostname:\n{{LOCAL_URL}}\n- Save by pressing Back",
    "Alternative: use the .local link above.\n{{LOCAL_URL}}",
    "FAN\nCONTROL",
    "Fan Control",
    "AUTO NIGHT MODE",
    "This feature activates \"Night Mode\" colors based on a schedule.\n- Set Start and End times below.\n- Toggle the switch to ON.\n- Manual Night Mode is disabled when Auto Night is ON.",
    "START TIME",
    "END TIME",
    "SCREEN BACKLIGHT",
    "Device monitors air quality while screen is off.\nSensors remain active. Touch to wake.",
    "SCHEDULED SLEEP",
    "WAKE ON ALERT",
    "ON / OFF",
    "POWER SAVING",
    "SLEEP AT",
    "WAKE AT",
    "ALWAYS ON",
    "30 SEC",
    "1 MIN",
    "5 MIN",
    "CO2 Calibration (Fresh Air)",
    "CALIBRATE\nCO2",
    "- ASC (Automatic Self-Calibration): ON by default.\n- Best when CO2 drops close to outdoor levels at least weekly\n(good ventilation / room unoccupied).\n- ASC adjusts slowly over days (not instantly).\n- With ASC ON, manual calibration is usually \nnot needed.",
    "- Power the device from a power bank.\n- Take it outdoors to clean fresh air.\n- Keep it away from people (breath), windows, cars, smoke, vents.\n- Let it run for 10 minutes (minimum 5).\n- Press Calibrate CO2 and keep the device still.\n- Manual calibration is for troubleshooting only.\n- Do not calibrate more than once every 6 months.\n- Calibration uses a 420 ppm reference.\n- Wrong conditions can make readings worse.",
    "START",
    "Confirm CO2 calibration",
    "Make sure the device has been in clean outdoor air for at least 5-10 minutes.\nDo you want to continue?",
    "CO2 calibration in progress\nPlease wait about 10 seconds.\nDo not move the device.",
    "Enabling CO2 ASC...\nPlease wait about 10 seconds.",
    "Disabling CO2 ASC...\nPlease wait about 10 seconds.",
    "TAP TO CONTINUE",
    "BOOT DIAGNOSTICS",
    "System",
    "Sensors",
    "App:",
    "MAC:",
    "Reset:",
    "Heap:",
    "Storage:",
    "I2C:",
    "Touch:",
    "SEN66:",
    "SFA3X:",
    "PCF8523:",
    "Errors detected",
    "SHOW ERRORS",
    "OK (config)",
    "OK (defaults)",
    "RECOVERED",
    "DETECTED",
    "FAIL",
    "STARTING",
    "NOT FOUND",
    "LOST",
    "SET TIME",
    "Absolute humidity very low",
    "Absolute humidity low",
    "Absolute humidity slightly low",
    "Absolute humidity slightly high",
    "Absolute humidity high",
    "Absolute humidity very high",
    "Temperature affects comfort, productivity, and sleep quality. Thresholds based on ASHRAE Standard 55 (thermal comfort) and WHO housing recommendations. Optimal range helps maintain focus and prevents fatigue. Extremes cause discomfort, drowsiness, or difficulty concentrating. Prolonged exposure to poor conditions may affect health.",
    "Excellent: 20-25°C (68-77°F)\nIdeal temperature range for comfort and productivity",
    "Acceptable: 18-20°C or 25-26°C (64-68°F or 77-79°F)\nSlightly outside optimal range, still comfortable",
    "Uncomfortable: 16-18°C or 26-28°C (61-64°F or 79-82°F)\nNoticeable discomfort, reduced productivity",
    "Poor: <16°C or >28°C (<61°F or >82°F)\nSignificant discomfort, take action to adjust",
    "VOC Index measures volatile organic compounds from paints, furniture, cleaning products, and cosmetics. Based on Sensirion SGP algorithm (1-500 scale). Index 100 represents baseline air. Higher values indicate increased VOC concentration. Prolonged exposure may cause headaches, eye irritation, and fatigue. Ventilate when elevated. Blue indicator = sensor warming up.",
    "Excellent: ≤150\nNormal indoor air, no action needed",
    "Acceptable: 151-250\nSlight VOC elevation, consider ventilation",
    "Uncomfortable: 251-350\nNoticeable odors possible, ventilate recommended",
    "Poor: >350\nHeadaches and irritation likely, ventilate immediately",
    "NOx Index measures nitrogen oxides from combustion sources: gas stoves, heaters, vehicles, tobacco smoke. Based on Sensirion SGP algorithm (1-500 scale). Outdoor traffic pollution is a common indoor source. High levels irritate airways and worsen asthma. Use range hood when cooking with gas. Keep windows closed during rush hours. Blue indicator = sensor warming up.",
    "Excellent: ≤50\nClean air, no combustion sources detected",
    "Acceptable: 51-100\nMinor elevation, ensure adequate ventilation",
    "Uncomfortable: 101-200\nNoticeable combustion byproducts, ventilate actively",
    "Poor: >200\nHigh NOx exposure, respiratory irritation likely, identify source",
    "Formaldehyde (HCHO) is a carcinogenic VOC released from pressed wood, furniture, flooring, adhesives, and textiles. Thresholds based on WHO guidelines (~80 µg/m³ ≈ 65 ppb). New furniture and renovations are major sources. Causes eye, nose, and throat irritation. Levels decrease over time as materials off-gas. Ventilate new spaces thoroughly for several weeks.",
    "Excellent: <30 ppb\nSafe level, no irritation expected",
    "Acceptable: 30-60 ppb\nLow exposure, sensitive individuals may notice slight irritation",
    "Uncomfortable: 60-100 ppb\nEye and throat irritation possible, increase ventilation",
    "Poor: >100 ppb\nHealth risk, prolonged exposure harmful, ventilate immediately",
    "AQI is a realtime overall air quality score for this device. It combines particulate, ventilation, and gas signals into one index from 0 to 100, where lower is better. The score reacts mainly to the worst pollution source, then adds smaller penalties from other elevated groups. Use AQI for a quick overview, then check individual sensors to find the main cause.",
    "Excellent: 0-25\nClean overall air, no action needed",
    "Acceptable: 26-50\nMinor air quality degradation, ventilation may help",
    "Uncomfortable: 51-75\nNoticeable pollution load, identify source and improve ventilation",
    "Poor: >75\nHigh pollution level, reduce exposure and act immediately",
    "CO₂ indicates indoor air quality and ventilation effectiveness. Thresholds based on ASHRAE and German Federal Environment Agency (UBA) guidelines. Outdoor air is ~400ppm. Levels above 1000ppm reduce cognitive performance; above 1500ppm cause drowsiness and headaches. Good ventilation keeps CO₂ low for optimal focus and health.",
    "Excellent: <800 ppm\nOptimal air quality for focus and productivity",
    "Acceptable: 800-1000 ppm\nSlight decrease in concentration possible",
    "Uncomfortable: 1000-1500 ppm\nNoticeable fatigue, reduced cognitive performance",
    "Poor: >1500 ppm\nDrowsiness, headaches, difficulty concentrating",
    "PM2.5 are fine particles that penetrate deep into lungs and bloodstream. Thresholds based on US EPA Air Quality Index (AQI) and WHO guidelines. Long-term exposure linked to respiratory and cardiovascular disease. Sources: cooking, candles, outdoor pollution,smoking. Keep indoor levels low through air filtration and ventilation.",
    "Excellent: ≤12 µg/m³\nClean air, no health impact",
    "Acceptable: >12-35 µg/m³\nSensitive individuals may notice mild irritation",
    "Uncomfortable: >35-55 µg/m³\nPossible respiratory discomfort, limit exposure",
    "Poor: >55 µg/m³\nHealth risk, avoid prolonged exposure, improve ventilation",
    "PM4 are respirable particles that deposit deep in the respiratory tract, between PM2.5 and PM10 in size. Thresholds are set between PM2.5 and PM10 guidance for practical indoor risk assessment. Sources include dust, pollen fragments, combustion aerosols, and outdoor pollution. Use filtration and ventilation to keep levels low.",
    "Excellent: ≤25 µg/m³\nClean air, minimal health impact",
    "Acceptable: >25-50 µg/m³\nMild elevation, sensitive individuals may notice irritation",
    "Uncomfortable: >50-75 µg/m³\nRespiratory discomfort possible, reduce exposure",
    "Poor: >75 µg/m³\nHigh exposure risk, improve ventilation and filtration",
    "PM10 are coarse particles including dust, pollen, and mold spores. Thresholds based on US EPA Air Quality Index (AQI). Can irritate eyes, nose, and throat. Less harmful than PM2.5 but still affects respiratory health. Sources: dust, construction, pollen, road particles. Reduce through regular cleaning, air filtration, and keeping windows closed.",
    "Excellent: ≤54 µg/m³\nClean air, no irritation expected",
    "Acceptable: >54-154 µg/m³\nSensitive individuals may experience mild irritation",
    "Uncomfortable: >154-254 µg/m³\nPossible eye and throat irritation, limit exposure",
    "Poor: >254 µg/m³\nRespiratory discomfort likely, avoid prolonged exposure",
    "3-hour pressure change shows immediate weather shifts and sudden impacts on well-being. Rapid drops often precede storms and may trigger acute symptoms in sensitive individuals: migraines, joint pain, dizziness. Useful for short-term planning. If you feel sudden fatigue or headache, check this value - pressure drop may be the cause.",
    "Excellent: <1.0 hPa (<0.03 inHg)\nStable weather, no discomfort expected",
    "Acceptable: 1.0-3.0 hPa (0.03-0.09 inHg)\nWeather shifting, mild fatigue possible",
    "Uncomfortable: 3.0-6.0 hPa (0.09-0.18 inHg)\nFront approaching, headaches and joint pain possible",
    "Poor: >6.0 hPa (>0.18 inHg)\nRapid storm change, migraines and fatigue likely",
    "24-hour pressure change reveals weather trends and prolonged stress on the body. Large swings indicate major fronts or storms passing through. Sensitive individuals may experience sustained fatigue, mood changes, or worsening chronic pain. Use for daily planning and anticipating symptoms over coming hours.",
    "Excellent: <2.0 hPa (<0.06 inHg)\nSettled weather, comfortable for all",
    "Acceptable: 2.0-6.0 hPa (0.06-0.18 inHg)\nWeather changing, mild symptoms possible",
    "Uncomfortable: 6.0-10.0 hPa (0.18-0.30 inHg)\nStorm or front passing, increased discomfort",
    "Poor: >10.0 hPa (>0.30 inHg)\nSevere weather event, strong symptoms likely",
    "Humidity affects respiratory comfort, skin health, and perceived temperature. Thresholds based on ASHRAE Standard 55 and EPA recommendations. Optimal range (40-60%) prevents dry airways and inhibits mold growth. Low humidity causes dry skin, irritation, and static. High humidity promotes mold, dust mites, and discomfort. Balance is key for health and home.",
    "Excellent: 40-60%\nOptimal comfort, healthy for airways and skin",
    "Acceptable: 30-40% or 60-65%\nSlight dryness or humidity, minor discomfort possible",
    "Uncomfortable: 20-30% or 65-70%\nDry skin/irritation or sticky/muggy feeling",
    "Poor: <20% or >70%\nHealth risk: respiratory issues or mold growth likely",
    "Absolute humidity measures actual water vapor mass in air (g/m³), independent of temperature. Unlike relative humidity, it shows true moisture content. Low levels dry out airways and skin. High levels make cooling difficult and promote mold. Useful for ventilation decisions and comparing indoor/outdoor air. Optimal range supports respiratory health and comfort.",
    "Excellent: 7-15 g/m³\nOptimal moisture, comfortable breathing",
    "Acceptable: 5-7 or 15-18 g/m³\nSlightly dry or humid, minor discomfort possible",
    "Uncomfortable: 4-5 or 18-20 g/m³\nNoticeable dryness or mugginess, discomfort likely",
    "Poor: <4 or >20 g/m³\nVery dry or humid, respiratory and skin issues likely",
    "Dew point indicates moisture comfort better than relative humidity. Based on NOAA comfort scale. It shows how muggy or dry the air feels. Low dew point means dry air causing skin and respiratory irritation. High dew point feels sticky and oppressive, making it hard to cool down through sweating. Ideal range provides comfortable breathing and natural cooling.",
    "Excellent: 10-16°C (50-61°F)\nIdeal comfort, pleasant breathing",
    "Acceptable: 8-10°C (46-50°F) or 16-18°C (61-64°F)\nSlightly dry or humid, still comfortable",
    "Uncomfortable: 5-8°C (41-46°F) or 18-21°C (64-70°F)\nDry or muggy, noticeable discomfort",
    "Poor: <5°C (<41°F) or >21°C (>70°F)\nToo dry or oppressive, health discomfort",
    "TEMPERATURE",
    "FORMALDEHYDE",
    "RELATIVE HUMIDITY",
    "ABSOLUTE HUMIDITY",
    "DEW POINT",
    "Mold risk indicates the likelihood of mold growth based on humidity and temperature conditions. High humidity above 70% combined with warm temperatures creates ideal conditions for mold and dust mites. Mold spores cause allergies, respiratory issues, and property damage. Monitor corners, bathrooms, and poorly ventilated areas. Keep humidity below 60% to prevent growth.",
    "Excellent: 0-2\nLow risk, conditions unfavorable for mold",
    "Acceptable: 3-4\nModerate risk, monitor humidity levels",
    "Uncomfortable: 5-7\nHigh risk, reduce humidity and improve ventilation",
    "Poor: 8-10\nCritical risk, mold growth likely, act immediately",
    "MOLD RISK",
    "PM1 are ultrafine particles smaller than 1 micron that penetrate deepest into lungs and enter bloodstream directly. Sources: combustion, vehicle exhaust, tobacco smoke, cooking fumes. Most dangerous particle size due to deep tissue penetration. No official EPA thresholds exist, values derived from PM2.5 guidelines with stricter limits due to increased health impact.",
    "Excellent: <=10 ug/m3\nClean air, no health impact",
    "Acceptable: >10-25 ug/m3\nSensitive individuals may notice mild irritation",
    "Uncomfortable: >25-50 ug/m3\nPossible respiratory discomfort, limit exposure",
    "Poor: >50 ug/m3\nHealth risk, avoid prolonged exposure, improve ventilation",
    "Carbon monoxide (CO) is a colorless, odorless toxic gas from incomplete combustion. Typical sources are gas stoves, heaters, fireplaces, engines, and tobacco smoke. CO reduces oxygen delivery in blood and can become dangerous quickly indoors. Keep combustion devices serviced, ventilate properly, and use a dedicated CO alarm.",
    "Excellent: <9 ppm\nSafe level, normal indoor air",
    "Acceptable: 9-35 ppm\nElevated, ensure ventilation, limit exposure",
    "Uncomfortable: >35-100 ppm\nWarning, headache and fatigue possible",
    "Poor: >100 ppm\nDanger! Evacuate and ventilate immediately",
    "PM0.5 counts ultrafine particles (0.3-0.5 um) that bypass lung defenses and enter the bloodstream. Measured by laser scattering in #/cm3. Main sources: combustion, cooking, 3D printing, candles, vaping. Sensor range: 0-3000 #/cm3. Thresholds account for sensor accuracy (+/-100 #/cm3) and typical urban indoor background levels.",
    "Excellent: <=250 #/cm3\nClean air, ideal for sleep and prolonged occupancy",
    "Acceptable: >250-600 #/cm3\nNormal indoor activity, no action needed",
    "Uncomfortable: >600-1200 #/cm3\nSource detected, ventilate or run air purifier",
    "Poor: >1200 #/cm3\nHigh count, identify source and improve airflow",
    "Installing update...\nDo not power off the device.\nDevice will reboot automatically.",
    "SET ALTITUDE",
    "CLICK TO\nSET\nALTITUDE",
    "MSL Pressure\nSea-level corrected pressure for weather comparison.",
    "Altitude above sea level\nCheck Maps or GPS for altitude",
    "Used only for MSL.\nAbsolute pressure stays unchanged.",
    "ABS Pressure",
    "MSL Pressure",
    "APPLY",
