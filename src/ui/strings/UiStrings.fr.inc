    "---",
    "--",
    "0%",
    "--:--",
    "--.--.----",
    "C",
    "F",
    "ppb",
    "Index",
    "HCHO",
    "AQI",
    "JOURNAL SYSTEME",
    "RETOUR",
    "EFFACER LOG",
    "Aucun avertissement ni erreur a afficher.",
    "Initialisation",
    "Air frais - Tout va bien",
    "Excellent",
    "Bon",
    "Moyen",
    "Mauvais",
    "OFF",
    "ON",
    "OK",
    "ERR",
    "SYNC",
    "CON",
    "UPD",
    "LOW",
    "WRN",
    "Connecté",
    "Mode AP",
    "Erreur",
    "Connexion",
    "Désactivé",
    "Pas de Wi-Fi",
    "Connecté",
    "Erreur",
    "Nouvel essai...",
    "Nouvel essai differe",
    "Connexion...",
    "Attente heure...",
    "ON / OFF",
    "Toutes les 6h",
    "http://192.168.4.1/wifi",
    "http://aura.local/mqtt",
    "http://aura.local/theme",
    "Mode AP:\n1) Connectez votre telephone/PC au reseau AP Aura.\n2) Ouvrez: http://192.168.4.1/dashboard\nConfig Wi-Fi: http://192.168.4.1/wifi",
    "Mode STA (Wi-Fi):\nUtilisez: {{IP_URL}}\nNom d'hote alternatif:\n{{LOCAL_URL}}",
    "Non connecte:\nActivez le mode AP dans les reglages Wi-Fi ou connectez Aura a votre Wi-Fi maison.\nPuis revenez sur cette page.",
    "CO détecté - Vérifiez source et alarme CO",
    "CO élevé - Sortez à l'air frais",
    "CO danger - Sortez maintenant",
    "CO2 très élevé",
    "CO2 élevé",
    "CO2 légèrement élevé",
    "PM2.5 très élevé",
    "PM2.5 élevé",
    "PM2.5 légèrement élevé",
    "PM1 très élevé",
    "PM1 élevé",
    "PM1 légèrement élevé",
    "PM10 très élevé",
    "PM10 élevé",
    "PM10 légèrement élevé",
    "HCHO très élevé",
    "HCHO élevé",
    "HCHO légèrement élevé",
    "Indice VOC très élevé",
    "Indice VOC élevé",
    "Indice VOC légèrement élevé",
    "Indice NOx très élevé",
    "Indice NOx élevé",
    "Indice NOx légèrement élevé",
    "Température très basse",
    "Température basse",
    "Température légèrement basse",
    "Température très haute",
    "Température haute",
    "Température légèrement haute",
    "Air très sec",
    "L'air peut sembler sec",
    "Air très lourd",
    "Air lourd",
    "L'air peut sembler lourd",
    "Humidité très basse",
    "Humidité basse",
    "Humidité légèrement basse",
    "Humidité très élevée",
    "Humidité élevée",
    "Humidité légèrement élevée",
    "RÉGLAGES",
    "RÉGLAGES",
    "RETOUR",
    "CORR. TEMP",
    "CORR. HUM",
    "MODE NUIT",
    "C / F",
    "ÉTAT HEAD",
    "WI-FI",
    "HEURE / DATE",
    "COULEUR THÈME",
    "MQTT",
    "AUTO NUIT",
    "REDÉMARRER",
    "RESET\nUSINE",
    "CO2\nCALIBRATION",
    "INFO",
    "POINTS\nINDICATEURS",
    "ALERTE\nCLIGNOTER",
    "VOC\nRÉAPPRENDRE",
    "ÉCLAIRAGE",
    "RÉGLAGES WI-FI",
    "Statut Wi-Fi:",
    "Pour configurer le Wi-Fi:\n- Appuyez sur ON / OFF\n- Connectez votre téléphone ou PC à \"ProjectAura-Setup\".\n- Ouvrez http://192.168.4.1/wifi ou scannez le QR.\n- Choisissez votre réseau Wi-Fi et entrez le mot de passe.\n",
    "SSID:",
    "IP:",
    "OUBLIER\nWI-FI",
    "RECONNECTER",
    "DÉMARRER AP",
    "RÉGLAGES MQTT",
    "Statut MQTT:",
    "Pour configurer MQTT:\n- Ouvrez {{IP_URL}} dans le navigateur ou scannez le QR.\n- Hote alt.: {{LOCAL_URL}}",
    "IP appareil:",
    "IP broker:",
    "Topic:",
    "RECONNECTER",
    "DATE & HEURE",
    "FUSEAU HORAIRE",
    "SYNC AUTO (NTP)",
    "RÉGLER HEURE",
    "Heures:",
    "Minutes:",
    "RÉGLER DATE",
    "Jour:",
    "Mois:",
    "Année:",
    "HEURE",
    "APPLIQUER",
    "RTC:",
    "WIFI:",
    "NTP:",
    "Si votre RTC est detecte correctement et que l'appareil affiche\nla bonne heure, vous n'avez rien a changer.\n\nLaissez ce reglage sur Auto sauf si la detection RTC est incorrecte.\n\nSi le systeme n'identifie pas correctement votre RTC,\nselectionnez manuellement le module installe :",
    "AUTO",
    "Utilisez la selection manuelle seulement si l'auto-detection est incorrecte.\nModifier ce reglage redemarrera l'appareil.",
    "Detecte : %s",
    "Selectionne : %s",
    "aucun",
    "Statut : Introuvable",
    "Statut : Batterie faible",
    "Statut : Perte d'alimentation",
    "Statut : Heure non reglee",
    "Statut : Heure invalide",
    "Statut : OK",
    "Statut : Redemarrage requis pour appliquer les changements",
    "ÉTAT: ",
    "TEMP",
    "HUMIDITÉ",
    "PRESSION MSL",
    "CHAUFFE",
    "RESET VOC",
    "REDÉMARRER",
    "RESET",
    "ANNULER",
    "Réinitialiser VOC?",
    "L'apprentissage VOC/NOx redémarre.\nMesures instables quelques heures.",
    "Redémarrer l'appareil?",
    "L'appareil va redémarrer.\nMesures en pause brièvement.",
    "Réinit. usine?",
    "Efface Wi-Fi, offsets, thèmes,\nplannings et état VOC.\nAction irréversible.",
    "THÈME:",
    "PERSO",
    "PRÉSETS",
    "EXEMPLE:",
    "Pour configurer le thème personnalisé:\n- Connectez d'abord Project Aura au WI-FI\n- Ouvrez {{IP_URL}} dans le\nnavigateur ou scannez le QR.\n- Nom d'hote alternatif:\n{{LOCAL_URL}}\n- Enregistrez avec Retour",
    "Alternative: utilisez le lien .local ci-dessus.\n{{LOCAL_URL}}",
    "CTRL\nVENTILO",
    "Controle ventilateur",
    "MODE NUIT AUTO",
    "Active les couleurs \"Mode Nuit\" par horaire.\n- Réglez début et fin.\n- Mettez l'interrupteur sur ON.\n- Mode Nuit manuel désactivé\n  quand Auto Nuit est ON.",
    "HEURE DÉBUT",
    "HEURE FIN",
    "ÉCLAIRAGE ÉCRAN",
    "Mesure l'air écran éteint.\nCapteurs actifs. Touchez pour réveiller.",
    "SOMMEIL PROGRAMMÉ",
    "RÉVEIL SUR ALERTE",
    "ON / OFF",
    "ÉCONOMIE ÉNERGIE",
    "DORMIR À",
    "RÉVEIL À",
    "TOUJOURS",
    "30 SEC",
    "1 MIN",
    "5 MIN",
    "Calibrage CO2 (Air frais)",
    "CALIBRER\nCO2",
    "- ASC (Auto Self-Calibration): ON par défaut.\n- Idéal si CO2 baisse proche extérieur chaque semaine\n  (bonne ventilation / pièce vide).\n- ASC ajuste lentement (jours, pas instantané).\n- Avec ASC ON, calibration manuelle\n  généralement inutile.",
    "- Alimentez avec power bank.\n- Sortez à l'air frais.\n- Éloignez de personnes, fenêtres, voitures, fumée, sorties.\n- Laissez 10 min (min 5).\n- Appuyez Calibrer CO2 et ne bougez pas.\n- Calibration manuelle pour dépannage.\n- Pas plus d'une fois / 6 mois.\n- Référence 420 ppm.\n- Mauvaises conditions dégradent les mesures.",
    "DEMARRER",
    "Confirmer calibration CO2",
    "Assurez-vous que l'appareil est reste dans de l'air exterieur propre pendant au moins 5-10 minutes.\nVoulez-vous continuer ?",
    "Calibration CO2 en cours\nVeuillez attendre environ 10 secondes.\nNe deplacez pas l'appareil.",
    "Activation de CO2 ASC...\nVeuillez attendre environ 10 secondes.",
    "Desactivation de CO2 ASC...\nVeuillez attendre environ 10 secondes.",
    "TOUCHEZ POUR CONTINUER",
    "DIAGNOSTIC BOOT",
    "Système",
    "Capteurs",
    "App:",
    "MAC:",
    "Reset:",
    "Heap:",
    "Stockage:",
    "I2C:",
    "Touch:",
    "SEN66:",
    "SFA3X:",
    "PCF8523:",
    "Erreurs détectées",
    "AFFICHER ERREURS",
    "OK (config)",
    "OK (défaut)",
    "RÉTABLI",
    "DÉTECTÉ",
    "ÉCHEC",
    "DÉMARRAGE",
    "NON TROUVÉ",
    "PERDU",
    "REGLER HEURE",
    "Humidité absolue très basse",
    "Humidité absolue basse",
    "Humidité absolue légèrement basse",
    "Humidité absolue légèrement élevée",
    "Humidité absolue élevée",
    "Humidité absolue très élevée",
    "La température affecte le confort, la productivité et le sommeil. Seuils basés sur l'ASHRAE 55 et l'OMS. La plage optimale aide à rester concentré et réduit la fatigue. Les extrêmes causent inconfort, somnolence ou difficulté à se concentrer. Une exposition prolongée peut nuire à la santé.",
    "Excellent: 20-25°C (68-77°F)\nPlage idéale pour confort et productivité",
    "Acceptable: 18-20°C ou 25-26°C (64-68°F ou 77-79°F)\nLégèrement hors optimum, encore confortable",
    "Inconfortable: 16-18°C ou 26-28°C (61-64°F ou 79-82°F)\nInconfort notable, productivité réduite",
    "Mauvais: <16°C ou >28°C (<61°F ou >82°F)\nInconfort important, ajuster rapidement",
    "L'indice VOC mesure les composés volatils des peintures, meubles, produits ménagers et cosmétiques. Basé sur l'algorithme Sensirion SGP (échelle 1-500). L'indice 100 est l'air de référence. Une exposition prolongée peut causer maux de tête, irritation oculaire et fatigue. Aérez si élevé. Indicateur bleu = capteur en chauffe.",
    "Excellent: ≤150\nAir intérieur normal, aucune action",
    "Acceptable: 151-250\nVOC légèrement élevés, pensez à aérer",
    "Inconfortable: 251-350\nOdeurs possibles, aération recommandée",
    "Mauvais: >350\nMaux de tête et irritation probables, aérez vite",
    "L'indice NOx mesure les oxydes d'azote de la combustion: gazinières, chauffages, véhicules, fumée de tabac. Basé sur l'algorithme Sensirion SGP (échelle 1-500). Des niveaux élevés irritent les voies respiratoires et aggravent l'asthme. Utilisez la hotte en cuisinant au gaz. Indicateur bleu = capteur en chauffe.",
    "Excellent: ≤50\nAir propre, pas de sources de combustion",
    "Acceptable: 51-100\nLégère hausse, assurez une bonne ventilation",
    "Inconfortable: 101-200\nSous-produits de combustion notables, aérez activement",
    "Mauvais: >200\nForte exposition NOx, irritation probable, identifiez la source",
    "Le formaldéhyde (HCHO) est un VOC cancérogène libéré par bois aggloméré, meubles, sols, adhésifs et textiles. Seuils basés sur l'OMS (~80 µg/m³ ≈ 65 ppb). Provoque irritation des yeux, du nez et de la gorge. Les niveaux diminuent avec le temps (dégazage). Aérez les nouveaux espaces plusieurs semaines.",
    "Excellent: <30 ppb\nNiveau sûr, aucune irritation attendue",
    "Acceptable: 30-60 ppb\nFaible exposition, sensibles peuvent ressentir une légère irritation",
    "Inconfortable: 60-100 ppb\nIrritation yeux/gorge possible, augmentez la ventilation",
    "Mauvais: >100 ppb\nRisque santé, exposition prolongée nocive, aérez immédiatement",
    "L'AQI est l'indice global temps réel de l'air pour cet appareil. Il combine particules, ventilation et gaz sur une échelle de 0 à 100; plus bas = mieux. Il suit surtout la pire source de pollution puis ajoute de petites pénalités d'autres groupes élevés. Donne une vue rapide; vérifiez les capteurs pour trouver la cause.",
    "Excellent: 0-25\nAir propre, aucune action requise",
    "Acceptable: 26-50\nLégère dégradation, aérer peut aider",
    "Inconfortable: 51-75\nCharge notable, cherchez la cause et aérez",
    "Mauvais: >75\nPollution forte, réduisez l'expo et agissez",
    "Le CO2 indique la qualité de l'air intérieur et l'efficacité de la ventilation. Seuils basés sur l'ASHRAE et l'agence allemande (UBA). L'air extérieur est ~400 ppm. Au-delà de 1000 ppm, les performances cognitives baissent; au-delà de 1500 ppm, somnolence et maux de tête. Une bonne ventilation maintient un CO2 bas pour la concentration et la santé.",
    "Excellent: <800 ppm\nQualité d'air optimale pour concentration et productivité",
    "Acceptable: 800-1000 ppm\nLégère baisse de concentration possible",
    "Inconfortable: 1000-1500 ppm\nFatigue notable, performance cognitive réduite",
    "Mauvais: >1500 ppm\nSomnolence, maux de tête, difficulté à se concentrer",
    "Les PM2.5 sont des particules fines qui pénètrent profondément dans les poumons et le sang. Seuils basés sur l'AQI de l'EPA US et les recommandations de l'OMS. L'exposition à long terme est liée aux maladies respiratoires et cardiovasculaires. Sources: cuisson, bougies, pollution extérieure, fumée. Maintenez des niveaux bas par filtration et ventilation.",
    "Excellent: ≤12 µg/m³\nAir propre, pas d'impact santé",
    "Acceptable: >12-35 µg/m³\nSensibles: légère irritation possible",
    "Inconfortable: >35-55 µg/m³\nGêne respiratoire possible, limitez l'exposition",
    "Mauvais: >55 µg/m³\nRisque santé, évitez l'exposition prolongée",
    "Les PM4 sont des particules respirables entre PM2.5 et PM10. Les seuils sont définis entre les repères PM2.5 et PM10 pour l'évaluation du risque intérieur. Sources: poussière, fragments de pollen, aérosols de combustion et pollution extérieure. Gardez les niveaux bas par filtration et ventilation.",
    "Excellent: ≤25 µg/m³\nAir propre, impact santé minimal",
    "Acceptable: >25-50 µg/m³\nHausse légère, irritation possible chez les sensibles",
    "Inconfortable: >50-75 µg/m³\nGêne respiratoire possible, réduisez l'exposition",
    "Mauvais: >75 µg/m³\nRisque élevé, améliorez ventilation et filtration",
    "Les PM10 sont des particules grossières: poussière, pollen et spores de moisissure. Seuils basés sur l'AQI de l'EPA US. Elles peuvent irriter yeux, nez et gorge. Moins nocives que les PM2.5 mais elles affectent la santé respiratoire. Sources: poussière, chantier, pollen, particules routières. Réduisez par nettoyage régulier, filtration et fenêtres fermées.",
    "Excellent: ≤54 µg/m³\nAir propre, aucune irritation attendue",
    "Acceptable: >54-154 µg/m³\nSensibles: irritation légère possible",
    "Inconfortable: >154-254 µg/m³\nIrritation yeux/gorge possible, limitez l'exposition",
    "Mauvais: >254 µg/m³\nGêne respiratoire probable, évitez l'exposition prolongée",
    "Le changement de pression sur 3 h montre les variations rapides du temps et leurs effets. Les chutes rapides précèdent les orages et peuvent déclencher des symptômes: migraines, douleurs articulaires, vertiges. Utile pour planifier. Si fatigue ou mal de tête soudain, vérifiez cette valeur: la baisse de pression peut en être la cause.",
    "Excellent: <1.0 hPa\nTemps stable, aucune gêne attendue",
    "Acceptable: 1.0-3.0 hPa\nTemps changeant, légère fatigue possible",
    "Inconfortable: 3.0-6.0 hPa\nFront proche, maux de tête/articulations",
    "Mauvais: >6.0 hPa\nChangement rapide, migraines et fatigue probables",
    "Le changement de pression sur 24 h révèle les tendances météo et le stress prolongé sur le corps. De grandes variations indiquent des fronts forts ou des tempêtes. Les personnes sensibles peuvent ressentir une fatigue persistante, des changements d'humeur ou une douleur chronique aggravée. Utile pour planifier la journée et anticiper les symptômes à venir.",
    "Excellent: <2.0 hPa\nTemps stable, confortable pour tous",
    "Acceptable: 2.0-6.0 hPa\nTemps changeant, symptômes légers possibles",
    "Inconfortable: 6.0-10.0 hPa\nOrage ou front, gêne accrue",
    "Mauvais: >10.0 hPa\nÉpisode sévère, symptômes marqués probables",
    "L'humidité influence le confort, la peau et la sensation thermique. Seuils basés sur l'ASHRAE 55 et l'EPA. La plage optimale (40-60 %) évite le dessèchement des voies respiratoires et freine la moisissure. Une faible humidité cause peau sèche, irritation et statique. Une humidité élevée favorise moisissures, acariens et inconfort.",
    "Excellent: 40-60%\nConfort optimal, sain pour voies respiratoires et peau",
    "Acceptable: 30-40% ou 60-65%\nLégère sécheresse ou humidité, gêne mineure possible",
    "Inconfortable: 20-30% ou 65-70%\nPeau sèche/irritation ou sensation collante",
    "Mauvais: <20% ou >70%\nRisque santé: problèmes respiratoires ou moisissures",
    "L'humidité absolue mesure la masse de vapeur d'eau dans l'air (g/m³), indépendante de la température. Contrairement à l'humidité relative, elle montre la teneur réelle. Niveaux faibles dessèchent voies respiratoires et peau. Niveaux élevés rendent le refroidissement difficile et favorisent la moisissure. La plage optimale soutient la santé.",
    "Excellent: 7-15 g/m³\nHumidité optimale, respiration confortable",
    "Acceptable: 5-7 ou 15-18 g/m³\nUn peu sec ou humide, gêne mineure possible",
    "Inconfortable: 4-5 ou 18-20 g/m³\nSécheresse ou moiteur sensible, gêne probable",
    "Mauvais: <4 ou >20 g/m³\nTrès sec ou humide, problèmes respiratoires",
    "Le point de rosée indique mieux le confort que l'humidité relative. Il montre si l'air paraît lourd ou sec. Un point de rosée bas signifie un air sec qui irrite la peau et les voies respiratoires. Un point élevé paraît collant et oppressant, rendant le refroidissement difficile. La plage idéale offre respiration confortable et refroidissement naturel.",
    "Excellent: 10-16°C (50-61°F)\nConfort idéal, respiration agréable",
    "Acceptable: 8-10°C (46-50°F) ou 16-18°C (61-64°F)\nLégèrement sec ou humide, encore confortable",
    "Inconfortable: 5-8°C (41-46°F) ou 18-21°C (64-70°F)\nSec ou lourd, inconfort notable",
    "Mauvais: <5°C (<41°F) ou >21°C (>70°F)\nTrop sec ou oppressant, inconfort pour la santé",
    "TEMPÉRATURE",
    "FORMALDÉHYDE",
    "HUMIDITÉ RELATIVE",
    "HUMIDITÉ ABSOLUE",
    "POINT DE ROSÉE",
    "Le risque de moisissure depend de l humidite et de la temperature. Au-dessus de 70% avec de la chaleur, le risque augmente vite, surtout dans les coins, salles de bain et zones mal ventilees. Gardez l humidite sous 60%.",
    "Excellent: 0-2\nRisque faible, moisissure peu probable",
    "Acceptable: 3-4\nRisque modere, surveiller les niveaux d humidite",
    "Inconfortable: 5-7\nRisque eleve, deshumidifier et mieux ventiler",
    "Mauvais: 8-10\nRisque critique, moisissure tres probable, agir immediatement",
    "RISQUE MOISISSURE",
    "Les PM1 sont des particules ultrafines inferieures a 1 micron, capables de penetrer tres profondement dans les poumons et parfois dans le sang. Sources typiques: combustion, echappement routier, fumee de tabac, cuisson. Il n existe pas de seuil EPA officiel PM1; ces niveaux sont derives de PM2.5 avec des bandes plus strictes.",
    "Excellent: <=10 ug/m3\nAir propre, pas d impact sante attendu",
    "Acceptable: >10-25 ug/m3\nPersonnes sensibles: irritation legere possible",
    "Inconfortable: >25-50 ug/m3\nGene respiratoire possible, limitez l exposition",
    "Mauvais: >50 ug/m3\nRisque sante, evitez l exposition prolongee",
    "Le monoxyde de carbone (CO) est un gaz toxique incolore et inodore issu d une combustion incomplete. Sources courantes: cuisiniere gaz, chauffage, cheminee, moteurs et fumee de tabac. Le CO diminue l apport en oxygene du sang et peut devenir dangereux tres vite en interieur. Entretenez les appareils, ventilez correctement et utilisez un detecteur CO.",
    "Excellent: <9 ppm\nNiveau sur, air interieur normal",
    "Acceptable: 9-35 ppm\nEleve, ventiler et limiter l exposition",
    "Inconfortable: >35-100 ppm\nAlerte, maux de tete et fatigue possibles",
    "Mauvais: >100 ppm\nDanger! Evacuer et ventiler immediatement",
    "PM0.5 compte les particules ultrafines (0.3-0.5 um) qui passent dans le sang. Mesure par diffusion laser en #/cm3. Sources: combustion, cuisson, impression 3D, bougies, vapotage. Plage capteur: 0-3000 #/cm3. Les seuils tiennent compte de la precision (+/-100 #/cm3) et de niveaux urbains typiques.",
    "Excellent: <=250 #/cm3\nAir propre, ideal pour sommeil et long sejour",
    "Acceptable: >250-600 #/cm3\nInterieur normal, pas d'action",
    "Uncomfortable: >600-1200 #/cm3\nSource detectee, aerer ou lancer purificateur",
    "Poor: >1200 #/cm3\nNiveau eleve, trouver la source et aerer mieux",
    "Installation en cours...\nN eteignez pas l appareil.\nL appareil redemarrera automatiquement.",
    "ALTITUDE",
    "TOUCHEZ\nPOUR\nALTITUDE",
    "Pression MSL\nPression corrigee au niveau de la mer pour comparaison meteo.",
    "Altitude au-dessus du niveau de la mer\nVerifier Maps ou GPS pour l'altitude",
    "Utilise seulement pour MSL.\nLa pression absolue reste inchangee.",
    "Pression ABS",
    "Pression MSL",
    "APPLIQUER",
