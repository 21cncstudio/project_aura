    "---",
    "--",
    "0%",
    "--:--",
    "--.--.----",
    "C",
    "F",
    "ppb",
    "Index",
    "HCHO",
    "AQI",
    "REGISTRO DEL SISTEMA",
    "ATRAS",
    "BORRAR LOG",
    "No hay advertencias ni errores para mostrar.",
    "Inicializando",
    "Aire fresco - Todo bien",
    "Excelente",
    "Bueno",
    "Moderado",
    "Malo",
    "OFF",
    "ON",
    "OK",
    "ERR",
    "SYNC",
    "CON",
    "UPD",
    "LOW",
    "WRN",
    "Conectado",
    "Modo AP",
    "Error",
    "Conectando",
    "Desactivado",
    "Sin WiFi",
    "Conectado",
    "Error",
    "Reintentando...",
    "Reintento tardio",
    "Conectando...",
    "Esperando hora...",
    "ON / OFF",
    "Cada 6h",
    "http://192.168.4.1/wifi",
    "http://aura.local/mqtt",
    "http://aura.local/theme",
    "Modo AP:\n1) Conecta tu telefono/PC a la red AP de Aura.\n2) Abre: http://192.168.4.1/dashboard\nConfig Wi-Fi: http://192.168.4.1/wifi",
    "Modo STA (Wi-Fi):\nUsa: {{IP_URL}}\nHostname alternativo:\n{{LOCAL_URL}}",
    "Sin conexion:\nActiva AP en ajustes Wi-Fi o conecta Aura a tu Wi-Fi de casa.\nLuego vuelve a esta pagina.",
    "CO detectado - Revisa fuente y alarma de CO",
    "CO elevado - Sal al aire libre",
    "CO peligro - Sal ahora",
    "CO2 muy alto",
    "CO2 alto",
    "CO2 elevado",
    "PM2.5 muy alto",
    "PM2.5 alto",
    "PM2.5 elevado",
    "PM1 muy alto",
    "PM1 alto",
    "PM1 elevado",
    "PM10 muy alto",
    "PM10 alto",
    "PM10 elevado",
    "HCHO muy alto",
    "HCHO alto",
    "HCHO elevado",
    "Índice VOC muy alto",
    "Índice VOC alto",
    "Índice VOC elevado",
    "Índice NOx muy alto",
    "Índice NOx alto",
    "Índice NOx elevado",
    "Temperatura muy baja",
    "Temperatura baja",
    "Temperatura ligeramente baja",
    "Temperatura muy alta",
    "Temperatura alta",
    "Temperatura ligeramente alta",
    "El aire se siente muy seco",
    "El aire puede sentirse seco",
    "El aire se siente muy bochornoso",
    "El aire se siente bochornoso",
    "El aire puede sentirse bochornoso",
    "Humedad muy baja",
    "Humedad baja",
    "Humedad ligeramente baja",
    "Humedad muy alta",
    "Humedad alta",
    "Humedad ligeramente alta",
    "AJUSTES",
    "AJUSTES",
    "ATRÁS",
    "CORR. TEMP",
    "CORR. HUM",
    "MODO NOCHE",
    "C / F",
    "ESTADO HEAD",
    "WI-FI",
    "HORA / FECHA",
    "COLOR TEMA",
    "MQTT",
    "AUTO NOCHE",
    "REINICIAR",
    "RESET\nFÁBRICA",
    "CO2\nCALIBRACIÓN",
    "INFO",
    "PUNTOS\nINDICADORES",
    "ALERTA\nPARPADEO",
    "VOC\nREAPRENDER",
    "RETROILUM",
    "AJUSTES WI-FI",
    "Estado Wi-Fi:",
    "Para configurar Wi-Fi:\n- Pulsa ON / OFF\n- Conecta tu móvil o PC a \"ProjectAura-Setup\".\n- Abre http://192.168.4.1/wifi o escanea el QR.\n- Elige tu red Wi-Fi y escribe la clave.\n",
    "SSID:",
    "IP:",
    "OLVIDAR\nWI-FI",
    "RECONECTAR",
    "INICIAR AP",
    "AJUSTES MQTT",
    "Estado MQTT:",
    "Para configurar MQTT:\n- Abre {{IP_URL}} en el navegador o escanea el QR.\n- Host alternativo: {{LOCAL_URL}}",
    "IP dispositivo:",
    "IP broker:",
    "Topic:",
    "RECONECTAR",
    "FECHA Y HORA",
    "ZONA HORARIA",
    "AUTO SINCR. (NTP)",
    "AJUSTAR HORA",
    "Horas:",
    "Minutos:",
    "AJUSTAR FECHA",
    "Día:",
    "Mes:",
    "Año:",
    "HORA",
    "APLICAR",
    "RTC:",
    "WIFI:",
    "NTP:",
    "Si el RTC se detecta correctamente y el dispositivo muestra\nla hora correcta, no necesitas cambiar nada.\n\nDeja esta opcion en Auto salvo que la deteccion del RTC sea incorrecta.\n\nSi el sistema no identifica tu RTC correctamente,\nselecciona manualmente el modulo instalado:",
    "AUTO",
    "Usa la seleccion manual solo si la deteccion automatica es incorrecta.\nCambiar esta opcion reiniciara el dispositivo.",
    "Detectado: %s",
    "Seleccionado: %s",
    "ninguno",
    "Estado: No encontrado",
    "Estado: Bateria baja",
    "Estado: Perdida de energia",
    "Estado: Hora no configurada",
    "Estado: Hora invalida",
    "Estado: OK",
    "Estado: Se requiere reinicio para aplicar cambios",
    "ESTADO: ",
    "TEMP",
    "HUMEDAD",
    "PRESION MSL",
    "CALENTANDO",
    "RESET VOC",
    "REINICIAR",
    "RESET",
    "CANCELAR",
    "¿Reiniciar calibración VOC?",
    "El aprendizaje VOC/NOx se reiniciará.\nLas lecturas pueden ser inestables unas horas.",
    "¿Reiniciar dispositivo?",
    "El dispositivo se reiniciará.\nLas lecturas se pausarán brevemente.",
    "¿Restablecer de fábrica?",
    "Esto borra Wi-Fi, offsets, temas,\nhorarios y estado VOC.\nNo se puede deshacer.",
    "TEMA:",
    "PERSONAL",
    "PRESETS",
    "EJEMPLO:",
    "Para configurar tema personalizado:\n- Conecta Project Aura a WI-FI primero\n- Abre {{IP_URL}} en el navegador\no escanea el QR.\n- Hostname alternativo:\n{{LOCAL_URL}}\n- Guarda pulsando Atrás",
    "Alternativa: usa el enlace .local de arriba.\n{{LOCAL_URL}}",
    "CTRL\nVENTIL.",
    "Control ventilador",
    "MODO NOCHE AUTO",
    "Esta función activa \"Modo Noche\" por horario.\n- Ajusta hora inicio y fin.\n- Pon el interruptor en ON.\n- Modo Noche manual se desactiva\n  cuando Auto Noche está ON.",
    "HORA INICIO",
    "HORA FIN",
    "LUZ DE PANTALLA",
    "El dispositivo mide aire con pantalla apagada.\nSensores siguen activos. Toca para despertar.",
    "SUEÑO PROGRAMADO",
    "DESPERTAR POR ALERTA",
    "ON / OFF",
    "AHORRO ENERGÍA",
    "DORMIR A",
    "DESPERTAR A",
    "SIEMPRE",
    "30 SEG",
    "1 MIN",
    "5 MIN",
    "Calibración CO2 (Aire fresco)",
    "CALIBRAR\nCO2",
    "- ASC (Auto Self-Calibration): ON por defecto.\n- Mejor si CO2 baja cerca de exterior cada semana\n  (buena ventilación / sala vacía).\n- ASC ajusta lento (días, no al instante).\n- Con ASC ON normalmente no hace falta\n  calibración manual.",
    "- Alimenta con power bank.\n- Llévalo afuera a aire limpio.\n- Lejos de personas, ventanas, coches, humo, salidas.\n- Déjalo 10 min (mín. 5).\n- Pulsa Calibrar CO2 y no lo muevas.\n- Calibración manual solo para diagnóstico.\n- No más de cada 6 meses.\n- Usa referencia 420 ppm.\n- Malas condiciones empeoran lecturas.",
    "INICIAR",
    "Confirmar calibracion CO2",
    "Asegurese de que el dispositivo haya estado en aire exterior limpio durante al menos 5-10 minutos.\nDesea continuar?",
    "Calibracion de CO2 en curso\nEspere unos 10 segundos.\nNo mueva el dispositivo.",
    "Activando CO2 ASC...\nEspere unos 10 segundos.",
    "Desactivando CO2 ASC...\nEspere unos 10 segundos.",
    "TOCA PARA SEGUIR",
    "DIAGNÓSTICO BOOT",
    "Sistema",
    "Sensores",
    "App:",
    "MAC:",
    "Reset:",
    "Heap:",
    "Almacenamiento:",
    "I2C:",
    "Touch:",
    "SEN66:",
    "SFA3X:",
    "PCF8523:",
    "Errores detectados",
    "MOSTRAR ERRORES",
    "OK (config)",
    "OK (defecto)",
    "RECUPERADO",
    "DETECTADO",
    "FALLO",
    "INICIANDO",
    "NO ENCONTRADO",
    "PERDIDO",
    "AJUSTAR HORA",
    "Humedad absoluta muy baja",
    "Humedad absoluta baja",
    "Humedad absoluta ligeramente baja",
    "Humedad absoluta ligeramente alta",
    "Humedad absoluta alta",
    "Humedad absoluta muy alta",
    "La temperatura afecta la comodidad, la productividad y la calidad del sueño. Umbrales basados en ASHRAE 55 (confort térmico) y recomendaciones de la OMS. El rango óptimo ayuda a mantener la concentración y reduce la fatiga. Los extremos causan malestar, somnolencia o dificultad para concentrarse. La exposición prolongada a malas condiciones puede afectar la salud.",
    "Excelente: 20-25°C (68-77°F)\nRango ideal de temperatura para comodidad y productividad",
    "Aceptable: 18-20°C o 25-26°C (64-68°F o 77-79°F)\nLigeramente fuera del óptimo, aún cómodo",
    "Incómodo: 16-18°C o 26-28°C (61-64°F o 79-82°F)\nMalestar notable, productividad reducida",
    "Malo: <16°C o >28°C (<61°F o >82°F)\nMalestar significativo, ajustar",
    "El índice VOC mide compuestos orgánicos volátiles de pinturas, muebles, limpiadores y cosméticos. Basado en algoritmo Sensirion SGP (escala 1-500). El índice 100 representa el aire base. Valores más altos indican mayor concentración de VOC. La exposición prolongada puede causar dolor de cabeza, irritación ocular y fatiga. Ventile si está elevado. Indicador azul = sensor en calentamiento.",
    "Excelente: ≤150\nAire interior normal, sin acción",
    "Aceptable: 151-250\nVOC ligeramente elevados, considere ventilar",
    "Incómodo: 251-350\nPosibles olores, se recomienda ventilar",
    "Malo: >350\nProbables dolores de cabeza e irritación, ventile de inmediato",
    "El índice NOx mide óxidos de nitrógeno de fuentes de combustión: cocinas de gas, calefactores, vehículos, humo de tabaco. Basado en algoritmo Sensirion SGP (escala 1-500). Niveles altos irritan las vías respiratorias y empeoran el asma. Use la campana al cocinar con gas. Indicador azul = sensor en calentamiento.",
    "Excelente: ≤50\nAire limpio, sin fuentes de combustión",
    "Aceptable: 51-100\nLeve elevación, asegurar ventilación",
    "Incómodo: 101-200\nSubproductos de combustión notorios, ventilar activamente",
    "Malo: >200\nAlta exposición a NOx, irritación respiratoria probable, identifique la fuente",
    "El formaldehído (HCHO) es un VOC cancerígeno liberado por madera prensada, muebles, suelos, adhesivos y textiles. Umbrales basados en las guías de la OMS (~80 µg/m³ ≈ 65 ppb). Los muebles nuevos y las renovaciones son fuentes principales. Causa irritación en ojos, nariz y garganta. Los niveles disminuyen con el tiempo al desgasificarse. Ventile espacios nuevos durante varias semanas.",
    "Excelente: <30 ppb\nNivel seguro, sin irritación esperada",
    "Aceptable: 30-60 ppb\nExposición baja, sensibles pueden notar irritación leve",
    "Incómodo: 60-100 ppb\nPosible irritación de ojos y garganta, aumentar ventilación",
    "Malo: >100 ppb\nRiesgo para la salud, ventile de inmediato",
    "AQI es el índice global en tiempo real de este dispositivo. Combina partículas, ventilación y gases en una escala de 0 a 100; cuanto más bajo, mejor. Responde sobre todo a la peor fuente de contaminación y suma penalizaciones menores de otros grupos altos. Sirve como vista rápida; revise los sensores para hallar la causa.",
    "Excelente: 0-25\nAire limpio, sin acción necesaria",
    "Aceptable: 26-50\nLeve deterioro, ventilar puede ayudar",
    "Incómodo: 51-75\nCarga notable, identifique la causa y ventile",
    "Malo: >75\nContaminación alta, reduzca exposición y actúe ya",
    "El CO2 indica la calidad del aire interior y la eficacia de la ventilación. Umbrales basados en ASHRAE y la agencia ambiental alemana (UBA). El aire exterior es ~400 ppm. Niveles por encima de 1000 ppm reducen el rendimiento cognitivo; por encima de 1500 ppm causan somnolencia y dolor de cabeza. Una buena ventilación mantiene el CO2 bajo para un enfoque y salud óptimos.",
    "Excelente: <800 ppm\nCalidad óptima del aire para concentración y productividad",
    "Aceptable: 800-1000 ppm\nLigera disminución de concentración posible",
    "Incómodo: 1000-1500 ppm\nFatiga notable, rendimiento cognitivo reducido",
    "Malo: >1500 ppm\nSomnolencia, dolor de cabeza, dificultad para concentrarse",
    "PM2.5 son partículas finas que penetran profundamente en pulmones y torrente sanguíneo. Umbrales basados en el US EPA AQI y guías de la OMS. La exposición a largo plazo se asocia con enfermedades respiratorias y cardiovasculares. Fuentes: cocina, velas, contaminación exterior, humo. Mantenga bajos los niveles interiores con filtración y ventilación.",
    "Excelente: ≤12 µg/m³\nAire limpio, sin impacto en la salud",
    "Aceptable: >12-35 µg/m³\nPersonas sensibles pueden notar irritación leve",
    "Incómodo: >35-55 µg/m³\nPosible molestia respiratoria, limite la exposición",
    "Malo: >55 µg/m³\nRiesgo para la salud, evite exposición prolongada",
    "PM4 son partículas respirables entre PM2.5 y PM10. Los umbrales se sitúan entre las guías de PM2.5 y PM10 para evaluar riesgo en interiores. Fuentes: polvo, fragmentos de polen, aerosoles de combustión y contaminación exterior. Mantenga niveles bajos con filtración y ventilación.",
    "Excelente: ≤25 µg/m³\nAire limpio, impacto mínimo en la salud",
    "Aceptable: >25-50 µg/m³\nElevación leve, personas sensibles pueden notar irritación",
    "Incómodo: >50-75 µg/m³\nPosible molestia respiratoria, reduzca la exposición",
    "Malo: >75 µg/m³\nRiesgo alto, mejore ventilación y filtración",
    "PM10 son partículas gruesas como polvo, polen y esporas de moho. Umbrales basados en el US EPA AQI. Pueden irritar ojos, nariz y garganta. Menos dañinas que PM2.5 pero aún afectan la salud respiratoria. Fuentes: polvo, construcción, polen, partículas de carretera. Reduzca con limpieza regular, filtración y ventanas cerradas.",
    "Excelente: ≤54 µg/m³\nAire limpio, sin irritación esperada",
    "Aceptable: >54-154 µg/m³\nLas personas sensibles pueden sentir irritación leve",
    "Incómodo: >154-254 µg/m³\nPosible irritación de ojos y garganta, limite la exposición",
    "Malo: >254 µg/m³\nMolestia respiratoria probable, evite exposición prolongada",
    "El cambio de presión en 3 horas muestra variaciones rápidas del clima y efectos inmediatos en el bienestar. Caídas rápidas suelen preceder tormentas y pueden desencadenar síntomas agudos en personas sensibles: migrañas, dolor articular, mareos. Útil para planificación. Si siente fatiga o dolor de cabeza repentino, revise este valor: la caída de presión puede ser la causa.",
    "Excelente: <1.0 hPa\nTiempo estable, sin molestias esperadas",
    "Aceptable: 1.0-3.0 hPa\nCambio de tiempo, fatiga leve posible",
    "Incómodo: 3.0-6.0 hPa\nFrente cercano, dolor de cabeza y articulaciones",
    "Malo: >6.0 hPa\nCambio rápido de tormenta, migraña y fatiga probables",
    "El cambio de presión en 24 horas revela tendencias del tiempo y estrés prolongado en el cuerpo. Grandes oscilaciones indican frentes fuertes o tormentas. Personas sensibles pueden sentir fatiga sostenida, cambios de ánimo o empeoramiento de dolor crónico. Útil para planificar el día y anticipar síntomas en las próximas horas.",
    "Excelente: <2.0 hPa\nTiempo estable, cómodo para todos",
    "Aceptable: 2.0-6.0 hPa\nEl tiempo cambia, síntomas leves posibles",
    "Incómodo: 6.0-10.0 hPa\nTormenta o frente, mayor malestar",
    "Malo: >10.0 hPa\nEvento severo, síntomas fuertes probables",
    "La humedad afecta el confort respiratorio, la salud de la piel y la sensación térmica. Umbrales basados en ASHRAE 55 y EPA. El rango óptimo (40-60%) evita vías respiratorias secas y frena el moho. La baja humedad causa piel seca, irritación y estática. La alta humedad favorece moho, ácaros y malestar. El equilibrio es clave.",
    "Excelente: 40-60%\nConfort óptimo, saludable para vías respiratorias y piel",
    "Aceptable: 30-40% o 60-65%\nLeve sequedad o humedad, posible molestia menor",
    "Incómodo: 20-30% o 65-70%\nPiel seca/irritación o sensación pegajosa",
    "Malo: <20% o >70%\nRiesgo para la salud: moho y problemas respiratorios",
    "La humedad absoluta mide la masa real de vapor de agua en el aire (g/m³), independiente de la temperatura. A diferencia de la humedad relativa, muestra el contenido real. Niveles bajos resecan vías respiratorias y piel. Niveles altos dificultan el enfriamiento y favorecen el moho. El rango óptimo favorece la salud respiratoria y el confort.",
    "Excelente: 7-15 g/m³\nHumedad óptima, respiración cómoda",
    "Aceptable: 5-7 o 15-18 g/m³\nAlgo seco o húmedo, molestia menor posible",
    "Incómodo: 4-5 o 18-20 g/m³\nSequedad o bochorno perceptible, probable molestia",
    "Malo: <4 o >20 g/m³\nMuy seco o húmedo, problemas respiratorios y de piel",
    "El punto de rocío indica la sensación de humedad mejor que la humedad relativa. Basado en la escala de confort NOAA. Muestra cuán bochornoso o seco se siente el aire. Un punto de rocío bajo significa aire seco que irrita piel y vías respiratorias. Un punto de rocío alto se siente pegajoso y opresivo, dificultando enfriarse al sudar. El rango ideal brinda respiración cómoda y enfriamiento natural.",
    "Excelente: 10-16°C (50-61°F)\nConfort ideal, respiración agradable",
    "Aceptable: 8-10°C (46-50°F) o 16-18°C (61-64°F)\nAlgo seco o húmedo, aún cómodo",
    "Incómodo: 5-8°C (41-46°F) o 18-21°C (64-70°F)\nSeco o bochornoso, malestar notable",
    "Malo: <5°C (<41°F) o >21°C (>70°F)\nDemasiado seco u opresivo, malestar para la salud",
    "TEMPERATURA",
    "FORMALDEHÍDO",
    "HUMEDAD RELATIVA",
    "HUMEDAD ABSOLUTA",
    "PUNTO DE ROCÍO",
    "El riesgo de moho depende de humedad y temperatura. Con mas de 70% de humedad y calor, el riesgo sube rapido, sobre todo en esquinas, banos y zonas con poca ventilacion. Mantenga la humedad por debajo de 60%.",
    "Excelente: 0-2\nRiesgo bajo, moho poco probable",
    "Aceptable: 3-4\nRiesgo moderado, vigilar niveles de humedad",
    "Incomodo: 5-7\nRiesgo alto, deshumidificar y ventilar mejor",
    "Malo: 8-10\nRiesgo critico, moho muy probable, actuar de inmediato",
    "RIESGO DE MOHO",
    "PM1 son particulas ultrafinas menores de 1 micra que penetran muy profundo en pulmones y pueden entrar en sangre. Fuentes tipicas: combustion, escape vehicular, humo de tabaco y cocina. No existen limites EPA oficiales para PM1, por eso los umbrales se derivan de PM2.5 con bandas mas estrictas por mayor impacto en salud.",
    "Excelente: <=10 ug/m3\nAire limpio, sin impacto esperado en salud",
    "Aceptable: >10-25 ug/m3\nPersonas sensibles pueden notar irritacion leve",
    "Incomodo: >25-50 ug/m3\nPosible molestia respiratoria, limite la exposicion",
    "Malo: >50 ug/m3\nRiesgo para la salud, evite exposicion prolongada",
    "El monoxido de carbono (CO) es un gas toxico incoloro e inodoro generado por combustion incompleta. Fuentes comunes: cocina a gas, calentadores, chimeneas, motores y humo de tabaco. El CO reduce el transporte de oxigeno en sangre y puede ser peligroso rapidamente en interiores. Mantenga equipos en buen estado, ventile bien y use un detector de CO.",
    "Excelente: <9 ppm\nNivel seguro, aire interior normal",
    "Aceptable: 9-35 ppm\nElevado, ventilar y limitar exposicion",
    "Incomodo: >35-100 ppm\nAdvertencia, posible dolor de cabeza y fatiga",
    "Malo: >100 ppm\nPeligro! Evacuar y ventilar de inmediato",
    "PM0.5 cuenta particulas ultrafinas (0.3-0.5 um) que pasan al torrente sanguineo. Se mide por dispersion laser en #/cm3. Fuentes: combustion, cocina, impresion 3D, velas y vapeo. Rango del sensor: 0-3000 #/cm3. Los umbrales consideran la precision (+/-100 #/cm3) y niveles urbanos tipicos en interiores.",
    "Excellent: <=250 #/cm3\nAire limpio, ideal para dormir y larga permanencia",
    "Acceptable: >250-600 #/cm3\nInterior normal, sin accion necesaria",
    "Uncomfortable: >600-1200 #/cm3\nFuente detectada, ventila o usa purificador",
    "Poor: >1200 #/cm3\nConteo alto, identifica fuente y mejora el aire",
    "Instalando actualizacion...\nNo apagues el dispositivo.\nEl dispositivo se reiniciara automaticamente.",
    "ALTITUD",
    "PULSE\nPARA\nALTITUD",
    "Presion MSL\nPresion corregida al nivel del mar para comparar el clima.",
    "Altitud sobre el nivel del mar\nConsulte Maps o GPS para la altitud",
    "Solo se usa para MSL.\nLa presion absoluta no cambia.",
    "Presion ABS",
    "Presion MSL",
    "APLICAR",
