    "---",
    "--",
    "0%",
    "--:--",
    "--.--.----",
    "C",
    "F",
    "ppb",
    "Index",
    "HCHO",
    "AQI",
    "LOG DI SISTEMA",
    "INDIETRO",
    "CANCELLA LOG",
    "Nessun avviso o errore da mostrare.",
    "Inizializzazione",
    "Aria fresca - Tutto ok",
    "Eccellente",
    "Buono",
    "Moderato",
    "Scarso",
    "OFF",
    "ON",
    "OK",
    "ERR",
    "SYNC",
    "CON",
    "UPD",
    "LOW",
    "WRN",
    "Connesso",
    "Modalità AP",
    "Errore",
    "Connessione",
    "Disattivato",
    "No Wi-Fi",
    "Connesso",
    "Errore",
    "Riprovo...",
    "Nuovo tentativo ritardato",
    "Connessione...",
    "Attesa ora...",
    "ON / OFF",
    "Ogni 6h",
    "http://192.168.4.1/wifi",
    "http://aura.local/mqtt",
    "http://aura.local/theme",
    "Modalita AP:\n1) Collega telefono/PC alla rete AP Aura.\n2) Apri: http://192.168.4.1/dashboard\nConfig Wi-Fi: http://192.168.4.1/wifi",
    "Modalita STA (Wi-Fi):\nUsa: {{IP_URL}}\nHostname alternativo:\n{{LOCAL_URL}}",
    "Non connesso:\nAttiva la modalita AP nelle impostazioni Wi-Fi oppure collega Aura al Wi-Fi di casa.\nPoi torna a questa pagina.",
    "CO rilevato - Controlla fonte e allarme CO",
    "CO elevato - Vai all'aria aperta",
    "CO pericolo - Esci ora",
    "CO2 molto alto",
    "CO2 alto",
    "CO2 elevato",
    "PM2.5 molto alto",
    "PM2.5 alto",
    "PM2.5 elevato",
    "PM1 molto alto",
    "PM1 alto",
    "PM1 elevato",
    "PM10 molto alto",
    "PM10 alto",
    "PM10 elevato",
    "HCHO molto alto",
    "HCHO alto",
    "HCHO elevato",
    "Indice VOC molto alto",
    "Indice VOC alto",
    "Indice VOC elevato",
    "Indice NOx molto alto",
    "Indice NOx alto",
    "Indice NOx elevato",
    "Temperatura molto bassa",
    "Temperatura bassa",
    "Temperatura leggermente bassa",
    "Temperatura molto alta",
    "Temperatura alta",
    "Temperatura leggermente alta",
    "Aria molto secca",
    "L'aria può sembrare secca",
    "Aria molto afosa",
    "Aria afosa",
    "L'aria può sembrare afosa",
    "Umidità molto bassa",
    "Umidità bassa",
    "Umidità leggermente bassa",
    "Umidità molto alta",
    "Umidità alta",
    "Umidità leggermente alta",
    "IMPOSTAZIONI",
    "IMPOST",
    "INDIETRO",
    "OFFSET TEMP",
    "OFFSET UMID",
    "MODO NOTTE",
    "C / F",
    "STATO HEAD",
    "WI-FI",
    "ORA / DATA",
    "COLORE TEMA",
    "MQTT",
    "AUTO NOTTE",
    "RIAVVIA",
    "RESET\nFABBRICA",
    "CO2\nCALIBRAZIONE",
    "INFO",
    "PUNTI\nINDICATORI",
    "ALLARME\nLAMPEGGIA",
    "VOC\nRIAPPRENDI",
    "RETROILL.",
    "IMPOSTAZIONI WI-FI",
    "Stato Wi-Fi:",
    "Per configurare il Wi-Fi:\n- Premi ON / OFF\n- Connetti telefono o PC a \"ProjectAura-Setup\".\n- Apri http://192.168.4.1/wifi o scansiona QR.\n- Seleziona la rete Wi-Fi e inserisci la password.\n",
    "SSID:",
    "IP:",
    "DIMENTICA\nWI-FI",
    "RICOLLEGA",
    "AVVIA AP",
    "IMPOSTAZIONI MQTT",
    "Stato MQTT:",
    "Per configurare MQTT:\n- Apri {{IP_URL}} nel browser o scansiona il QR.\n- Host alternativo: {{LOCAL_URL}}",
    "IP dispositivo:",
    "IP broker:",
    "Topic:",
    "RICOLLEGA",
    "DATA E ORA",
    "FUSO ORARIO",
    "SYNC AUTO (NTP)",
    "IMPOSTA ORA",
    "Ore:",
    "Minuti:",
    "IMPOSTA DATA",
    "Giorno:",
    "Mese:",
    "Anno:",
    "ORA",
    "APPLICA",
    "RTC:",
    "WIFI:",
    "NTP:",
    "Se il tuo RTC viene rilevato correttamente e il dispositivo mostra\nl'ora corretta, non devi cambiare nulla.\n\nLascia questa impostazione su Auto a meno che il rilevamento RTC sia errato.\n\nSe il sistema non identifica correttamente il tuo RTC,\nseleziona manualmente il modulo installato:",
    "AUTO",
    "Usa la selezione manuale solo se il rilevamento automatico non e corretto.\nLa modifica di questa impostazione riavviera il dispositivo.",
    "Rilevato: %s",
    "Selezionato: %s",
    "nessuno",
    "Stato: Non trovato",
    "Stato: Batteria bassa",
    "Stato: Alimentazione persa",
    "Stato: Ora non impostata",
    "Stato: Ora non valida",
    "Stato: OK",
    "Stato: Riavvio richiesto per applicare le modifiche",
    "STATO: ",
    "TEMP",
    "UMIDITÀ",
    "PRESSIONE MSL",
    "RISCALD.",
    "RESET VOC",
    "RIAVVIA",
    "RESET",
    "ANNULLA",
    "Reset calibrazione VOC?",
    "L'apprendimento VOC/NOx riparte.\nLetture instabili per alcune ore.",
    "Riavvia dispositivo?",
    "Il dispositivo si riavvia.\nLetture in pausa brevemente.",
    "Reset di fabbrica?",
    "Cancella Wi-Fi, offset, temi,\nprogrammi e stato VOC.\nAzione irreversibile.",
    "TEMA:",
    "PERSON.",
    "PRESET",
    "ESEMPIO:",
    "Per configurare il tema personalizzato:\n- Connetti prima Project Aura al WI-FI\n- Apri {{IP_URL}} nel browser\no scansiona il QR.\n- Hostname alternativo:\n{{LOCAL_URL}}\n- Salva con Indietro",
    "Alternativa: usa il link .local sopra.\n{{LOCAL_URL}}",
    "CTRL\nVENTOLA",
    "Controllo ventola",
    "MODO NOTTE AUTO",
    "Attiva colori \"Modo Notte\" a orario.\n- Imposta inizio e fine.\n- Interruttore su ON.\n- Modo Notte manuale disattivato\n  quando Auto Notte è ON.",
    "ORA INIZIO",
    "ORA FINE",
    "RETROILLUMINAZ.",
    "Misura aria a schermo spento.\nSensori attivi. Tocca per svegliare.",
    "SONNO PROGRAM.",
    "RISVEGLIO SU ALLARME",
    "ON / OFF",
    "RISPARMIO",
    "DORMI ALLE",
    "SVEGLIA ALLE",
    "SEMPRE",
    "30 SEC",
    "1 MIN",
    "5 MIN",
    "Calibrazione CO2 (Aria fresca)",
    "CALIBRA\nCO2",
    "- ASC (Auto Self-Calibration): ON per default.\n- Ideale se CO2 scende vicino esterno ogni settimana\n  (buona ventilazione / stanza vuota).\n- ASC regola lentamente (giorni, non istantaneo).\n- Con ASC ON, calibrazione manuale\n  di solito non necessaria.",
    "- Alimenta con power bank.\n- Porta all'aperto in aria pulita.\n- Lontano da persone, finestre, auto, fumo, bocchette.\n- Lascia 10 min (min 5).\n- Premi Calibra CO2 e non muovere.\n- Calibrazione manuale solo diagnostica.\n- Non più di una volta / 6 mesi.\n- Riferimento 420 ppm.\n- Condizioni errate peggiorano letture.",
    "AVVIA",
    "Conferma calibrazione CO2",
    "Assicurati che il dispositivo sia rimasto in aria esterna pulita per almeno 5-10 minuti.\nVuoi continuare?",
    "Calibrazione CO2 in corso\nAttendere circa 10 secondi.\nNon muovere il dispositivo.",
    "Attivazione CO2 ASC...\nAttendere circa 10 secondi.",
    "Disattivazione CO2 ASC...\nAttendere circa 10 secondi.",
    "TOCCA PER CONTINUARE",
    "DIAGNOSTICA BOOT",
    "Sistema",
    "Sensori",
    "App:",
    "MAC:",
    "Reset:",
    "Heap:",
    "Memoria:",
    "I2C:",
    "Touch:",
    "SEN66:",
    "SFA3X:",
    "PCF8523:",
    "Errori rilevati",
    "MOSTRA ERRORI",
    "OK (config)",
    "OK (default)",
    "RECUPERATO",
    "RILEVATO",
    "FALLITO",
    "AVVIO",
    "NON TROVATO",
    "PERSO",
    "IMPOSTA ORA",
    "Umidità assoluta molto bassa",
    "Umidità assoluta bassa",
    "Umidità assoluta leggermente bassa",
    "Umidità assoluta leggermente alta",
    "Umidità assoluta alta",
    "Umidità assoluta molto alta",
    "La temperatura influisce su comfort, produttività e qualità del sonno. Soglie basate su ASHRAE 55 (comfort termico) e raccomandazioni OMS. L'intervallo ottimale aiuta a mantenere la concentrazione e riduce la fatica. Gli estremi causano disagio, sonnolenza o difficoltà di concentrazione. L'esposizione prolungata può influire sulla salute.",
    "Eccellente: 20-25°C (68-77°F)\nIntervallo ideale per comfort e produttività",
    "Accettabile: 18-20°C o 25-26°C (64-68°F o 77-79°F)\nLeggermente fuori dall'ottimo, ancora confortevole",
    "Scomodo: 16-18°C o 26-28°C (61-64°F o 79-82°F)\nDisagio evidente, produttività ridotta",
    "Scarso: <16°C o >28°C (<61°F o >82°F)\nDisagio significativo, intervenire",
    "L'indice VOC misura i composti organici volatili da vernici, mobili, detergenti e cosmetici. Basato sull'algoritmo Sensirion SGP (scala 1-500). Valori più alti indicano maggiore concentrazione di VOC. L'esposizione prolungata può causare mal di testa, irritazione oculare e fatica. Arieggiare se elevato. Indicatore blu = sensore in riscaldamento.",
    "Eccellente: ≤150\nAria interna normale, nessuna azione",
    "Accettabile: 151-250\nVOC leggermente elevati, valutare ventilazione",
    "Scomodo: 251-350\nOdori possibili, ventilazione consigliata",
    "Scarso: >350\nProbabili mal di testa e irritazione, arieggiare subito",
    "L'indice NOx misura gli ossidi di azoto da combustione: fornelli a gas, riscaldatori, veicoli, fumo di tabacco. Basato sull'algoritmo Sensirion SGP (scala 1-500). Livelli alti irritano le vie respiratorie e peggiorano l'asma. Usa la cappa quando cucini a gas. Indicatore blu = sensore in riscaldamento.",
    "Eccellente: ≤50\nAria pulita, nessuna fonte di combustione",
    "Accettabile: 51-100\nLieve aumento, assicurare ventilazione",
    "Scomodo: 101-200\nSottoprodotti di combustione evidenti, ventilare",
    "Scarso: >200\nAlta esposizione NOx, irritazione probabile, identifica la fonte",
    "La formaldeide (HCHO) è un VOC cancerogeno rilasciato da legno pressato, mobili, pavimenti, adesivi e tessuti. Soglie basate sulle linee guida OMS (~80 µg/m³ ≈ 65 ppb). Mobili nuovi e ristrutturazioni sono fonti principali. Causa irritazione a occhi, naso e gola. I livelli diminuiscono nel tempo (degassamento). Arieggiare gli ambienti nuovi per alcune settimane.",
    "Eccellente: <30 ppb\nLivello sicuro, nessuna irritazione attesa",
    "Accettabile: 30-60 ppb\nBassa esposizione, i sensibili possono avvertire lieve irritazione",
    "Scomodo: 60-100 ppb\nPossibile irritazione occhi/gola, aumentare ventilazione",
    "Scarso: >100 ppb\nRischio salute, esposizione prolungata nociva",
    "AQI è l'indice globale in tempo reale della qualità dell'aria del dispositivo. Combina particolato, ventilazione e gas in una scala 0-100; più basso è meglio. Reagisce soprattutto alla fonte peggiore e aggiunge piccole penalità da altri gruppi elevati. Utile come vista rapida; controlla i sensori per trovare la causa.",
    "Ottimo: 0-25\nAria pulita, nessuna azione necessaria",
    "Accettabile: 26-50\nLieve degrado, ventilare può aiutare",
    "Scomodo: 51-75\nCarico evidente, cerca la causa e ventila",
    "Scarso: >75\nInquinamento alto, riduci esposizione e agisci subito",
    "La CO2 indica la qualità dell'aria interna e l'efficacia della ventilazione. Soglie basate su ASHRAE e UBA. L'aria esterna è ~400 ppm. Sopra 1000 ppm calano le prestazioni cognitive; sopra 1500 ppm causano sonnolenza e mal di testa. Una buona ventilazione mantiene la CO2 bassa per concentrazione e salute.",
    "Eccellente: <800 ppm\nQualità ottimale per concentrazione e produttività",
    "Accettabile: 800-1000 ppm\nPossibile lieve calo di concentrazione",
    "Scomodo: 1000-1500 ppm\nFatica evidente, prestazioni cognitive ridotte",
    "Scarso: >1500 ppm\nSonnolenza, mal di testa, difficoltà di concentrazione",
    "Le PM2.5 sono particelle fini che penetrano in profondità nei polmoni e nel sangue. Soglie basate su AQI EPA e OMS. L'esposizione a lungo termine è legata a malattie respiratorie e cardiovascolari. Fonti: cucina, candele, inquinamento esterno, fumo. Mantieni bassi i livelli indoor con filtrazione e ventilazione.",
    "Eccellente: ≤12 µg/m³\nAria pulita, nessun impatto sulla salute",
    "Accettabile: >12-35 µg/m³\nI sensibili possono avvertire lieve irritazione",
    "Scomodo: >35-55 µg/m³\nPossibile fastidio respiratorio, limitare esposizione",
    "Scarso: >55 µg/m³\nRischio salute, evita esposizione prolungata",
    "Le PM4 sono particelle respirabili tra PM2.5 e PM10. Le soglie sono impostate tra i riferimenti PM2.5 e PM10 per valutare il rischio indoor. Fonti: polvere, frammenti di polline, aerosol da combustione e inquinamento esterno. Mantieni bassi i livelli con filtrazione e ventilazione.",
    "Eccellente: ≤25 µg/m³\nAria pulita, impatto minimo sulla salute",
    "Accettabile: >25-50 µg/m³\nAumento lieve, i sensibili possono avvertire irritazione",
    "Scomodo: >50-75 µg/m³\nPossibile fastidio respiratorio, ridurre esposizione",
    "Scarso: >75 µg/m³\nRischio elevato, migliorare ventilazione e filtrazione",
    "Le PM10 sono particelle grossolane: polvere, polline e spore di muffa. Soglie basate su AQI EPA. Possono irritare occhi, naso e gola. Meno dannose delle PM2.5 ma incidono sulla salute respiratoria. Fonti: polvere, lavori, polline, particelle stradali. Riduci con pulizia regolare, filtrazione e finestre chiuse.",
    "Eccellente: ≤54 µg/m³\nAria pulita, nessuna irritazione attesa",
    "Accettabile: >54-154 µg/m³\nI sensibili possono avvertire lieve irritazione",
    "Scomodo: >154-254 µg/m³\nPossibile irritazione occhi/gola, limitare esposizione",
    "Scarso: >254 µg/m³\nProbabile fastidio respiratorio, evitare esposizione prolungata",
    "Il cambio di pressione in 3 ore mostra variazioni rapide del tempo e effetti sul benessere. I cali precedono i temporali e possono scatenare sintomi acuti nei sensibili: emicrania, dolori articolari, vertigini. Utile per la pianificazione a breve. Se senti stanchezza o mal di testa improvviso, controlla questo valore: il calo di pressione può esserne la causa.",
    "Eccellente: <1.0 hPa\nTempo stabile, nessun disagio atteso",
    "Accettabile: 1.0-3.0 hPa\nTempo in cambiamento, possibile lieve fatica",
    "Scomodo: 3.0-6.0 hPa\nFronte in arrivo, possibili mal di testa e dolori articolari",
    "Scarso: >6.0 hPa\nCambiamento rapido, probabili emicrania e fatica",
    "Il cambio di pressione in 24 ore mostra tendenze meteo e stress prolungato sul corpo. Grandi oscillazioni indicano fronti forti o tempeste. I sensibili possono avvertire fatica persistente, cambi d'umore o peggioramento del dolore cronico. Utile per pianificare la giornata e prevedere i sintomi nelle ore successive.",
    "Eccellente: <2.0 hPa\nTempo stabile, confortevole per tutti",
    "Accettabile: 2.0-6.0 hPa\nTempo in cambiamento, possibili sintomi lievi",
    "Scomodo: 6.0-10.0 hPa\nPassaggio di fronte/temporale, maggior disagio",
    "Scarso: >10.0 hPa\nEvento severo, sintomi forti probabili",
    "L'umidità influisce sul comfort respiratorio, sulla pelle e sulla temperatura percepita. Soglie basate su ASHRAE 55 ed EPA. L'intervallo ottimale (40-60%) evita vie respiratorie secche e limita la muffa. Umidità bassa causa pelle secca, irritazione e staticità. Umidità alta favorisce muffa, acari e disagio. L'equilibrio è fondamentale.",
    "Eccellente: 40-60%\nComfort ottimale, sano per vie respiratorie e pelle",
    "Accettabile: 30-40% o 60-65%\nLeggera secchezza o umidità, possibile lieve disagio",
    "Scomodo: 20-30% o 65-70%\nPelle secca/irritazione o sensazione appiccicosa",
    "Scarso: <20% o >70%\nRischio salute: problemi respiratori o muffa",
    "L'umidità assoluta misura la massa reale di vapore acqueo nell'aria (g/m³), indipendente dalla temperatura. Livelli bassi seccano vie respiratorie e pelle. Livelli alti rendono difficile raffreddarsi e favoriscono la muffa. Utile per decidere la ventilazione e confrontare aria interna/esterna. L'intervallo ottimale sostiene salute respiratoria e comfort.",
    "Eccellente: 7-15 g/m³\nUmidità ottimale, respirazione confortevole",
    "Accettabile: 5-7 o 15-18 g/m³\nUn po' secco o umido, possibile lieve disagio",
    "Scomodo: 4-5 o 18-20 g/m³\nSecchezza o afa evidente, disagio probabile",
    "Scarso: <4 o >20 g/m³\nMolto secco o umido, problemi respiratori",
    "Il punto di rugiada indica il comfort di umidità meglio dell'umidità relativa. Mostra quanto l'aria appare afosa o secca. Un punto basso significa aria secca che irrita pelle e vie respiratorie. Un punto alto è appiccicoso e opprimente, rendendo difficile raffreddarsi sudando. L'intervallo ideale offre respirazione confortevole e raffreddamento naturale.",
    "Eccellente: 10-16°C (50-61°F)\nComfort ideale, respirazione piacevole",
    "Accettabile: 8-10°C (46-50°F) o 16-18°C (61-64°F)\nLeggermente secco o umido, ancora confortevole",
    "Scomodo: 5-8°C (41-46°F) o 18-21°C (64-70°F)\nSecco o afoso, disagio evidente",
    "Scarso: <5°C (<41°F) o >21°C (>70°F)\nTroppo secco o opprimente, disagio per la salute",
    "TEMPERATURA",
    "FORMALDEIDE",
    "UMIDITÀ RELATIVA",
    "UMIDITÀ ASSOLUTA",
    "PUNTO DI RUGIADA",
    "Il rischio muffa indica la probabilita di crescita in base alle condizioni di umidita e temperatura. Umidita elevata oltre 70% combinata con temperature calde crea condizioni ideali per muffa e acari. Le spore di muffa causano allergie, problemi respiratori e danni alla casa. Controlla angoli, bagni e aree poco ventilate. Mantieni l umidita sotto 60% per prevenire la crescita.",
    "Eccellente: 0-2\nRischio basso, muffa improbabile",
    "Accettabile: 3-4\nRischio moderato, monitorare i livelli di umidita",
    "Scomodo: 5-7\nRischio alto, deumidificare e ventilare meglio",
    "Scarso: 8-10\nRischio critico, muffa molto probabile, agire subito",
    "RISCHIO MUFFA",
    "Le PM1 sono particelle ultrafini sotto 1 micron che penetrano piu in profondita nei polmoni e possono entrare nel sangue. Fonti tipiche: combustione, traffico, fumo di tabacco e cottura. Non esistono limiti EPA ufficiali per PM1; queste soglie derivano da PM2.5 con fasce piu severe.",
    "Eccellente: <=10 ug/m3\nAria pulita, nessun impatto salute atteso",
    "Accettabile: >10-25 ug/m3\nI soggetti sensibili possono notare lieve irritazione",
    "Scomodo: >25-50 ug/m3\nPossibile fastidio respiratorio, limitare esposizione",
    "Scarso: >50 ug/m3\nRischio salute, evitare esposizione prolungata",
    "Il monossido di carbonio (CO) e un gas tossico incolore e inodore prodotto da combustione incompleta. Fonti comuni: fornelli a gas, stufe, camini, motori e fumo di tabacco. Il CO riduce il trasporto di ossigeno nel sangue e puo diventare pericoloso rapidamente in ambienti chiusi. Manutenere gli apparecchi, ventilare bene e usare un rilevatore CO.",
    "Eccellente: <9 ppm\nLivello sicuro, aria interna normale",
    "Accettabile: 9-35 ppm\nElevato, ventilare e limitare esposizione",
    "Scomodo: >35-100 ppm\nAvviso, possibili mal di testa e stanchezza",
    "Scarso: >100 ppm\nPericolo! Evacuare e ventilare subito",
    "PM0.5 conta particelle ultrafini (0.3-0.5 um) che passano nel sangue. Misura tramite diffusione laser in #/cm3. Fonti: combustione, cucina, stampa 3D, candele, vaping. Range sensore: 0-3000 #/cm3. Le soglie considerano precisione del sensore (+/-100 #/cm3) e livelli urbani indoor tipici.",
    "Excellent: <=250 #/cm3\nAria pulita, ideale per sonno e soggiorno lungo",
    "Acceptable: >250-600 #/cm3\nIndoor normale, nessuna azione",
    "Uncomfortable: >600-1200 #/cm3\nSorgente rilevata, ventila o usa purificatore",
    "Poor: >1200 #/cm3\nConteggio alto, trova sorgente e migliora aria",
    "Installazione in corso...\nNon spegnere il dispositivo.\nIl dispositivo si riavviera automaticamente.",
    "ALTITUD.",
    "TOCCA\nPER\nALTIT.",
    "Pressione MSL\nPressione corretta al livello del mare per confronto meteo.",
    "Altitudine sul livello del mare\nControlla Maps o GPS per l'altitudine",
    "Usato solo per MSL.\nLa pressione assoluta non cambia.",
    "Pressione ABS",
    "Pressione MSL",
    "APPLICA",
