    "---",
    "--",
    "0%",
    "--:--",
    "--.--.----",
    "C",
    "F",
    "ppb",
    "指数",
    "HCHO",
    "AQI",
    "系统日志",
    "返回",
    "清除日志",
    "没有可显示的警告或错误。",
    "初始化中",
    "空气清新 - 一切正常",
    "优秀",
    "良好",
    "一般",
    "较差",
    "关",
    "开",
    "OK",
    "错误",
    "同步",
    "CON",
    "UPD",
    "LOW",
    "WRN",
    "已连接",
    "AP模式",
    "错误",
    "连接中",
    "已禁用",
    "无Wi-Fi",
    "已连接",
    "错误",
    "正在重试...",
    "延迟重试",
    "连接中...",
    "等待时间...",
    "开 / 关",
    "每6小时",
    "http://192.168.4.1/wifi",
    "http://aura.local/mqtt",
    "http://aura.local/theme",
    "AP模式:\n1) 将手机/PC连接到 Aura AP 网络。\n2) 打开: http://192.168.4.1/dashboard\nWi-Fi设置: http://192.168.4.1/wifi",
    "STA模式 (Wi-Fi):\n使用: {{IP_URL}}\n备用主机名:\n{{LOCAL_URL}}",
    "未连接:\n请在Wi-Fi设置中启用AP模式，或将Aura连接到家庭Wi-Fi。\n请返回。",
    "检测到 CO - 检查来源和 CO 报警器",
    "CO 升高 - 移到新鲜空气处",
    "CO 极高 - 立即离开",
    "CO2 很高",
    "CO2 高",
    "CO2 偏高",
    "PM2.5 很高",
    "PM2.5 高",
    "PM2.5 偏高",
    "PM1 很高",
    "PM1 高",
    "PM1 偏高",
    "PM10 很高",
    "PM10 高",
    "PM10 偏高",
    "HCHO 很高",
    "HCHO 高",
    "HCHO 偏高",
    "VOC 指数很高",
    "VOC 指数高",
    "VOC 指数偏高",
    "NOx 指数很高",
    "NOx 指数高",
    "NOx 指数偏高",
    "温度很低",
    "温度低",
    "温度略低",
    "温度很高",
    "温度高",
    "温度略高",
    "空气非常干燥",
    "空气可能干燥",
    "空气非常闷热",
    "空气闷热",
    "空气可能闷热",
    "湿度很低",
    "湿度低",
    "湿度略低",
    "湿度很高",
    "湿度高",
    "湿度略高",
    "设置",
    "设置",
    "保存并返回",
    "温度偏移",
    "湿度偏移",
    "夜间模式",
    "C / F",
    "探头状态",
    "Wi-Fi",
    "时间/日期",
    "主题颜色",
    "MQTT",
    "自动夜间",
    "重启",
    "恢复\n出厂",
    "CO2\n校准",
    "关于",
    "指示\n灯",
    "警报\n闪烁",
    "VOC\n重新学习",
    "背光",
    "Wi-Fi 设置",
    "Wi-Fi 状态:",
    "配置 Wi-Fi:\n- 按下 开/关\n- 用手机或电脑连接 \"ProjectAura-Setup\".\n- 打开 http://192.168.4.1/wifi 或扫描二维码.\n- 选择家庭 Wi-Fi 并输入密码.\n",
    "SSID:",
    "IP:",
    "忘记\nWI-FI",
    "重新连接",
    "启动AP",
    "MQTT 设置",
    "MQTT 状态:",
    "配置 MQTT:\n- 在浏览器打开 {{IP_URL}} 或扫描二维码.\n- 备用主机: {{LOCAL_URL}}",
    "设备 IP:",
    "Broker IP:",
    "Topic:",
    "重新连接",
    "日期和时间",
    "时区",
    "自动同步 (NTP)",
    "设置时间",
    "小时:",
    "分钟:",
    "设置日期",
    "日:",
    "月:",
    "年:",
    "时间",
    "立即应用",
    "RTC:",
    "WIFI:",
    "NTP:",
    "如果RTC识别正确，且设备显示的时间正确，\n则无需进行任何更改。\n\n除非RTC自动识别错误，否则请保持为Auto。\n\n如果系统无法正确识别你的RTC，\n请手动选择已安装的模块：",
    "AUTO",
    "仅当自动识别错误时才使用手动选择。\n更改此设置后设备将重启。",
    "已检测到：%s",
    "已选择：%s",
    "无",
    "状态：未找到",
    "状态：电池电量低",
    "状态：掉电",
    "状态：时间未设置",
    "状态：时间无效",
    "状态：OK",
    "状态：需要重启以应用更改",
    "状态: ",
    "温度",
    "湿度",
    "MSL 气压",
    "预热",
    "重置 VOC",
    "重启",
    "重置",
    "取消",
    "重置 VOC 校准?",
    "VOC/NOx 学习将重启.\n读数可能会不稳定数小时.",
    "重启设备?",
    "设备将重启.\n读数会短暂停止.",
    "恢复出厂设置?",
    "将清除 Wi-Fi、偏移、主题、\n计划和 VOC 状态.\n此操作不可恢复.",
    "主题:",
    "自定义",
    "预设",
    "示例:",
    "配置自定义主题:\n- 先将 Project Aura 连接到 WI-FI\n- 在浏览器打开 {{IP_URL}}\n或扫描二维码.\n- 备用主机名:\n{{LOCAL_URL}}\n- 按 返回 保存",
    "备选: 使用上方的 .local 链接.\n{{LOCAL_URL}}",
    "风量\n控制",
    "风量控制",
    "自动夜间模式",
    "此功能按时间表启用\"夜间模式\".\n- 设置开始和结束时间\n- 将开关置为开\n- 自动夜间开启时\n  手动夜间将禁用",
    "开始时间",
    "结束时间",
    "屏幕背光",
    "屏幕关闭时仍监测空气质量.\n传感器保持工作, 触摸唤醒.",
    "定时休眠",
    "报警唤醒",
    "开 / 关",
    "省电",
    "休眠于",
    "唤醒于",
    "常亮",
    "30 秒",
    "1 分",
    "5 分",
    "CO2 校准(新鲜空气)",
    "校准\nCO2",
    "- ASC (自动自校准): 默认开启.\n- 适合每周至少一次 CO2 降至室外水平\n  (通风良好/房间无人).\n- ASC 调整缓慢(按天, 非即时).\n- 开启 ASC 时通常不需要\n  手动校准.",
    "- 使用移动电源供电.\n- 带到室外新鲜空气处.\n- 远离人(呼吸)、窗户、汽车、烟雾、出风口.\n- 运行 10 分钟(至少 5 分钟).\n- 按 校准 CO2 并保持静止.\n- 手动校准仅用于排查问题.\n- 6 个月最多一次.\n- 校准使用 420 ppm 参考.\n- 条件不当会使读数变差.",
    "继续",
    "确认 CO2 校准",
    "请确认设备已在室外新鲜空气中运行至少 5-10 分钟.\n是否继续?",
    "CO2 校准进行中\n请等待约 10 秒.\n请勿移动设备.",
    "正在启用 CO2 ASC...\n请等待约 10 秒.",
    "正在禁用 CO2 ASC...\n请等待约 10 秒.",
    "点击继续",
    "启动诊断",
    "系统",
    "传感器",
    "应用:",
    "MAC:",
    "重置:",
    "堆:",
    "存储:",
    "I2C:",
    "触控:",
    "SEN66:",
    "SFA3X:",
    "PCF8523:",
    "检测到错误",
    "显示错误",
    "OK (配置)",
    "OK (默认)",
    "已恢复",
    "已检测",
    "失败",
    "启动中",
    "未找到",
    "丢失",
    "设置时间",
    "绝对湿度很低",
    "绝对湿度低",
    "绝对湿度略低",
    "绝对湿度略高",
    "绝对湿度高",
    "绝对湿度很高",
    "温度影响舒适、工作效率和睡眠质量。阈值参考ASHRAE 55热舒适标准和WHO住房建议。适宜范围有助于保持专注并减少疲劳。过冷或过热会导致不适、嗜睡或注意力下降。长期处于不良温度可能影响健康。",
    "优秀: 20-25°C (68-77°F)\n理想范围，舒适高效",
    "良好: 18-20°C 或 25-26°C (64-68°F / 77-79°F)\n略偏离，仍可接受",
    "不适: 16-18°C 或 26-28°C (61-64°F / 79-82°F)\n明显不适，效率下降",
    "较差: <16°C 或 >28°C (<61°F / >82°F)\n显著不适，需要调整",
    "VOC 指数反映空气中挥发性有机物(涂料、家具、清洁用品、化妆品)。基于 Sensirion SGP 算法(1-500)。100 为基线空气，数值越高表示 VOC 越多。长期暴露可致头痛、眼鼻刺激和疲劳。升高时通风。蓝色指示=传感器预热。",
    "优秀: ≤150\n室内空气正常",
    "良好: 151-250\n轻度升高，建议通风",
    "不适: 251-350\n可能有异味，需通风",
    "较差: >350\n头痛刺激，立即通风",
    "NOx 指数反映燃烧产生的氮氧化物(燃气灶、炉具、车辆、烟雾)。基于 Sensirion SGP 算法(1-500)。室外交通污染常影响室内。高值会刺激呼吸道、加重哮喘。升高时通风，做饭用油烟机。蓝色指示=传感器预热。",
    "优秀: ≤50\n空气很干净",
    "良好: 51-100\n轻度升高，注意通风",
    "不适: 101-200\n燃烧副产物明显，需通风",
    "较差: >200\n刺激呼吸道，尽快通风",
    "甲醛(HCHO)来自家具、人造板、地板、胶黏剂和纺织品。阈值参考WHO(~80 µg/m³≈65 ppb)。新家具和装修是主要来源，会刺激眼鼻喉。材料会缓慢释放，需持续通风。",
    "优秀: <30 ppb\n安全水平",
    "良好: 30-60 ppb\n低暴露，敏感人群可能不适",
    "不适: 60-100 ppb\n刺激可能，需通风",
    "较差: >100 ppb\n健康风险，立即通风",
    "AQI是本设备的实时空气质量总分。它把颗粒物、通风和气体信号合成0到100的指数，越低越好。分数主要跟随最差污染源，再叠加其他偏高组的小惩罚。AQI适合快速总览，具体原因请查看各传感器。",
    "优秀: 0-25\n空气整体良好，无需处理",
    "良好: 26-50\n轻度变差，通风会有帮助",
    "不适: 51-75\n污染明显，查找来源并通风",
    "较差: >75\n污染高，减少暴露并立即处理",
    "CO₂反映室内空气质量和通风效果。阈值参考ASHRAE与德国UBA。室外约400 ppm。>1000 ppm会降低注意力，>1500 ppm易困倦头痛。良好通风可保持低CO₂。",
    "优秀: <800 ppm\n空气好，专注度高",
    "良好: 800-1000 ppm\n稍高，建议通风",
    "不适: 1000-1500 ppm\n疲劳和困倦可能出现",
    "较差: >1500 ppm\n头痛、注意力下降",
    "PM2.5 细颗粒可深入肺部和血液。阈值参考EPA AQI与WHO。长期暴露与呼吸和心血管疾病相关。来源包括烹饪、蜡烛、室外污染、吸烟。建议过滤和通风。",
    "优秀: ≤12 µg/m³\n空气清新",
    "良好: 12-35 µg/m³\n轻度升高，注意过滤",
    "不适: 35-55 µg/m³\n可能刺激呼吸",
    "较差: >55 µg/m³\n健康风险，减少暴露",
    "PM4 为可吸入颗粒，在 PM2.5 与 PM10 中间。阈值参考EPA AQI，并在 PM2.5 与 PM10 中间设置。高值会刺激眼鼻喉并影响呼吸。来源包括灰尘、花粉、室外污染和燃烧。建议过滤和通风。",
    "优秀: ≤25 µg/m³\n空气良好",
    "良好: 25-50 µg/m³\n轻度升高，建议通风",
    "不适: 50-75 µg/m³\n可能刺激呼吸，减少暴露",
    "较差: >75 µg/m³\n污染偏高，尽快处理",
    "PM10 为较大颗粒(灰尘、花粉、道路尘)。阈值参考EPA AQI。高值会刺激眼鼻喉并影响呼吸。来源包括尘土、施工和室外污染。建议清扫和通风。",
    "优秀: ≤54 µg/m³\n空气良好",
    "良好: 54-154 µg/m³\n有些尘，敏感人群注意",
    "不适: 154-254 µg/m³\n刺激可能，减少暴露",
    "较差: >254 µg/m³\n污染高，尽量室内",
    "3小时气压变化反映短期天气。快速下降多预示风暴，快速上升表示转晴。用下方数值判断变化速度。",
    "优秀: <1 hPa\n气压稳定",
    "良好: 1-3 hPa\n变化轻微",
    "不适: 3-6 hPa\n变化明显",
    "较差: >6 hPa\n变化剧烈，天气转变",
    "24小时气压变化反映日内趋势。大幅波动表示天气不稳，稳定则较平稳。用下方数值判断强度。",
    "优秀: <2 hPa\n天气稳定",
    "良好: 2-6 hPa\n变化较小",
    "不适: 6-10 hPa\n变化较大",
    "较差: >10 hPa\n大幅变化，风暴可能",
    "相对湿度影响呼吸舒适、皮肤与体感温度。阈值参考ASHRAE 55和EPA。最佳范围40-60%可减少干燥并抑制霉菌。过低会干燥、静电，过高会促进霉菌和尘螨。保持平衡更健康。",
    "优秀: 40-60%\n舒适健康",
    "良好: 30-40% 或 60-65%\n略干或略湿",
    "不适: 20-30% 或 65-70%\n干燥或闷",
    "较差: <20% 或 >70%\n霉菌风险高",
    "绝对湿度表示空气中水汽质量(g/m³)，不受温度影响。低值会使空气干燥并刺激呼吸道和皮肤；高值会闷热并促进霉菌。用于通风决策和室内外比较。",
    "优秀: 7-15 g/m³\n舒适范围",
    "良好: 5-7 或 15-18 g/m³\n略干或略湿",
    "不适: 4-5 或 18-20 g/m³\n明显干燥或闷",
    "较差: <4 或 >20 g/m³\n过干或过闷",
    "露点比相对湿度更能反映湿闷感，参考NOAA舒适度。露点低表示干燥，皮肤和呼吸道易不适；露点高则闷热黏腻，散热困难。适宜范围更舒适。",
    "优秀: 10-16°C (50-61°F)\n舒适",
    "良好: 8-10°C 或 16-18°C\n略干或略闷",
    "不适: 5-8°C 或 18-21°C\n干燥或闷热",
    "较差: <5°C 或 >21°C\n过干或过闷",
    "温度",
    "甲醛",
    "相对湿度",
    "绝对湿度",
    "露点",
    "霉菌风险表示在当前湿度和温度条件下霉菌生长的可能性。湿度高于70%且温度偏高时，最容易滋生霉菌和尘螨。霉菌孢子可能引发过敏、呼吸道问题和财产损害。请重点关注墙角、浴室和通风不良区域。将湿度保持在60%以下可预防生长。",
    "优秀: 0-2\n风险低，不利于霉菌生长",
    "可接受: 3-4\n中等风险，建议持续关注湿度",
    "不适: 5-7\n高风险，建议除湿并加强通风",
    "较差: 8-10\n严重风险，霉菌很可能生长，请立即处理",
    "霉菌风险",
    "PM1 是小于 1 微米的超细颗粒，可最深入肺部并进入血液。常见来源包括燃烧、交通尾气、烟草烟雾和烹饪油烟。由于暂无官方 EPA PM1 阈值，这里基于 PM2.5 指南并采用更严格区间，以反映更高的健康风险。",
    "优秀: <=10 ug/m3\n空气清洁，预计无健康影响",
    "可接受: >10-25 ug/m3\n敏感人群可能出现轻微刺激",
    "不适: >25-50 ug/m3\n可能引起呼吸不适，建议减少暴露",
    "较差: >50 ug/m3\n存在健康风险，避免长期暴露并加强通风",
    "一氧化碳 (CO) 是无色无味的有毒气体，主要来自不完全燃烧。常见来源包括燃气灶、取暖器、壁炉、发动机尾气和烟草烟雾。CO 会降低血液携氧能力，在室内可快速达到危险水平。请定期维护燃烧设备、保持通风，并使用独立 CO 报警器。",
    "优秀: <9 ppm\n安全水平，室内空气正常",
    "可接受: 9-35 ppm\n浓度升高，需通风并减少暴露",
    "不适: >35-100 ppm\n警告，可能出现头痛和疲劳",
    "较差: >100 ppm\n危险! 立即撤离并通风",
    "PM0.5 统计可绕过肺部防御并进入血液的超细颗粒（0.3-0.5 um）。通过激光散射测得，单位 #/cm3。主要来源：燃烧、烹饪、3D 打印、蜡烛、电子烟。传感器范围：0-3000 #/cm3。阈值考虑了传感器精度（+/-100 #/cm3）和典型城市室内背景水平。",
    "Excellent: <=250 #/cm3\n空气洁净，适合睡眠和长时间停留",
    "Acceptable: >250-600 #/cm3\n室内活动正常，无需处理",
    "Uncomfortable: >600-1200 #/cm3\n检测到污染源，建议通风或净化",
    "Poor: >1200 #/cm3\n浓度较高，请排查来源并改善气流",
    "正在安装更新...\n请勿关闭设备电源。\n设备将自动重启。",
    "设置海拔",
    "点击\n设置\n海拔",
    "MSL 气压\n用于天气对比的海平面修正气压。",
    "海拔高度\n可在地图或 GPS 中查询",
    "仅用于 MSL。\n绝对气压保持不变。",
    "绝对气压",
    "MSL 气压",
    "应用",
