    "---",
    "--",
    "0%",
    "--:--",
    "--.--.----",
    "°C",
    "°F",
    "ppb",
    "指数",
    "HCHO",
    "AQI",
    "システムログ",
    "戻る",
    "ログをクリア",
    "警告やエラーはありません。",
    "初期化中",
    "きれいな空気です。問題ありません。",
    "非常に良い",
    "良い",
    "普通",
    "悪い",
    "OFF",
    "ON",
    "OK",
    "ERR",
    "同期",
    "CON",
    "UPD",
    "LOW",
    "WRN",
    "接続済み",
    "APモード",
    "エラー",
    "接続中",
    "無効",
    "WiFiなし",
    "接続済み",
    "エラー",
    "再試行中...",
    "再試行待ち",
    "接続中...",
    "時刻設定待ち...",
    "有効 / 無効",
    "6時間ごと",
    "http://192.168.4.1/wifi",
    "http://aura.local/mqtt",
    "http://aura.local/theme",
    "APモード:\n1） スマホ/PCを Aura AP ネットワークに接続。\n2） 開く: http://192.168.4.1/dashboard\nWi-Fi設定: http://192.168.4.1/wifi",
    "STA （Wi-Fi） モード:\n使用: {{IP_URL}}\n代替ホスト名:\n{{LOCAL_URL}}",
    "未接続:\nWi-Fi設定でAPモードを有効にするか、\nWi-Fiネットワークに接続してください。\n接続完了後、このページを開いてください。",
    "COを検出しました。速やかに換気を開始してください。",
    "CO濃度が高いです。危険なため直ちに換気してください。",
    "COが危険レベル。命に関わるため直ちに避難してください。",
    "CO2濃度が極めて高いです。窓を開けて換気してください。",
    "CO2濃度が高いです。早めの換気を推奨します。",
    "CO2濃度がやや高いです。必要に応じて換気してください。",
    "PM2.5が極めて高いです。空気清浄機の使用と煙の確認を。",
    "PM2.5が高いです。空気清浄機の使用と発生源の特定を。",
    "PM2.5がやや高いです。空気清浄機の使用を推奨します。",
    "PM1が極めて高いです。空気清浄機の使用と火元の確認を。",
    "PM1が高いです。空気清浄機の使用と発生源の特定を。",
    "PM1がやや高いです。空気清浄機の使用を推奨します。",
    "PM10が極めて高いです。空気清浄機の使用と発生源の特定を。",
    "PM10が高いです。空気清浄機の使用と埃の除去を。",
    "PM10がやや高いです。空気清浄機の使用を推奨します。",
    "HCHOが極めて高いです。速やかな換気と発生源の除去を。",
    "HCHOが高いです。換気を行い発生源を除去してください。",
    "HCHOを検出しました。換気と発生源の確認を推奨します。",
    "VOCが極めて高いです。速やかな換気と発生源の特定を。",
    "VOCが高いです。換気をしてください。",
    "NOxが極めて高いです。速やかな換気と燃焼機器の停止を。",
    "NOxが高いです。換気扇の使用と発生源の特定を。",
    "NOxがやや高いです。コンロの状態や屋外状況の確認を。",
    "気温が極めて低いです。健康維持のために暖房の使用を。",
    "気温が低いです。暖房の使用を推奨します。",
    "やや肌寒いです。必要に応じて暖房を使用してください。",
    "気温が極めて高いです。熱中症予防のために冷房の使用を。",
    "気温が高いです。冷房の使用や換気を推奨します。",
    "やや暑いです。必要に応じて換気や冷房を使用してください。",
    "露点が極めて低いです。乾燥を防ぐために速やかな加湿を。",
    "露点が低いです。空気が乾燥しているため注意が必要です。",
    "露点が高く極めて蒸し暑いです。直ちに除湿してください。",
    "露点が極めて高いです。除湿や冷房を使用してください。",
    "露点が高いです。必要に応じて除湿や冷房の使用を。",
    "湿度が極めて低いです。乾燥を防ぐために速やかな加湿を。",
    "湿度が非常に低いです。加湿器の使用を推奨します。",
    "湿度が低いです。必要に応じて加湿器の使用を推奨します。",
    "湿度が極めて高いです。カビ防止のために速やかな除湿を。",
    "湿度が非常に高いです。除湿機の使用を推奨します。",
    "湿度が高いです。必要に応じて除湿や冷房の使用を。",
    "設定",
    "設定",
    "保存して戻る",
    "気温補正",
    "湿度補正",
    "夜間モード",
    "°C / °F",
    "バーの色表示",
    "Wi-Fi",
    "日付と時刻",
    "テーマ変更",
    "MQTT",
    "自動夜間モード",
    "再起動",
    "初期状態に\nリセット",
    "CO2\n校正",
    "情報",
    "ドット\nインジケータ",
    "警報発生時に\n点滅",
    "VOC\n再学習",
    "バックライト",
    "Wi-Fi設定",
    "Wi-Fi状態:",
    "Wi-Fiの設定:\n- 以下の有効/無効ボタンを押します。\n- スマートフォンやPCを「ProjectAura-Setup」のWi-Fiネットワークに接続してください。\n- ブラウザで http://192.168.4.1/wifi を開くか、QRコードを読み取ります。\n- 接続したいWi-Fiネットワークを選択し、パスワードを入力してください。\n",
    "SSID:",
    "IP:",
    "Wi-Fi設定\n削除",
    "再接続",
    "AP開始",
    "MQTT設定",
    "MQTT状態:",
    "MQTTの設定:\n- ブラウザで {{IP_URL}} を開くかQRコードを読み取ります。\n- 代替ホスト名: {{LOCAL_URL}}",
    "デバイスIP:",
    "ブローカーIP:",
    "トピック:",
    "再接続",
    "日付と時刻",
    "タイムゾーン",
    "自動取得（NTP）",
    "時刻設定",
    "時:",
    "分:",
    "日付設定",
    "日:",
    "月:",
    "年:",
    "時刻",
    "適用",
    "RTC:",
    "WIFI:",
    "NTP:",
    "RTCが正しく検出され、時刻も正しく表示されている場合は、変更不要です。\n\nRTCの検出が誤っている場合を除き、Autoのままにしてください。\n\nRTCが正しく識別されない場合は、取り付けたモジュールを手動で選択してください:",
    "AUTO",
    "自動検出が誤っている場合のみ手動選択を使用してください。\nこの設定を変更するとデバイスが再起動します。",
    "検出: %s",
    "選択: %s",
    "なし",
    "状態: 未検出",
    "状態: 電池残量低下",
    "状態: 電源喪失",
    "状態: 時刻未設定",
    "状態: 時刻が無効",
    "状態: OK",
    "状態: 変更の適用に再起動が必要",
    "今の状態:",
    "気温",
    "湿度",
    "海面気圧",
    "安定化待ち",
    "続行",
    "再起動",
    "リセット",
    "キャンセル",
    "VOC校正をリセットしますか？",
    "VOC/NOxの再学習を開始します。\n測定値が数時間不安定になることがあります。",
    "デバイスを再起動しますか？",
    "デバイスが再起動します。\n測定が一時的に停止します。",
    "初期状態にリセットしますか？",
    "Wi-Fi設定、補正、テーマ、\nスケジュール、VOC状態を消去します。\nこの操作は元に戻せません。",
    "テーマ:",
    "カスタム",
    "プリセット",
    "例:",
    "カスタムテーマの設定:\n- Project Aura を Wi-Fi に接続します。\n- ブラウザで {{IP_URL}} を開くか、\nQRコードを読み取ってください。\n- 代替ホスト名: {{LOCAL_URL}} \n- 設定後は「戻る」を押して保存してください。",
    "代替: 上の .local リンクを使用することも可能です。\n{{LOCAL_URL}}",
    "ファン\n制御",
    "ファン制御",
    "自動夜間モード",
    "スケジュールに従って「夜間モード」の配色を有効にします。\n- 下記の項目で開始時刻と終了時刻を設定してください。\n- 有効に切り替えます。\n- 自動夜間モードが有効な間は、\n手動での夜間モード切り替えは無効になります。",
    "開始時刻",
    "終了時刻",
    "画面バックライト",
    "画面オフ中も空気質を監視します。\nセンサは動作継続しタッチで復帰します。",
    "スケジュール",
    "警報で復帰",
    "有効 / 無効",
    "自動画面オフ",
    "オフ時刻",
    "オン時刻",
    "常時オン",
    "30秒",
    "1分",
    "5分",
    "CO2校正（新鮮な空気）",
    "CO2\n校正",
    "- ASC（自動自己校正）: デフォルトでオンになっています。\n- 週に1回以上、CO2濃度が屋外に近いレベルまで下がる環境（適切な換気を\n行っている部屋や無人の部屋）で最適に動作します。\n- ASCは数日かけて緩やかに自動調整を行うため、効果は即時ではありません。\n- ASCがオンであれば、通常は手動での校正作業は不要です。",
    "- モバイルバッテリ等で給電してください。\n- 屋外の新鮮な空気が通る場所へ設置してください。\n- 人の呼気、窓、車両、煙、排気口などの影響から十分に離してください。\n- 最低5分間（推奨は10分間）そのまま運転させます。\n- CO2校正を実行し、完了まで本体を動かさないでください。\n- 手動校正はトラブル対応専用の機能です。\n- 6か月に1回を超える頻度での校正は避けてください。\n- 校正は420 ppmを基準にして処理されます。\n- 条件が悪い場所で校正を行うと、その後の測定精度が悪化することがあります。",
    "開始",
    "CO2校正を確認",
    "本体が屋外の新鮮な空気に少なくとも5-10分置かれていることを確認してください。\n続行しますか？",
    "CO2校正中\n約10秒お待ちください。\n本体を動かさないでください。",
    "CO2 ASCを有効化中...\n約10秒お待ちください。",
    "CO2 ASCを無効化中...\n約10秒お待ちください。",
    "TAP TO CONTINUE",
    "BOOT DIAGNOSTICS",
    "System",
    "Sensors",
    "App:",
    "MAC:",
    "Reset:",
    "Heap:",
    "Storage:",
    "I2C:",
    "Touch:",
    "SEN66:",
    "SFA3X:",
    "PCF8523:",
    "Errors detected",
    "SHOW ERRORS",
    "OK (config)",
    "OK (defaults)",
    "RECOVERED",
    "DETECTED",
    "FAIL",
    "STARTING",
    "NOT FOUND",
    "LOST",
    "SET TIME",
    "絶対湿度が極めて低いです。乾燥を防ぐために速やかな加湿を。",
    "絶対湿度が低いです。必要に応じて加湿器の使用を推奨します。",
    "絶対湿度が高いです。必要に応じて除湿や冷房の使用を。",
    "絶対湿度が極めて高いです。カビ防止のために速やかな除湿を。",
    "気温は快適性、生産性、睡眠の質に直接影響します。しきい値はASHRAE規格55（温熱快適性）およびWHOの住環境勧告に基づいています。適正範囲を維持することは、集中力を保ち疲労を防ぐために有効です。極端な気温は不快感、眠気、集中力低下を引き起こし、悪い環境に長く滞在すると健康に影響することがあります。",
    "良い: 20-25°C （68-77°F）\n快適性と生産性を最大化する理想の温度範囲です。",
    "普通: 18-20°C または 25-26°C （64-68°F / 77-79°F）\n適正範囲をわずかに外れますが、許容できる快適さです。",
    "悪い: 16-18°C または 26-28°C （61-64°F / 79-82°F）\n明らかな不快感があり、生産性が低下します。",
    "非常に悪い: <16°C または >28°C （<61°F / >82°F）\n強い不快感があるため、気温の調整が必要です。",
    "VOC指数は建材、家具、洗剤、化粧品などから発生する揮発性有機化合物（VOC）の総量を測定します。Sensirion SGPアルゴリズム（1-500）を採用しており、指数100を基準の空気（過去の平均値）として定義しています。値の上昇は汚染の増加を示します。長時間の暴露は頭痛、目への刺激、疲労の原因になります。数値が上昇した場合は換気を行ってください。青い表示はセンサ温度の安定化を待っていることを意味します。",
    "良い: ≦150\n通常の室内空気です。特段の対応は不要です。",
    "普通: 151-250\nVOCがわずかに上昇しています。必要に応じて換気を検討してください。",
    "悪い: 251-350\nにおいや不快感が発生する可能性があります。積極的な換気を推奨します。",
    "非常に悪い: >350\n頭痛や粘膜刺激の恐れがあります。直ちに換気を実施してください。",
    "NOx指数はガスコンロ、暖房器具、車両、たばこの煙などの燃焼源から発生する窒素酸化物を測定します。Sensirion SGPアルゴリズム（1-500）を採用しています。多くは屋外の交通汚染が室内に流入することで上昇します。高濃度は気道を刺激し、喘息症状を悪化させます。ガス調理時は換気扇を常時使用し、交通量の多い時間帯は窓を閉めてください。青い表示はセンサ温度の安定化を待っていることを意味します。",
    "良い: ≦50\n清浄な空気です。燃焼源の影響はありません。",
    "普通: 51-100\nわずかに上昇しています。十分な換気を確保してください。",
    "悪い: 101-200\n燃焼副産物が顕著に存在しています。換気を強化してください。",
    "非常に悪い: >200\n高濃度のNOxに暴露されています。直ちに発生源を特定してください。",
    "ホルムアルデヒド（HCHO）は合板、家具、床材、接着剤、繊維などから放散される発がん性のある揮発性有機化合物（VOC）です。WHO指針（~80 µg/m³ ≈ 65 ppb）に基づいています。新築、改装、新しい家具の導入が主な発生源で、目・鼻・喉に強い刺激を与えます。材料の経年変化とともに放散量は減少します。新しい空間では数週間の徹底した換気が不可欠です。",
    "良い: <30 ppb\n安全な水準です。健康影響や刺激の心配はありません。",
    "普通: 30-60 ppb\n低濃度の暴露です。敏感な人はわずかな刺激を感じる可能性があります。",
    "悪い: 60-100 ppb\n目や喉への刺激リスクが上昇しています。換気回数を増やしてください。",
    "非常に悪い: >100 ppb\n健康リスクを伴う有害な水準です。直ちに換気を実施してください。",
    "AQIはデバイスが測定したリアルタイムの総合空気質スコアです。粒子状物質、換気効率、ガス汚染の各指標を0-100の範囲で統合し、数値が低いほど清浄であることを示します。スコアは最も悪化している汚染物質の値を主軸に算出し、他の汚染物質による軽微な影響を加算します。この指標で全体の傾向を素早く把握し、個別の測定項目で詳細を確認してください。",
    "良い: 0-25\n全体的に清浄な空気です。対応は不要です。",
    "普通: 26-50\nわずかに空気質が低下しています。換気が有効な対策となります。",
    "悪い: 51-75\n汚染が顕著です。汚染源を特定し、換気環境を改善してください。",
    "非常に悪い: >75\n高度な汚染です。暴露を減らすため直ちに対応を実施してください。",
    "CO2濃度は室内空気の停滞度と換気効率の指標です。ASHRAEおよびドイツ連邦環境庁（UBA）の基準に基づいています。屋外の基準値は約400ppmです。1000ppmを超えると認知能力が低下し、1500ppmを超えると眠気、頭痛、集中力低下を誘発します。適切な換気によって低濃度を維持することが、生産性と健康の維持に不可欠です。",
    "良い: <800 ppm\n集中力と生産性の維持に最適な空気質です。",
    "普通: 800-1000 ppm\n空気の停滞による集中力低下の兆候があります。",
    "悪い: 1000-1500 ppm\n顕著な疲労感があり、認知能力が低下します。",
    "非常に悪い: >1500 ppm\n強い眠気、頭痛、激しい集中困難を引き起こします。",
    "PM2.5は肺の深部や血管内にまで侵入する微小粒子状物質です。米国EPAの大気質指数（AQI）およびWHO指針に準拠しています。長期の暴露は呼吸器・循環器系疾患のリスクを高めます。室内における主な発生源は調理、ろうそく、喫煙、屋外汚染の流入です。空気清浄機の使用と適切な換気により低濃度を維持してください。",
    "良い: ≦12 µg/m³\n清浄な空気です。健康への影響はありません。",
    "普通: >12-35 µg/m³\n敏感な人は軽度の刺激を感じる可能性があります。",
    "悪い: >35-55 µg/m³\n呼吸器への不快感が生じる可能性があります。暴露時間の制限を推奨します。",
    "非常に悪い: >55 µg/m³\n健康リスクを伴う水準です。長時間の滞在を避け、濾過と換気を強化してください。",
    "PM4はPM2.5とPM10の中間に位置し、気道の奥に沈着する吸入性粒子です。実用的な室内リスク評価のため、しきい値はPM2.5とPM10の指針値から中間的に設定しています。主な発生源は粉塵、花粉の破片、燃焼エアロゾル、屋外からの汚染です。HEPAフィルター等による濾過と適切な換気で制御してください。",
    "良い: ≦25 µg/m³\n清浄な空気です。健康への影響は極めて最小限です。",
    "普通: >25-50 µg/m³\n軽度の上昇です。敏感な人は刺激を感じる可能性があります。",
    "悪い: >50-75 µg/m³\n呼吸器への不快感が生じる可能性があります。暴露量を削減してください。",
    "非常に悪い: >75 µg/m³\n高い暴露リスクがあります。換気と空気濾過の速やかな改善が必要です。",
    "PM10は粉塵、花粉、カビの胞子などを含む粗大粒子です。米国EPAの大気質指数（AQI）の基準に基づいています。目・鼻・喉の粘膜を直接刺激します。PM2.5に比べ沈着部位は浅いものの、呼吸器系に悪影響を及ぼします。発生源は土砂粉塵、工事、花粉、道路粒子です。こまめな清掃、空気清浄機の使用、窓の閉鎖が有効な対策となります。",
    "良い: ≦54 µg/m³\n清浄な空気です。刺激の心配はありません。",
    "普通: >54-154 µg/m³\n敏感な人は軽い刺激を感じる可能性があります。",
    "悪い: >154-254 µg/m³\n目や喉への明確な刺激があります。暴露を制限してください。",
    "非常に悪い: >254 µg/m³\n呼吸器への強い不快感があります。長時間の暴露を回避してください。",
    "3時間の気圧変化は、短時間の気象変化とそれに伴う体調への急激な影響を示す指標です。急激な気圧低下は前線や低気圧の接近を意味し、気象病に敏感な人に片頭痛、関節痛、めまいの急性症状を誘発する恐れがあります。短期的な活動計画に有用です。原因不明の急な疲労や頭痛発生時は、この値を確認することをおすすめします。",
    "良い: <1.0 hPa （<0.03 inHg）\n気圧が安定しています。気圧変化による不快感の心配はありません。",
    "普通: 1.0-3.0 hPa （0.03-0.09 inHg）\n気象が緩やかに変化しています。軽度の疲労感を感じる可能性があります。",
    "悪い: 3.0-6.0 hPa （0.09-0.18 inHg）\n前線が接近しています。頭痛、関節痛などの気象病症状を誘発することがあります。",
    "非常に悪い: >6.0 hPa （>0.18 inHg）\n急激な悪天候です。強い片頭痛や激しい疲労感に襲われる恐れがあります。",
    "24時間の気圧変化は、マクロな天候トレンドと身体への持続的な負担を示す指標です。大幅な変動は、発達した低気圧や強い前線の通過を意味します。気象病に敏感な人は、持続的な疲労感、気分の変動、慢性的な関節痛や旧傷の痛みの悪化を招くことがあります。1日の行動計画の策定や、数時間後の体調予測に有効です。",
    "良い: <2.0 hPa （<0.06 inHg）\n極めて安定した天候です。身体への負担はありません。",
    "普通: 2.0-6.0 hPa （0.06-0.18 inHg）\n天候が変化しています。敏感な人は軽度の症状が発生する可能性があります。",
    "悪い: 6.0-10.0 hPa （0.18-0.30 inHg）\n低気圧や前線が通過中です。身体的・精神的な不快感が増大します。",
    "非常に悪い: >10.0 hPa （>0.30 inHg）\n猛烈な荒天です。重度の気象病症状が発生する恐れがあります。",
    "相対湿度（Relative Humidity）は呼吸器の快適性、皮膚の健康、体感温度に影響します。ASHRAE規格55および米国EPAの推奨に基づいています。最適範囲（40-60%）の維持は、粘膜の乾燥を防ぎ、微生物やカビの繁殖を抑制します。低湿度は肌の乾燥、粘膜の刺激、静電気の発生を誘発します。高湿度はカビ、ダニの繁殖と不快感を促進します。",
    "良い: 40-60%\n理想的な湿度環境です。呼吸器の保護と肌の健康に最適です。",
    "普通: 30-40% または 60-65%\n軽度の乾燥または多湿です。わずかな不快感が生じる可能性があります。",
    "悪い: 20-30% または 65-70%\n顕著な肌の乾燥や刺激、または強い蒸し暑さを感じます。",
    "非常に悪い: <20% または >70%\n健康リスクが上昇します。呼吸器疾患の誘発、または激しいカビの発生の恐れがあります。",
    "絶対湿度（Absolute Humidity）は周囲の気温に左右されず、空気1m³中に含まれる実際の水蒸気重量（g/m³）を測定します。相対湿度と異なり、大気中の真の水分量を評価できます。低すぎると気道粘膜や皮膚が乾燥し、高すぎると発汗による体温調節が困難になりカビの発生を促します。換気の適切な判断や室内外の空気比較に最適です。",
    "良い: 7-15 g/m³\n最適な水分量です。呼吸が最も快適に行える環境です。",
    "普通: 5-7 または 15-18 g/m³\nわずかに乾燥または多湿です。軽度の不快感が生じる可能性があります。",
    "悪い: 4-5 または 18-20 g/m³\n乾燥または蒸し暑さが顕著です。身体的負荷が発生します。",
    "非常に悪い: <4 または >20 g/m³\n極端な乾燥または過湿です。呼吸器や皮膚のトラブルリスクがあります。",
    "露点温度（Dew Point）は、大気中の水蒸気が結露を始める温度であり、人間の体感的な蒸し暑さ・乾燥度を相対湿度よりも正確に表現します。NOAA（米国海洋大気庁）の快適度指標に基づいています。低い露点は空気の乾燥を示し、皮膚や気道を刺激します。高い露点はベタつきを伴う不快感を生じ、発汗による体温調節機能を阻害します。",
    "良い: 10-16°C （50-61°F）\n理想的な快適性です。自然な呼吸と発汗が可能な環境です。",
    "普通: 8-10°C （46-50°F） または 16-18°C （61-64°F）\n軽度の乾燥または湿気です。許容できる快適さです。",
    "悪い: 5-8°C （41-46°F） または 18-21°C （64-70°F）\n乾燥または蒸し暑さが感じられ、明確な不快感があります。",
    "非常に悪い: <5°C （<41°F） または >21°C （>70°F）\n過度の乾燥、または顕著な不快感があります。健康維持に悪影響を与えます。",
    "気温",
    "ホルムアルデヒド",
    "相対湿度",
    "絶対湿度",
    "露点",
    "カビ発生リスク（Mold Risk）は湿度と気温の条件からカビの発生しやすさを示します。70%を超える高湿度と高い室温は、カビやダニの繁殖に最適な条件を作り出します。カビの胞子はアレルギーや呼吸器疾患、家具などの物的被害を招きます。部屋の隅、浴室、換気の悪い場所を定期的に確認してください。湿度を60%未満に保つことで発生を防ぐことができます。",
    "良い: 0-2\n低リスクです。カビが発生心配が少ない環境です。",
    "普通: 3-4\n中程度のリスクです。湿度の推移に注意してください。",
    "悪い: 5-7\n高リスクです。除湿を行い、換気環境を改善してください。",
    "非常に悪い: 8-10\n危機的なリスクです。すでにカビが発生している恐れがあるため、直ちに対応してください。",
    "カビ発生リスク。",
    "PM1は1ミクロン未満の超微粒子であり、肺の最深部にまで到達して血流に直接進入します。発生源には燃焼器具、自動車の排気、たばこの煙、調理時の煙があります。組織の奥深くまで浸透するため、数ある粒径の中でも特に危険性が高いとされています。公式のEPA基準値はありませんが、健康への影響が大きいため、PM2.5の指針をもとに、より厳格なしきい値を設定しています。",
    "良い: ≦10 ug/m3\n清浄な空気です。健康への影響はありません。",
    "普通: >10-25 ug/m3\n敏感な人は軽度の刺激を感じる可能性があります。",
    "悪い: >25-50 ug/m3\n呼吸器への不快感が生じる可能性があります。暴露時間を制限してください。",
    "非常に悪い: >50 ug/m3\n健康リスクを伴う水準です。長時間の滞在を避け、換気環境を改善してください。",
    "一酸化炭素（CO）は不完全燃焼によって発生する、無色無臭のきわめて有毒なガスです。主な発生源はガスコンロ、暖房器具、暖炉、エンジン、たばこの煙などです。密閉された室内では急速に危険な濃度へ達することがあり、吸い込むと血液の酸素運搬を著しく妨げて重大な中毒症状を引き起こします。燃焼機器の定期点検と適切な換気を行い、専用のCO警報器を設置してください。",
    "良い: <9 ppm\n安全な水準です。通常の室内空気です。",
    "普通: 9-35 ppm\n濃度が上昇しています。確実な換気を行い、暴露時間を制限してください。",
    "悪い: >35-100 ppm\n警告水準です。頭痛や激しい疲労感を引き起こす可能性があります。",
    "非常に悪い: >100 ppm\n危険な状態です。直ちに該当エリアから避難し、換気を行ってください。",
    "PM0.5は、肺の防御機能をすり抜けて血流に進入する、0.3〜0.5ミクロンの超微粒子を計測したものです。レーザ散乱方式で測定し、単位には「個/cm³（#/cm³）」を使用します。主な発生源は燃焼、調理、3Dプリンタ、ろうそく、電子たばこなどです。センサの測定範囲は0-3000個/cm³です。しきい値は、センサの測定精度（+/-100個/cm³）と、都市部における一般的な室内の濃度を考慮して設定されています。",
    "良い: ≦250 #/cm³\n清浄な空気です。睡眠や長時間の滞在に心配のない環境です。",
    "普通: >250-600 #/cm³\n通常の室内活動における標準値です。特段の対応は不要です。",
    "悪い: >600-1200 #/cm³\n室内に発生源が存在します。換気を行うか、空気清浄機を使用してください。",
    "非常に悪い: >1200 #/cm³\n高濃度に達しています。速やかに発生源を特定し、気流を改善してください。",
    "更新をインストール中...\nデバイスの電源を切らないでください。\nデバイスは自動的に再起動します。",
    "標高設定",
    "タップして\n標高を設定",
    "海面気圧\n標高差を除外し、天候を比較するため海面値に補正した気圧です。",
    "海抜標高\n地図やGPSで標高を確認してください",
    "海面気圧にのみ使用。\n現地気圧は変わりません。",
    "現地気圧",
    "海面気圧",
    "適用",
