    "---",
    "--",
    "0%",
    "--:--",
    "--.--.----",
    "C",
    "F",
    "ppb",
    // 'Indeksi' (56 px) wraps in the 40 px card unit label, so 'Index' is
    // used, as in the other Latin-script locales.
    "Index",
    "HCHO",
    "AQI",
    "JÄRJESTELMÄLOKI",
    "TAKAISIN",
    "TYHJENNÄ LOKI",
    "Ei näytettäviä varoituksia tai virheitä.",
    "Alustetaan...",
    "Raikas ilma - Kaikki hyvin",
    "Erinomainen",
    "Hyvä",
    "Kohtalainen",
    "Huono",
    "OFF",
    "ON",
    "OK",
    "ERR",
    "SYNC",
    "CON",
    "UPD",
    "LOW",
    "WRN",
    "Yhdistetty",
    "AP-tila",
    "Virhe",
    "Yhdistetään...",
    "Pois käytöstä",
    "Ei Wi-Fiä",
    "Yhdistetty",
    "Virhe",
    "Yritetään uudelleen...",
    "Viivästetty yritys",
    "Yhdistetään...",
    "Odotetaan aikaa...",
    "ON / OFF",
    "Joka 6h",
    "http://192.168.4.1/wifi",
    "http://aura.local/mqtt",
    "http://aura.local/theme",
    "AP-tila:\n1) Yhdistä puhelin/PC Auran AP-verkkoon.\n2) Avaa: http://192.168.4.1/dashboard\nWi-Fi-asetus: http://192.168.4.1/wifi",
    "STA (Wi-Fi) -tila:\nKäytä: {{IP_URL}}\nVaihtoehtoinen osoite:\n{{LOCAL_URL}}",
    "Ei yhteyttä:\nOta AP-tila käyttöön Wi-Fi-asetuksista tai yhdistä kotiverkkoon.\nPalaa sitten tälle sivulle.",
    "Häkää (CO) havaittu - Tarkista lähde, häkävaroitin",
    "Häkä (CO) koholla - Siirry raittiiseen ilmaan",
    "Häkävaara (CO) - Poistu heti",
    "Hiilidioksidi (CO2) erittäin korkea",
    "Hiilidioksidi (CO2) korkea",
    "Hiilidioksidi (CO2) koholla",
    "PM2.5 erittäin korkea",
    "PM2.5 korkea",
    "PM2.5 koholla",
    "PM1 erittäin korkea",
    "PM1 korkea",
    "PM1 koholla",
    "PM10 erittäin korkea",
    "PM10 korkea",
    "PM10 koholla",
    "Formaldehydi (HCHO) erittäin korkea",
    "Formaldehydi (HCHO) korkea",
    "Formaldehydi (HCHO) koholla",
    "VOC-indeksi erittäin korkea",
    "VOC-indeksi korkea",
    "VOC-indeksi koholla",
    "NOx-indeksi erittäin korkea",
    "NOx-indeksi korkea",
    "NOx-indeksi koholla",
    "Lämpötila erittäin matala",
    "Lämpötila matala",
    "Lämpötila hieman matala",
    "Lämpötila erittäin korkea",
    "Lämpötila korkea",
    "Lämpötila hieman korkea",
    "Ilma tuntuu hyvin kuivalta",
    "Ilma voi tuntua kuivalta",
    "Ilma tuntuu hyvin tukalalta",
    "Ilma tuntuu tukalalta",
    "Ilma voi tuntua tukalalta",
    "Kosteus erittäin matala",
    "Kosteus matala",
    "Kosteus hieman matala",
    "Kosteus erittäin korkea",
    "Kosteus korkea",
    "Kosteus hieman korkea",
    "ASETUKSET",
    // 'ASETUKSET' (72 px) is clipped in the 70 px settings button label, so
    // the shorter 'VALIKKO' is used.
    "VALIKKO",
    "TALLENNA",
    "LÄMPÖKORJAUS",
    "KOSTEUSKORJ.",
    "YÖTILA",
    "C / F",
    "TILARIVI",
    "WI-FI",
    "AIKA / PVM",
    "TEEMAN VÄRI",
    "MQTT",
    "AUTO YÖTILA",
    "KÄYNNISTÄ\nUUDELLEEN",
    "TEHDAS-\nPALAUTUS",
    "CO2\nKALIBROINTI",
    "TIETOJA",
    "TILA-\nPISTEET",
    "HÄLYTYS-\nVILKKU",
    "VOC\nNOLLAUS",
    "TAUSTAVALO",
    "WI-FI-ASETUKSET",
    "Wi-Fi-tila:",
    "Wi-Fi-asetukset:\n- Paina ON / OFF -painiketta\n- Yhdistä puhelin tai PC verkkoon \"ProjectAura-Setup\".\n- Avaa selaimessa http://192.168.4.1/wifi tai skannaa QR-koodi.\n- Valitse kotiverkkosi ja syötä salasana.\n",
    "SSID:",
    "IP:",
    "UNOHDA\nWI-FI",
    "YHDISTÄ",
    "AP PÄÄLLE",
    "MQTT-ASETUKSET",
    "MQTT-tila:",
    "MQTT-asetukset:\n- Avaa {{IP_URL}} selaimessa tai skannaa QR-koodi.\n- Vaihtoehtoinen osoite: {{LOCAL_URL}}",
    "Laitteen IP:",
    "Broker-IP:",
    "Aihe:",
    "YHDISTÄ",
    "AIKA JA PÄIVÄYS",
    "AIKAVYÖHYKE",
    "NTP-SYNKRONOINTI",
    "ASETA AIKA",
    "Tunnit:",
    "Minuutit:",
    "ASETA PVM",
    "Päivä:",
    "Kk:",
    "Vuosi:",
    "AIKA",
    "KÄYTÄ NYT",
    "RTC:",
    "WIFI:",
    "NTP:",
    "Jos RTC tunnistetaan oikein ja laite näyttää\noikean ajan, mitään ei tarvitse muuttaa.\n\nJätä asetus tilaan Auto, ellei RTC-tunnistus ole väärä.\n\nJos järjestelmä ei tunnista RTC-piiriä oikein,\nvalitse asennettu moduuli käsin:",
    "AUTO",
    "Käytä manuaalista valintaa vain, jos automaattitunnistus on väärä.\nAsetuksen muuttaminen käynnistää laitteen uudelleen.",
    "Tunnistettu: %s",
    "Valittu: %s",
    "ei mitään",
    "Tila: Ei löytynyt",
    "Tila: Paristo vähissä",
    "Tila: Virta katkennut",
    "Tila: Aikaa ei asetettu",
    "Tila: Aika virheellinen",
    "Tila: OK",
    "Tila: Vaatii uudelleenkäynnistyksen",
    "TILA: ",
    "LÄMPÖ",
    "KOSTEUS",
    "MSL-PAINE",
    "KÄYNNISTYY",
    "NOLLAA VOC",
    "KÄYNNISTÄ",
    "PALAUTA",
    "PERUUTA",
    "Nollataanko VOC-kalibrointi?",
    "VOC/NOx-oppiminen alkaa alusta.\nLukemat voivat heilua muutaman tunnin.",
    "Käynnistetäänkö laite uudelleen?",
    "Laite käynnistyy uudelleen.\nMittaus keskeytyy hetkeksi.",
    "Palautetaanko tehdasasetukset?",
    "Poistaa Wi-Fi-tiedot, korjaukset,\nteemat, ajastukset ja VOC-tilan.\nTätä ei voi perua.",
    "TEEMA:",
    "OMA",
    "VALMIIT",
    "ESIMERKKI:",
    "Oman teeman asetus:\n- Yhdistä Project Aura ensin Wi-Fi-verkkoon\n- Avaa {{IP_URL}} selaimessa\ntai skannaa QR-koodi.\n- Vaihtoehtoinen osoite:\n{{LOCAL_URL}}\n- Tallenna painamalla Takaisin",
    "Vaihtoehto: käytä yllä olevaa .local-linkkiä.\n{{LOCAL_URL}}",
    "PUHALLIN-\nOHJAUS",
    "Puhallinohjaus",
    "AUTOMAATTINEN YÖTILA",
    "Tämä toiminto ottaa \"Yötilan\" värit käyttöön aikataulun mukaan.\n- Aseta alku- ja loppuaika alla.\n- Kytke kytkin päälle (ON).\n- Manuaalinen yötila ei ole käytössä, kun Auto yötila on päällä.",
    "ALKUAIKA",
    "LOPPUAIKA",
    "NÄYTÖN TAUSTAVALO",
    "Laite seuraa ilmanlaatua myös näytön ollessa pois päältä.\nAnturit pysyvät aktiivisina. Herätä koskettamalla.",
    "LEPOTILAN AJASTUS",
    "HERÄÄ HÄLYTYKSEEN",
    "ON / OFF",
    "VIRRANSÄÄSTÖ",
    "LEPOTILA KLO",
    "HERÄTYS KLO",
    "AINA PÄÄLLÄ",
    "30 SEK",
    "1 MIN",
    "5 MIN",
    "CO2-kalibrointi (raitis ilma)",
    "KALIBROI\nCO2",
    "- ASC (automaattinen itsekalibrointi): oletuksena päällä.\n- Toimii parhaiten, kun CO2 laskee lähelle ulkoilman tasoa\nvähintään viikoittain (hyvä tuuletus / tyhjä huone).\n- ASC säätyy hitaasti päivien kuluessa (ei heti).\n- Kun ASC on päällä, manuaalista kalibrointia\nei yleensä tarvita.",
    "- Käytä laitetta varavirtalähteellä (power bank).\n- Vie se ulos raittiiseen ilmaan.\n- Pidä etäällä ihmisistä, ikkunoista, autoista ja savusta.\n- Anna käydä 10 minuuttia (vähintään 5).\n- Paina Kalibroi CO2 ja pidä laite paikallaan.\n- Manuaalinen kalibrointi on vain vianetsintään.\n- Älä kalibroi useammin kuin kerran 6 kuukaudessa.\n- Kalibrointi käyttää 420 ppm:n vertailuarvoa.\n- Väärät olosuhteet voivat huonontaa lukemia.",
    "ALOITA",
    "Vahvista CO2-kalibrointi",
    "Varmista, että laite on ollut puhtaassa ulkoilmassa vähintään 5-10 minuuttia.\nHaluatko jatkaa?",
    "CO2-kalibrointi käynnissä\nOdota noin 10 sekuntia.\nÄlä liikuta laitetta.",
    "Otetaan CO2 ASC käyttöön...\nOdota noin 10 sekuntia.",
    "Poistetaan CO2 ASC käytöstä...\nOdota noin 10 sekuntia.",
    "JATKA",
    "KÄYNNISTYSDIAGNOSTIIKKA",
    "Järjestelmä",
    "Anturit",
    "App:",
    "MAC:",
    "Reset:",
    "Heap:",
    "Tallennus:",
    "I2C:",
    // 'Kosketus:' (99 px) overlaps the value, which starts 71 px after the
    // label, and the word does not work in this technical context.
    "Touch:",
    "SEN66:",
    "SFA3X:",
    "PCF8523:",
    "Virheitä havaittu",
    "NÄYTÄ VIRHEET",
    "OK (asetukset)",
    "OK (oletukset)",
    "PALAUTETTU",
    "TUNNISTETTU",
    "VIRHE",
    "KÄYNNISTYY",
    "EI LÖYDY",
    "KADONNUT",
    "ASETA AIKA",
    "Absoluuttinen kosteus erittäin matala",
    "Absoluuttinen kosteus matala",
    "Absoluuttinen kosteus hieman matala",
    "Absoluuttinen kosteus hieman korkea",
    "Absoluuttinen kosteus korkea",
    "Absoluuttinen kosteus erittäin korkea",
    "Lämpötila vaikuttaa viihtyvyyteen, tuottavuuteen ja unen laatuun. Raja-arvot perustuvat ASHRAE 55 -lämpöviihtyvyysstandardiin ja WHO:n asumissuosituksiin. Ihanteellinen lämpötila auttaa keskittymään ja ehkäisee väsymystä. Liian kylmä tai kuuma aiheuttaa epämukavuutta, uneliaisuutta tai keskittymisvaikeuksia. Pitkäaikainen altistus huonoille lämpöolosuhteille voi vaikuttaa terveyteen.",
    "Erinomainen: 20-25°C (68-77°F)\nIhanteellinen lämpötila viihtyvyydelle ja tuottavuudelle",
    "Hyväksyttävä: 18-20°C tai 25-26°C (64-68°F tai 77-79°F)\nHieman ihannealueen ulkopuolella, silti miellyttävä",
    "Epämukava: 16-18°C tai 26-28°C (61-64°F tai 79-82°F)\nSelvää epämukavuutta, tuottavuus laskee",
    "Huono: <16°C tai >28°C (<61°F tai >82°F)\nMerkittävää epämukavuutta, säädä lämpötilaa",
    "VOC-indeksi mittaa haihtuvia orgaanisia yhdisteitä, joita vapautuu maaleista, huonekaluista, puhdistusaineista ja kosmetiikasta. Indeksi perustuu Sensirionin SGP-algoritmiin (asteikko 1-500), ja arvo 100 vastaa tavanomaista ilmaa. Pitkäaikainen altistus voi aiheuttaa päänsärkyä, silmien ärsytystä ja väsymystä. Tuuleta, kun arvo on koholla. Sininen merkki = anturi on käynnistysvaiheessa.",
    "Erinomainen: ≤150\nNormaali sisäilma, ei toimenpiteitä",
    "Hyväksyttävä: 151-250\nVOC hieman koholla, harkitse tuuletusta",
    "Epämukava: 251-350\nHajuja saattaa esiintyä, tuuletus suositeltavaa",
    "Huono: >350\nPäänsärky ja ärsytys mahdollisia, tuuleta heti",
    "NOx-indeksi mittaa palamisessa syntyviä typen oksideja: kaasuliedet, lämmittimet, ajoneuvot, tupakansavu. Perustuu Sensirionin SGP-algoritmiin (asteikko 1-500). Liikenteen päästöt tulevat usein ulkoa sisään. Suuret pitoisuudet ärsyttävät hengitysteitä ja pahentavat astmaa. Käytä liesituuletinta kaasuliedellä ja pidä ikkunat kiinni ruuhka-aikaan. Sininen merkki = anturi on käynnistysvaiheessa.",
    "Erinomainen: ≤50\nPuhdas ilma, palamislähteitä ei havaittu",
    "Hyväksyttävä: 51-100\nLievästi koholla, huolehdi riittävästä tuuletuksesta",
    "Epämukava: 101-200\nPalamistuotteita havaittavissa, tuuleta tehokkaasti",
    "Huono: >200\nSuuri NOx-altistus, hengitysteiden ärsytys todennäköistä, etsi lähde",
    "Formaldehydi (HCHO) on syöpävaarallinen VOC-yhdiste, jota vapautuu puristelevyistä, huonekaluista, lattioista, liimoista ja tekstiileistä. Raja-arvot perustuvat WHO:n ohjeisiin (~80 µg/m³ ≈ 65 ppb). Suurimpia lähteitä ovat uudet huonekalut ja remontit. Ärsyttää silmiä, nenää ja kurkkua. Pitoisuus laskee ajan myötä päästöjen vähentyessä. Tuuleta uusia tiloja huolellisesti useita viikkoja.",
    "Erinomainen: <30 ppb\nTurvallinen taso, ärsytystä ei odoteta",
    "Hyväksyttävä: 30-60 ppb\nVähäinen altistus, herkät voivat tuntea lievää ärsytystä",
    "Epämukava: 60-100 ppb\nSilmien ja kurkun ärsytys mahdollista, lisää tuuletusta",
    "Huono: >100 ppb\nTerveysriski, pitkäaikainen altistus haitallista, tuuleta heti",
    "AQI kuvaa ilmanlaadun kokonaistilannetta tällä hetkellä. Se yhdistää hiukkas-, ilmanvaihto- ja kaasumittaukset yhdeksi luvuksi välillä 0-100. Mitä pienempi luku, sitä parempi ilma. AQI huomioi ensisijaisesti pahimman epäpuhtauslähteen ja nostaa lukua hieman myös muiden koholla olevien ryhmien vuoksi. Katso AQI:stä nopea yleiskuva ja etsi syy yksittäisten antureiden lukemista.",
    "Erinomainen: 0-25\nPuhdas ilma, ei toimenpiteitä",
    "Hyväksyttävä: 26-50\nLievää ilmanlaadun heikkenemistä, tuuletus voi auttaa",
    "Epämukava: 51-75\nSelvästi kohonnut epäpuhtaustaso, etsi lähde ja paranna tuuletusta",
    "Huono: >75\nKorkea epäpuhtaustaso, vähennä altistusta ja toimi heti",
    "Hiilidioksidi (CO₂) kertoo sisäilman laadusta ja ilmanvaihdon tehokkuudesta. Raja-arvot perustuvat ASHRAE:n ja UBA:n ohjeisiin. Ulkoilman CO₂-pitoisuus on noin 400 ppm. Yli 1000 ppm:n pitoisuus heikentää kognitiivista suorituskykyä, ja yli 1500 ppm aiheuttaa uneliaisuutta ja päänsärkyä. Hyvä ilmanvaihto pitää hiilidioksidin määrän matalana, mikä tukee keskittymistä ja terveyttä.",
    "Erinomainen: <800 ppm\nIhanteellinen ilmanlaatu keskittymiselle ja tuottavuudelle",
    "Hyväksyttävä: 800-1000 ppm\nLievä keskittymiskyvyn lasku mahdollinen",
    "Epämukava: 1000-1500 ppm\nHavaittavaa väsymystä, heikentynyt kognitiivinen suorituskyky",
    "Huono: >1500 ppm\nUneliaisuutta, päänsärkyä, keskittymisvaikeuksia",
    "PM2.5 ovat pienhiukkasia, jotka tunkeutuvat syvälle keuhkoihin ja verenkiertoon. Raja-arvot perustuvat US EPA:n ilmanlaatuindeksiin (AQI) ja WHO:n ohjeisiin. Pitkäaikainen altistus liittyy hengitystie-, sydän- ja verisuonisairauksiin. Lähteitä ovat ruoanlaitto, kynttilät, ulkoilman hiukkaset ja tupakointi. Pidä sisäilman pitoisuudet matalina suodattamalla ja tuulettamalla.",
    "Erinomainen: ≤12 µg/m³\nPuhdas ilma, ei terveysvaikutuksia",
    "Hyväksyttävä: >12-35 µg/m³\nHerkät voivat tuntea lievää ärsytystä",
    "Epämukava: >35-55 µg/m³\nHengitysoireet mahdollisia, rajoita altistusta",
    "Huono: >55 µg/m³\nTerveysriski, vältä pitkää altistusta, paranna tuuletusta",
    "PM4 ovat hengitettäviä hiukkasia, jotka kertyvät syvälle hengitysteihin. Ne ovat kooltaan PM2.5:n ja PM10:n välissä. Raja-arvot on asetettu PM2.5- ja PM10-ohjeiden väliin käytännön sisäilmariskin arviointia varten. Lähteitä ovat pöly, siitepölyn palaset, palamisaerosolit ja ulkoilman hiukkaset. Pidä pitoisuudet matalina suodattamalla ja tuulettamalla.",
    "Erinomainen: ≤25 µg/m³\nPuhdas ilma, vähäiset terveysvaikutukset",
    "Hyväksyttävä: >25-50 µg/m³\nLievästi koholla, herkät voivat tuntea ärsytystä",
    "Epämukava: >50-75 µg/m³\nHengitysoireet mahdollisia, vähennä altistusta",
    "Huono: >75 µg/m³\nKorkea altistusriski, paranna tuuletusta ja suodatusta",
    "PM10 ovat karkeita hiukkasia, kuten pölyä, siitepölyä ja homeitiöitä. Raja-arvot perustuvat US EPA:n AQI-indeksiin. PM10-hiukkaset voivat ärsyttää silmiä, nenää ja kurkkua. Ne ovat PM2.5:tä vähemmän haitallisia, mutta vaikuttavat silti hengitysterveyteen. Lähteitä: pöly, rakentaminen ja katupöly. Vähennä siivoamalla säännöllisesti, suodattamalla ja pitämällä ikkunat kiinni.",
    "Erinomainen: ≤54 µg/m³\nPuhdas ilma, ärsytystä ei odoteta",
    "Hyväksyttävä: >54-154 µg/m³\nHerkät voivat tuntea lievää ärsytystä",
    "Epämukava: >154-254 µg/m³\nSilmien ja kurkun ärsytys mahdollista, rajoita altistusta",
    "Huono: >254 µg/m³\nHengitysoireet todennäköisiä, vältä pitkää altistusta",
    "Ilmanpaineen 3 tunnin muutos kertoo nopeista sään vaihteluista, jotka voivat vaikuttaa hyvinvointiin. Nopea paineen lasku edeltää usein myrskyjä ja voi aiheuttaa herkille äkillisiä oireita: migreeniä, nivelkipua ja huimausta. Hyödyllinen lyhyen aikavälin suunnitteluun. Jos tunnet äkillistä väsymystä tai päänsärkyä, tarkista tämä arvo - paineen lasku voi olla syynä.",
    "Erinomainen: <1.0 hPa (<0.03 inHg)\nVakaa sää, epämukavuutta ei odoteta",
    "Hyväksyttävä: 1.0-3.0 hPa (0.03-0.09 inHg)\nSää muuttumassa, lievä väsymys mahdollinen",
    "Epämukava: 3.0-6.0 hPa (0.09-0.18 inHg)\nRintama lähestyy, päänsärky ja nivelkipu mahdollisia",
    "Huono: >6.0 hPa (>0.18 inHg)\nNopea muutos kohti myrskyä, migreeni ja väsymys mahdollisia",
    "Ilmanpaineen 24 tunnin muutos kertoo sään kehityksestä ja pitkäkestoisesta rasituksesta keholle. Suuret vaihtelut viittaavat ohi kulkeviin voimakkaisiin rintamiin tai myrskyihin. Herkät voivat kokea pitkittynyttä väsymystä, mielialan vaihteluita tai kroonisen kivun pahenemista. Käytä päivän suunnitteluun ja lähituntien oireiden ennakointiin.",
    "Erinomainen: <2.0 hPa (<0.06 inHg)\nTasainen sää, miellyttävä kaikille",
    "Hyväksyttävä: 2.0-6.0 hPa (0.06-0.18 inHg)\nSää muuttuu, lievät oireet mahdollisia",
    "Epämukava: 6.0-10.0 hPa (0.18-0.30 inHg)\nMyrsky tai rintama ohittamassa, epämukavuus lisääntyy",
    "Huono: >10.0 hPa (>0.30 inHg)\nVoimakas sääilmiö, vahvat oireet mahdollisia",
    "Ilmankosteus vaikuttaa hengitysmukavuuteen, ihon terveyteen ja koettuun lämpötilaan. Raja-arvot perustuvat ASHRAE 55 -standardiin ja EPA:n suosituksiin. Ihannealue (40-60%) ehkäisee hengitysteiden kuivumista ja homeen kasvua. Matala kosteus kuivattaa ihoa, ärsyttää ja lisää staattista sähköä. Korkea kosteus edistää hometta, pölypunkkeja ja epämukavuutta. Tasapaino suojaa terveyttä ja kotia.",
    "Erinomainen: 40-60%\nMukava ja terveellinen hengitysteille ja iholle",
    "Hyväksyttävä: 30-40% tai 60-65%\nLievää kuivuutta tai kosteutta, vähäinen epämukavuus mahdollinen",
    "Epämukava: 20-30% tai 65-70%\nKuiva iho/ärsytys tai tahmea/tukala olo",
    "Huono: <20% tai >70%\nTerveysriski: hengitysoireet tai homeen kasvu todennäköisiä",
    "Absoluuttinen kosteus mittaa ilman vesihöyryn määrän (g/m³) lämpötilasta riippumatta. Toisin kuin suhteellinen kosteus, se kertoo todellisen kosteussisällön. Matalat arvot kuivattavat hengitysteitä ja ihoa. Korkeat arvot vaikeuttavat viilenemistä ja edistävät hometta. Hyödyllinen tuuletuksessa ja sisä- ja ulkoilman vertailussa. Ihannealue tukee hengitysterveyttä ja viihtyvyyttä.",
    "Erinomainen: 7-15 g/m³\nIhanteellinen kosteus, mukava hengittää",
    "Hyväksyttävä: 5-7 tai 15-18 g/m³\nHieman kuiva tai kostea, vähäinen epämukavuus mahdollinen",
    "Epämukava: 4-5 tai 18-20 g/m³\nHavaittavaa kuivuutta tai tukaluutta, epämukavuus mahdollinen",
    "Huono: <4 tai >20 g/m³\nErittäin kuiva tai kostea, hengitys- ja iho-oireet mahdollisia",
    "Kastepiste kuvaa kosteuden tuntua suhteellista kosteutta paremmin. Tulkinta perustuu NOAA:n mukavuusasteikkoon. Se kertoo, kuinka tukalalta tai kuivalta ilma tuntuu. Matala kastepiste tarkoittaa kuivaa ilmaa, joka ärsyttää ihoa ja hengitysteitä. Korkea kastepiste tuntuu tahmealta ja painostavalta, eikä hikoilu viilennä kunnolla. Ihannealueella hengitys on mukavaa ja keho viilenee luonnollisesti.",
    "Erinomainen: 10-16°C (50-61°F)\nIhanteellinen viihtyvyys, miellyttävä hengittää",
    "Hyväksyttävä: 8-10°C (46-50°F) tai 16-18°C (61-64°F)\nHieman kuiva tai kostea, silti miellyttävä",
    "Epämukava: 5-8°C (41-46°F) tai 18-21°C (64-70°F)\nKuiva tai tukala, havaittavaa epämukavuutta",
    "Huono: <5°C (<41°F) tai >21°C (>70°F)\nLiian kuiva tai painostava, epämukava terveydelle",
    "LÄMPÖTILA",
    "FORMALDEHYDI",
    "SUHTEELLINEN KOSTEUS",
    // 'ABSOLUUTTINEN KOSTEUS' (231 px) wraps to two lines in the 223 px
    // sensor info title, so the abbreviated form is used.
    "ABSOL. KOSTEUS",
    "KASTEPISTE",
    "Homeriski kertoo homeen kasvun todennäköisyydestä kosteuden ja lämpötilan perusteella. Yli 70 %:n kosteus ja lämmin ilma luovat ihanteelliset olot homeelle ja pölypunkeille. Homeitiöt aiheuttavat allergioita, hengitystieoireita ja rakennevaurioita. Tarkkaile nurkkia, kylpyhuoneita ja huonosti tuuletettuja tiloja. Pidä kosteus alle 60 %, jotta home ei pääse kasvamaan.",
    "Erinomainen: 0-2\nMatala riski, olosuhteet epäsuotuisat homeelle",
    "Hyväksyttävä: 3-4\nKohtalainen riski, tarkkaile kosteutta",
    "Epämukava: 5-7\nKorkea riski, vähennä kosteutta ja paranna tuuletusta",
    "Huono: 8-10\nKriittinen riski, homeen kasvu todennäköistä, toimi heti",
    "HOMERISKI",
    "PM1 ovat alle 1 mikronin ultrapieniä hiukkasia, jotka tunkeutuvat syvimmälle keuhkoihin ja suoraan verenkiertoon. Lähteitä: palaminen, ajoneuvojen pakokaasut, tupakansavu, ruoanlaiton käryt. Hiukkaskoko on vaarallisin, koska se tunkeutuu syvälle kudoksiin. Virallisia EPA-raja-arvoja ei ole, joten arvot on johdettu PM2.5-ohjeista tiukemmin rajoin suuremman terveysvaikutuksen vuoksi.",
    "Erinomainen: <=10 ug/m3\nPuhdas ilma, ei terveysvaikutuksia",
    "Hyväksyttävä: >10-25 ug/m3\nHerkät voivat tuntea lievää ärsytystä",
    "Epämukava: >25-50 ug/m3\nHengitysoireet mahdollisia, rajoita altistusta",
    "Huono: >50 ug/m3\nTerveysriski, vältä pitkää altistusta, paranna tuuletusta",
    "Hiilimonoksidi eli häkä (CO) on väritön, hajuton ja myrkyllinen kaasu, jota syntyy epätäydellisessä palamisessa. Tyypillisiä lähteitä ovat kaasuliedet, lämmittimet, takat, moottorit ja tupakansavu. CO heikentää hapen kuljetusta veressä ja voi muuttua sisätiloissa nopeasti vaaralliseksi. Huolla polttolaitteet, tuuleta kunnolla ja käytä erillistä häkävaroitinta.",
    "Erinomainen: <9 ppm\nTurvallinen taso, normaali sisäilma",
    "Hyväksyttävä: 9-35 ppm\nKoholla, varmista tuuletus, rajoita altistusta",
    "Epämukava: >35-100 ppm\nVaroitus, päänsärky ja väsymys mahdollisia",
    "Huono: >100 ppm\nVaara! Poistu ja tuuleta välittömästi",
    "PM0.5 laskee ultrapieniä hiukkasia (0.3-0.5 um), jotka ohittavat keuhkojen puolustuksen ja päätyvät verenkiertoon. Hiukkaset mitataan lasersironnalla yksikössä #/cm3. Päälähteitä ovat palaminen, ruoanlaitto, 3D-tulostus, kynttilät ja sähkötupakka. Anturin mittausalue: 0-3000 #/cm3. Raja-arvot huomioivat anturin tarkkuuden (+/-100 #/cm3) ja kaupunkien sisäilman tyypilliset taustatasot.",
    "Erinomainen: <=250 #/cm3\nPuhdas ilma, ihanteellinen uneen ja pitkään oleskeluun",
    "Hyväksyttävä: >250-600 #/cm3\nTavallisen sisäoleskelun taso, ei toimenpiteitä",
    "Epämukava: >600-1200 #/cm3\nLähde havaittu, tuuleta tai käytä ilmanpuhdistinta",
    "Huono: >1200 #/cm3\nSuuri hiukkasmäärä, etsi lähde ja paranna ilmanvaihtoa",
    "Asennetaan päivitystä...\nÄlä katkaise laitteen virtaa.\nLaite käynnistyy uudelleen automaattisesti.",
    "KORKEUS",
    "NAPAUTA:\nASETA\nKORKEUS",
    "MSL-paine\nMerenpinnan tasoon korjattu paine säävertailua varten.",
    "Korkeus merenpinnasta\nTarkista korkeus kartasta tai GPS:stä",
    "Käytetään vain MSL-paineeseen.\nAbsoluuttinen paine ei muutu.",
    "ABS-paine",
    "MSL-paine",
    "KÄYTÄ",
    "YKSIKÖT",
    "WWW-\nSIVU",
    "LOKIT",
    "KIELI:",
    "Laiteohjelmiston päivitys",
    "SALLI\nPÄIVITYS",
    "ESTÄ\nPÄIVITYS",
    "Päivitys odottaa lupaa.\nSallitaanko laiteohjelmiston päivitys?",
    "Päivitys sallittu.\nLataus alkaa...",
    "Päivitys estetty.\nLataus peruttu.",
    "KÄSIN",
    "AUTO\nPÄÄLLÄ",
    "AIKA:",
    "NOPEUS:",
    "PUHALLIN:",
    "Syy",
    "Lisäasetukset verkossa:",
    "LÄHTÖ:",
    "1\nh",
    "2\nh",
    "4\nh",
    "8\nh",
    "EI YHTEYTTÄ",
    "VIKA",
    "KÄYNNISSÄ",
    "PYSÄYTETTY",
    "EI TIETOA",
    "Ota AP käyttöön tai yhdistä Wi-Fiin",
    "Project Aura\nVersio: v%s\n(c) Volodymyr Papush (21CNCStudio)\nAvoin laiteohjelmisto (GPL-3.0-or-later)\naura-aq.com",
