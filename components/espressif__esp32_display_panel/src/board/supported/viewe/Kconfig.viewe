## components/espressif__esp32_display_panel/src/board/supported/viewe/Kconfig.viewe
```kconfig
config BOARD_VIEWE_SMARTRING
    bool "SMARTRING"
    help
        https://github.com/VIEWESMART/SMARTRING/tree/main/information

config BOARD_VIEWE_UEDX24240013_MD50E
    bool "UEDX24240013-MD50E"
    help
        https://github.com/VIEWESMART/UEDX24240013-MD50ESP32_1.3inch-Knob/tree/main/information

config BOARD_VIEWE_UEDX46460015_MD50ET
    bool "UEDX46460015-MD50ET"
    help
        https://github.com/VIEWESMART/UEDX46460015-MD50ESP32-1.5inch-Touch-Knob-Display/tree/main/datasheet

config BOARD_VIEWE_UEDX48480021_MD80E
    bool "UEDX48480021_MD80E"
    help
        https://github.com/VIEWESMART/UEDX48480021-MD80ESP32_2.1inch-Knob/tree/main/information

config BOARD_VIEWE_UEDX48480021_MD80E_V2
    bool "UEDX48480021_MD80E_V2"
    help
        https://github.com/VIEWESMART/UEDX48480021-MD80ESP32_2.1inch-Knob/tree/main/information

config BOARD_VIEWE_UEDX48480021_MD80ET
    bool "UEDX48480021_MD80ET"
    help
        https://github.com/VIEWESMART/UEDX48480021-MD80ESP32-2.1inch-Touch-Knob-Display/tree/main/information

config BOARD_VIEWE_UEDX48480028_MD80ET
    bool "UEDX48480028_MD80ET"

config BOARD_VIEWE_UEDX24320024E_WB_A
    bool "UEDX24320024E-WB-A"
    help
        https://viewedisplay.com/product/esp32-2-4-inch-240x320-rgb-ips-tft-display-touch-screen-arduino-lvgl-wifi-ble-uart-smart-module/

config BOARD_VIEWE_UEDX24320028E_WB_A
    bool "UEDX24320028E-WB-A"
    help
        https://viewedisplay.com/product/esp32-2-8-inch-240x320-mcu-ips-tft-display-touch-screen-arduino-lvgl-wifi-ble-uart-smart-module/

config BOARD_VIEWE_UEDX24320035E_WB_A
    bool "UEDX24320035E-WB-A"
    help
        https://viewedisplay.com/product/esp32-3-5-inch-240x320-mcu-ips-tft-display-touch-screen-arduino-lvgl-wifi-ble-uart-smart-module/

config BOARD_VIEWE_UEDX32480035E_WB_A
    bool "UEDX32480035E-WB-A"
    help
        https://github.com/VIEWESMART/Product-Specification-and-Schematic/blob/main/ESP32/3.5inch/320480/UEDX32480035E-WB-A%20SPEC.pdf

config BOARD_VIEWE_UEDX48270043E_WB_A
    bool "UEDX48270043E-WB-A"
    help
        https://github.com/VIEWESMART/Product-Specification-and-Schematic/blob/main/ESP32/4.3inch/Low-Resolution_480272/UEDX48270043E-WB-A%20SPEC.pdf

config BOARD_VIEWE_UEDX48480040E_WB_A
    bool "UEDX48480040E-WB-A"
    help
        https://viewedisplay.com/product/esp32-4-inch-tft-display-touch-screen-arduino-lvgl/

config BOARD_VIEWE_UEDX80480043E_WB_A
    bool "UEDX80480043E-WB-A"
    help
        https://viewedisplay.com/product/esp32-4-3-inch-800x480-rgb-ips-tft-display-touch-screen-arduino-lvgl/

config BOARD_VIEWE_UEDX80480050E_WB_A
    bool "UEDX80480050E-WB-A"
    help
        https://viewedisplay.com/product/esp32-5-inch-800x480-rgb-ips-tft-display-touch-screen-arduino-lvgl/

config BOARD_VIEWE_UEDX80480050E_AC_A
    bool "UEDX80480050E-AC-A"
    help
        https://viewedisplay.com/product/esp32-5-inch-800x480-rgb-ips-tft-display-touch-screen-arduino-lvgl/

config BOARD_VIEWE_UEDX80480050E_WB_A_2
    bool "UEDX80480050E-WB-A-2"
    help
        https://viewedisplay.com/product/esp32-5-inch-800x480-rgb-ips-tft-display-touch-screen-arduino-lvgl/

config BOARD_VIEWE_UEDX80480070E_WB_A
    bool "UEDX80480070E-WB-A"
    help
        https://viewedisplay.com/product/esp32-7-inch-800x480-rgb-ips-tft-display-touch-screen-arduino-lvgl-uart/
```

## sdkconfig.defaults
```kconfig
CONFIG_LCD_CAM_ISR_IRAM_SAFE=y
CONFIG_LCD_RGB_ISR_IRAM_SAFE=y
CONFIG_ESP_WIFI_IRAM_OPT=y
CONFIG_ESP_IPC_TASK_STACK_SIZE=4096
```
